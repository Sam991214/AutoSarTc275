AUTOSAR XML (schema 4-0-3)
package /DaVinci_Project
  module config Rte
    4 x RteBswModuleInstance:
      BswM
        BswM_MainFunctionTimingEvent0 (RteBswEventToTaskMapping): RteBswUsedOsEventRef=Rte_Ev_Cyclic2_OsTask_Bsw5ms_Core0_0_5ms, RteBswUsedOsAlarmRef=Os/Rte_Al_TE2_OsTask_Bsw5ms_Core0_0_5ms
      Det
      EcuM
        3 x RteBswEventToTaskMapping:
          EcuM_MainFunctionTimingEvent0: RteBswUsedOsEventRef=Rte_Ev_Cyclic2_OsTask_Bsw5ms_Core0_0_5ms, RteBswUsedOsAlarmRef=Os/Rte_Al_TE2_OsTask_Bsw5ms_Core0_0_5ms
          EcuM_MainFunctionTimingEvent1: RteBswUsedOsEventRef=Rte_Ev_RunS2_EcuM_EcuM_MainFunction, RteBswUsedOsAlarmRef=Os/Rte_Al_TE2_EcuM_EcuM_MainFunction
          EcuM_MainFunctionTimingEvent2: RteBswUsedOsEventRef=Rte_Ev_Cyclic2_OsTask_App10ms_Core2_0_5ms, RteBswUsedOsAlarmRef=Os/Rte_Al_TE2_OsTask_App10ms_Core2_0_5ms
      Mcu
    6 x RteSwComponentInstance:
      BswM_EcuSwComposition
        Timer_BswM_MainFunction (RteEventToTaskMapping): RteUsedOsEventRef=Rte_Ev_Cyclic2_OsTask_Bsw5ms_Core0_0_5ms, RteUsedOsAlarmRef=Os/Rte_Al_TE2_OsTask_Bsw5ms_Core0_0_5ms
      Det_EcuSwComposition
      EcuM_EcuSwComposition
        Timer_EcuM_MainFunction (RteEventToTaskMapping): RteUsedOsEventRef=Rte_Ev_Cyclic2_OsTask_App10ms_Core2_0_5ms, RteUsedOsAlarmRef=Os/Rte_Al_TE2_OsTask_App10ms_Core2_0_5ms
      Os_OsCore{0..2}_swc_EcuSwComposition
    RteOsInteraction
      3 x RteUsedOsActivation, all with RteExpectedActivationOffset=0:
        Rte_Al_TE2_EcuM_EcuM_MainFunction: RteActivationOsAlarmRef=Os/Rte_Al_TE2_EcuM_EcuM_MainFunction, RteActivationOsTaskRef=OsTask_App10ms_Core1
        Rte_Al_TE2_OsTask_App10ms_Core2_0_5ms: RteActivationOsAlarmRef=Os/Rte_Al_TE2_OsTask_App10ms_Core2_0_5ms, RteActivationOsTaskRef=OsTask_App10ms_Core2
        Rte_Al_TE2_OsTask_Bsw5ms_Core0_0_5ms: RteActivationOsAlarmRef=Os/Rte_Al_TE2_OsTask_Bsw5ms_Core0_0_5ms, RteActivationOsTaskRef=OsTask_Bsw5ms_Core0
  module config NvM
  module config Os
    OsTask_App10ms_Core1 (OsTask):
      OsTaskActivation = 1
      OsTaskPriority = 42
      OsTaskSchedule = NON
      OsTaskEventRef = Rte_Ev_RunS2_EcuM_EcuM_MainFunction
      OsTaskAccessingApplication = SystemApplication_OsCore0
      OsTaskAccessingApplication = SystemApplication_OsCore2
    Rte_Al_TE2_EcuM_EcuM_MainFunction (OsAlarm):
      OsAlarmCounterRef = SystemTimer_Core1
      OsAlarmAccessingApplication = SystemApplication_OsCore0
      OsAlarmAccessingApplication = SystemApplication_OsCore2
      OsAlarmAction
        OsAlarmSetEvent: OsAlarmSetEventRef=Rte_Ev_RunS2_EcuM_EcuM_MainFunction, OsAlarmSetEventTaskRef=OsTask_App10ms_Core1
    OsTask_App10ms_Core2 (OsTask):
      OsTaskActivation = 1
      OsTaskPriority = 46
      OsTaskSchedule = NON
      OsTaskEventRef = Rte_Ev_Cyclic2_OsTask_App10ms_Core2_0_5ms
      OsTaskAccessingApplication = SystemApplication_OsCore0
      OsTaskAccessingApplication = SystemApplication_OsCore1
    Rte_Al_TE2_OsTask_App10ms_Core2_0_5ms (OsAlarm):
      OsAlarmCounterRef = SystemTimer_Core2
      OsAlarmAccessingApplication = SystemApplication_OsCore0
      OsAlarmAccessingApplication = SystemApplication_OsCore1
      OsAlarmAction
        OsAlarmSetEvent: OsAlarmSetEventRef=Rte_Ev_Cyclic2_OsTask_App10ms_Core2_0_5ms, OsAlarmSetEventTaskRef=OsTask_App10ms_Core2
    OsTask_Bsw5ms_Core0 (OsTask):
      OsTaskActivation = 1
      OsTaskPriority = 35
      OsTaskSchedule = NON
      OsTaskEventRef = Rte_Ev_Cyclic2_OsTask_Bsw5ms_Core0_0_5ms
      OsTaskAccessingApplication = SystemApplication_OsCore1
      OsTaskAccessingApplication = SystemApplication_OsCore2
    Rte_Al_TE2_OsTask_Bsw5ms_Core0_0_5ms (OsAlarm):
      OsAlarmCounterRef = SystemTimer_Core0
      OsAlarmAccessingApplication = SystemApplication_OsCore1
      OsAlarmAccessingApplication = SystemApplication_OsCore2
      OsAlarmAction
        OsAlarmSetEvent: OsAlarmSetEventRef=Rte_Ev_Cyclic2_OsTask_Bsw5ms_Core0_0_5ms, OsAlarmSetEventTaskRef=OsTask_Bsw5ms_Core0
    3 x OsEvent:
      Rte_Ev_Cyclic2_OsTask_App10ms_Core2_0_5ms
      Rte_Ev_Cyclic2_OsTask_Bsw5ms_Core0_0_5ms
      Rte_Ev_RunS2_EcuM_EcuM_MainFunction
    3 x OsApplication, all with OsTrusted=true:
      SystemApplication_OsCore0: OsAppTaskRef=OsTask_Bsw5ms_Core0, OsAppAlarmRef=Os/Rte_Al_TE2_OsTask_Bsw5ms_Core0_0_5ms
      SystemApplication_OsCore1: OsAppTaskRef=OsTask_App10ms_Core1, OsAppAlarmRef=Os/Rte_Al_TE2_EcuM_EcuM_MainFunction
      SystemApplication_OsCore2: OsAppTaskRef=OsTask_App10ms_Core2, OsAppAlarmRef=Os/Rte_Al_TE2_OsTask_App10ms_Core2_0_5ms
  module config EcuC
  ecuc value collection DaVinci_Project: ecuc-values=[Com, Rte, Os, EcuC, NvM]
