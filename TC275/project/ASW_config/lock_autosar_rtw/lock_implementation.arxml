AUTOSAR XML (schema 00048)
package /ComponentTypes
  swc implementation lock_imp: programming-language=C, sw-version=1.1.1, used-code-generator=Embedded Coder 7.9 (R2022b) 13-May-2022, vendor-id=0, behavior=lock_InternalBehavior
    code-descriptors:
      code Code
        artifact-descriptors:
          short-label=lock_c, category=SWSRC
          short-label=lock_h, category=SWHDR
          short-label=lock_private_h, category=SWHDR
          short-label=lock_types_h, category=SWHDR
          short-label=rtwtypes_h, category=SWHDR
    resource consumption RsrcCons_lock
