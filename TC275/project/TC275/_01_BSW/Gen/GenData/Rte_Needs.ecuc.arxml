AUTOSAR XML (schema 4-0-3)
package /DaVinci_Project
  module config Com
    ComConfig
      lock_cmd_oLOCK_Control_oCAN00_cf665a91_Rx (ComSignal): ComSignalType=UINT8
      lock_status_oLOCK_status_oCAN00_d69a269d_Tx (ComSignal): ComSignalType=UINT8
  module config Rte
    14 x RteBswModuleInstance:
      BswM
        BswM_MainFunctionTimingEvent0 (RteBswEventToTaskMapping): RteBswUsedOsEventRef=Rte_Ev_Cyclic2_OsTask_Bsw5ms_Core0_0_5ms, RteBswUsedOsAlarmRef=Os/Rte_Al_TE2_OsTask_Bsw5ms_Core0_0_5ms
      Can
        5 x RteBswEventToTaskMapping, all with RteBswUsedOsEventRef=Rte_Ev_Cyclic2_OsTask_Bsw5ms_Core0_0_10ms, RteBswUsedOsAlarmRef=Os/Rte_Al_TE2_OsTask_Bsw5ms_Core0_0_10ms:
          Can_MainFunction_BusOffTimingEvent0
          Can_MainFunction_ModeTimingEvent0
          Can_MainFunction_ReadTimingEvent0
          Can_MainFunction_WakeupTimingEvent0
          Can_MainFunction_WriteTimingEvent0
      CanIf
      CanNm
        CanNm_MainFunctionTimingEvent0 (RteBswEventToTaskMapping): RteBswUsedOsEventRef=Rte_Ev_Cyclic2_OsTask_Bsw5ms_Core0_0_10ms, RteBswUsedOsAlarmRef=Os/Rte_Al_TE2_OsTask_Bsw5ms_Core0_0_10ms
      CanSM
        CanSM_MainFunctionTimingEvent0 (RteBswEventToTaskMapping): RteBswUsedOsEventRef=Rte_Ev_Cyclic2_OsTask_Bsw5ms_Core0_0_5ms, RteBswUsedOsAlarmRef=Os/Rte_Al_TE2_OsTask_Bsw5ms_Core0_0_5ms
      Com
        Com_MainFunctionRxTimingEvent0 (RteBswEventToTaskMapping): RteBswUsedOsEventRef=Rte_Ev_Cyclic2_OsTask_Bsw5ms_Core0_0_10ms, RteBswUsedOsAlarmRef=Os/Rte_Al_TE2_OsTask_Bsw5ms_Core0_0_10ms
        Com_MainFunctionTxTimingEvent0 (RteBswEventToTaskMapping): RteBswUsedOsEventRef=Rte_Ev_Cyclic2_OsTask_Bsw5ms_Core0_0_10ms, RteBswUsedOsAlarmRef=Os/Rte_Al_TE2_OsTask_Bsw5ms_Core0_0_10ms
      ComM
        ComM_MainFunction_0TimingEvent0 (RteBswEventToTaskMapping): RteBswUsedOsEventRef=Rte_Ev_Cyclic2_OsTask_Bsw5ms_Core0_0_20ms, RteBswUsedOsAlarmRef=Os/Rte_Al_TE2_OsTask_Bsw5ms_Core0_0_20ms
      Det
      Dio
      EcuM
        3 x RteBswEventToTaskMapping:
          EcuM_MainFunctionTimingEvent0: RteBswUsedOsEventRef=Rte_Ev_Cyclic2_OsTask_Bsw5ms_Core0_0_5ms, RteBswUsedOsAlarmRef=Os/Rte_Al_TE2_OsTask_Bsw5ms_Core0_0_5ms
          EcuM_MainFunctionTimingEvent1: RteBswUsedOsEventRef=Rte_Ev_RunS2_EcuM_EcuM_MainFunction, RteBswUsedOsAlarmRef=Os/Rte_Al_TE2_EcuM_EcuM_MainFunction
          EcuM_MainFunctionTimingEvent2: RteBswUsedOsEventRef=Rte_Ev_Cyclic2_OsTask_App10ms_Core2_0_5ms, RteBswUsedOsAlarmRef=Os/Rte_Al_TE2_OsTask_App10ms_Core2_0_5ms
      Mcu
      Nm
      PduR
      Port
    8 x RteSwComponentInstance:
      BswM_EcuSwComposition
        Timer_BswM_MainFunction (RteEventToTaskMapping): RteUsedOsEventRef=Rte_Ev_Cyclic2_OsTask_Bsw5ms_Core0_0_5ms, RteUsedOsAlarmRef=Os/Rte_Al_TE2_OsTask_Bsw5ms_Core0_0_5ms
      ComM_EcuSwComposition
        Timer_ComM_MainFunction_0 (RteEventToTaskMapping): RteUsedOsEventRef=Rte_Ev_Cyclic2_OsTask_Bsw5ms_Core0_0_20ms, RteUsedOsAlarmRef=Os/Rte_Al_TE2_OsTask_Bsw5ms_Core0_0_20ms
      Det_EcuSwComposition
      EcuM_EcuSwComposition
        Timer_EcuM_MainFunction (RteEventToTaskMapping): RteUsedOsEventRef=Rte_Ev_Cyclic2_OsTask_App10ms_Core2_0_5ms, RteUsedOsAlarmRef=Os/Rte_Al_TE2_OsTask_App10ms_Core2_0_5ms
      Os_OsCore{0..2}_swc_EcuSwComposition
      lock_EcuSwComposition
        TMT_Runnable (RteEventToTaskMapping): RteUsedOsEventRef=Rte_Ev_Run_lock_lock, RteUsedOsAlarmRef=Os/Rte_Al_TE_lock_lock
    RteOsInteraction
      6 x RteUsedOsActivation, all with RteExpectedActivationOffset=0:
        Rte_Al_TE2_EcuM_EcuM_MainFunction: RteActivationOsAlarmRef=Os/Rte_Al_TE2_EcuM_EcuM_MainFunction, RteActivationOsTaskRef=OsTask_App10ms_Core1
        Rte_Al_TE2_OsTask_App10ms_Core2_0_5ms: RteActivationOsAlarmRef=Os/Rte_Al_TE2_OsTask_App10ms_Core2_0_5ms, RteActivationOsTaskRef=OsTask_App10ms_Core2
        Rte_Al_TE2_OsTask_Bsw5ms_Core0_0_10ms: RteActivationOsAlarmRef=Os/Rte_Al_TE2_OsTask_Bsw5ms_Core0_0_10ms, RteActivationOsTaskRef=OsTask_Bsw5ms_Core0
        Rte_Al_TE2_OsTask_Bsw5ms_Core0_0_20ms: RteActivationOsAlarmRef=Os/Rte_Al_TE2_OsTask_Bsw5ms_Core0_0_20ms, RteActivationOsTaskRef=OsTask_Bsw5ms_Core0
        Rte_Al_TE2_OsTask_Bsw5ms_Core0_0_5ms: RteActivationOsAlarmRef=Os/Rte_Al_TE2_OsTask_Bsw5ms_Core0_0_5ms, RteActivationOsTaskRef=OsTask_Bsw5ms_Core0
        Rte_Al_TE_lock_lock: RteActivationOsAlarmRef=Os/Rte_Al_TE_lock_lock, RteActivationOsTaskRef=OsTask_Bsw5ms_Core0
  module config NvM
  module config Os
    OsTask_App10ms_Core1 (OsTask):
      OsTaskActivation = 1
      OsTaskPriority = 42
      OsTaskSchedule = NON
      OsTaskEventRef = Rte_Ev_RunS2_EcuM_EcuM_MainFunction
      OsTaskAccessingApplication = SystemApplication_OsCore0
      OsTaskAccessingApplication = SystemApplication_OsCore2
    Rte_Al_TE2_EcuM_EcuM_MainFunction (OsAlarm):
      OsAlarmCounterRef = SystemTimer_Core1
      OsAlarmAccessingApplication = SystemApplication_OsCore0
      OsAlarmAccessingApplication = SystemApplication_OsCore2
      OsAlarmAction
        OsAlarmSetEvent: OsAlarmSetEventRef=Rte_Ev_RunS2_EcuM_EcuM_MainFunction, OsAlarmSetEventTaskRef=OsTask_App10ms_Core1
    OsTask_App10ms_Core2 (OsTask):
      OsTaskActivation = 1
      OsTaskPriority = 46
      OsTaskSchedule = NON
      OsTaskEventRef = Rte_Ev_Cyclic2_OsTask_App10ms_Core2_0_5ms
      OsTaskAccessingApplication = SystemApplication_OsCore0
      OsTaskAccessingApplication = SystemApplication_OsCore1
    Rte_Al_TE2_OsTask_App10ms_Core2_0_5ms (OsAlarm):
      OsAlarmCounterRef = SystemTimer_Core2
      OsAlarmAccessingApplication = SystemApplication_OsCore0
      OsAlarmAccessingApplication = SystemApplication_OsCore1
      OsAlarmAction
        OsAlarmSetEvent: OsAlarmSetEventRef=Rte_Ev_Cyclic2_OsTask_App10ms_Core2_0_5ms, OsAlarmSetEventTaskRef=OsTask_App10ms_Core2
    OsTask_Bsw5ms_Core0 (OsTask):
      OsTaskActivation = 1
      OsTaskPriority = 35
      OsTaskSchedule = NON
      OsTaskEventRef = Rte_Ev_Cyclic2_OsTask_Bsw5ms_Core0_0_10ms
      OsTaskEventRef = Rte_Ev_Cyclic2_OsTask_Bsw5ms_Core0_0_20ms
      OsTaskEventRef = Rte_Ev_Cyclic2_OsTask_Bsw5ms_Core0_0_5ms
      OsTaskEventRef = Rte_Ev_Run_lock_lock
      OsTaskAccessingApplication = SystemApplication_OsCore1
      OsTaskAccessingApplication = SystemApplication_OsCore2
    4 x OsAlarm, all with OsAlarmCounterRef=SystemTimer_Core0, OsAlarmAccessingApplication=SystemApplication_OsCore1, OsAlarmAccessingApplication=SystemApplication_OsCore2:
      Rte_Al_TE2_OsTask_Bsw5ms_Core0_0_10ms
        OsAlarmAction
          OsAlarmSetEvent: OsAlarmSetEventRef=Rte_Ev_Cyclic2_OsTask_Bsw5ms_Core0_0_10ms, OsAlarmSetEventTaskRef=OsTask_Bsw5ms_Core0
      Rte_Al_TE2_OsTask_Bsw5ms_Core0_0_20ms
        OsAlarmAction
          OsAlarmSetEvent: OsAlarmSetEventRef=Rte_Ev_Cyclic2_OsTask_Bsw5ms_Core0_0_20ms, OsAlarmSetEventTaskRef=OsTask_Bsw5ms_Core0
      Rte_Al_TE2_OsTask_Bsw5ms_Core0_0_5ms
        OsAlarmAction
          OsAlarmSetEvent: OsAlarmSetEventRef=Rte_Ev_Cyclic2_OsTask_Bsw5ms_Core0_0_5ms, OsAlarmSetEventTaskRef=OsTask_Bsw5ms_Core0
      Rte_Al_TE_lock_lock
        OsAlarmAction
          OsAlarmSetEvent: OsAlarmSetEventRef=Rte_Ev_Run_lock_lock, OsAlarmSetEventTaskRef=OsTask_Bsw5ms_Core0
    6 x OsEvent:
      Rte_Ev_Cyclic2_OsTask_App10ms_Core2_0_5ms
      Rte_Ev_Cyclic2_OsTask_Bsw5ms_Core0_0_10ms
      Rte_Ev_Cyclic2_OsTask_Bsw5ms_Core0_0_20ms
      Rte_Ev_Cyclic2_OsTask_Bsw5ms_Core0_0_5ms
      Rte_Ev_RunS2_EcuM_EcuM_MainFunction
      Rte_Ev_Run_lock_lock
    3 x OsApplication, all with OsTrusted=true:
      SystemApplication_OsCore0: OsAppTaskRef=OsTask_Bsw5ms_Core0, OsAppAlarmRef=Os/Rte_Al_TE2_OsTask_Bsw5ms_Core0_0_10ms, OsAppAlarmRef=Os/Rte_Al_TE2_OsTask_Bsw5ms_Core0_0_20ms, OsAppAlarmRef=Os/Rte_Al_TE2_OsTask_Bsw5ms_Core0_0_5ms, OsAppAlarmRef=Os/Rte_Al_TE_lock_lock
      SystemApplication_OsCore1: OsAppTaskRef=OsTask_App10ms_Core1, OsAppAlarmRef=Os/Rte_Al_TE2_EcuM_EcuM_MainFunction
      SystemApplication_OsCore2: OsAppTaskRef=OsTask_App10ms_Core2, OsAppAlarmRef=Os/Rte_Al_TE2_OsTask_App10ms_Core2_0_5ms
  module config EcuC
  ecuc value collection DaVinci_Project: ecuc-values=[Com, Rte, Os, EcuC, NvM]
