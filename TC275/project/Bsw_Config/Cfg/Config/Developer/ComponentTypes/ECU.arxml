AUTOSAR XML (schema 4-3-0)
package /ComponentTypes
  composition sw component type ECU
    component SWC_lock: type=lock
