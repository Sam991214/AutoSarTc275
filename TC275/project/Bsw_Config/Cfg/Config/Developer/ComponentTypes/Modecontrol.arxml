AUTOSAR XML (schema 4-3-0)
package /PortInterfaces
  service sw component type Modecontrol
    provide port MODEOUT: nonqueued-sender-com-spec=MODE, provided-interface=MODEOUT
    behavior Modecontrol_InternalBehavior: port-api-option{enable-take-address=true, error-handling=NO-TRANSFORMER-ERROR-HANDLING, indirect-api=true, port=MODEOUT}
  swc implementation Modecontrol_Implementation: behavior=Modecontrol_InternalBehavior
