AUTOSAR XML (schema 4-3-0)
package /ModeDclrGroups
  mode declaration group mode: initial-mode=MOD
    mode MOD: value=0
    mode MOD1: value=1
package /PortInterfaces
  4 x sender receiver interface:
    lock_control
      data lock_cmd: type=uint8
    lock_status
      data lock_status: type=uint8
    MODEOUT: is-service=true
      data MODE: type=uint8
    outmode
      data mode: type=uint8
