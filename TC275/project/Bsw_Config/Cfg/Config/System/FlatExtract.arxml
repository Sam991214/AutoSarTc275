AUTOSAR XML (schema 00046)
package /COM/VECTOR/CFG/WORKFLOW/SYSDESC/SYNC
  system SYSTEM: category=ECU_EXTRACT
    system mapping MAPPINGS
      data-mappings:
        data-element=lock.COMPOSITIONTYPE.lock_control.lock_cmd, system-signal=lock_cmd
        data-element=lock.COMPOSITIONTYPE.lock_status.lock_status, system-signal=lock_status
    root-software-compositions:
      root sw composition prototype COMPOSITIONTYPE: flat-map=FLATMAP, software-composition=COMPOSITIONTYPE
  composition sw component type COMPOSITIONTYPE  # UB:Derived from original system description
    8 x component:
      Det: type=Det
      EcuM: type=EcuM
      Os_OsCore0_swc: type=Os_OsCore0_swc
      Os_OsCore2_swc: type=Os_OsCore2_swc
      Os_OsCore1_swc: type=Os_OsCore1_swc
      BswM: type=BswM
      ComM: type=ComM
      lock: type=lock
    connect BswM.Switch_ESH_ModeSwitch -> BswM.Notification_ESH_ModeNotification
  end to end protection set E2EPROTECTIONSET
    end to end protection ECU_Composition_SG_Sig_Grp_0x212_SG_Sig_Grp_0x212_delegated: end-to-end-profile={category=PROFILE_01, data-ids=4112, data-id-mode=0, data-length=64, max-delta-counter-init=2, crc-offset=0, counter-offset=56, max-no-new-or-repeated-data=14, sync-counter-init=2, data-id-nibble-offset=0}, end-to-end-protection-variable-prototype=AppComTx.COMPOSITIONTYPE.SG_Sig_Grp_0x212.SG_Sig_Grp_0x212
    end to end protection ECU_Composition_SG_Sig_Grp_0x300_SG_Sig_Grp_0x300_delegated_001: end-to-end-profile={category=PROFILE_01, data-ids=8224, data-id-mode=0, data-length=64, max-delta-counter-init=2, crc-offset=0, counter-offset=56, max-no-new-or-repeated-data=14, sync-counter-init=2, data-id-nibble-offset=0}, end-to-end-protection-variable-prototype=receiver=AppComRx.COMPOSITIONTYPE.SG_Sig_Grp_0x300.SG_Sig_Grp_0x300
  port interface mapping set PORTINTERFACEMAPPINGSET
