AUTOSAR XML (schema 00046)
package /ActiveEcuC
  module config Rte: implementation-config-variant=VARIANT-PRE-COMPILE, module-description=Rte_Impl
    RteInitializationBehavior: RteInitializationStrategy=RTE_INITIALIZATION_STRATEGY_AT_DATA_DECLARATION, RteSectionInitializationPolicy=INIT
    RteGeneration:
      RteGenerationMode = COMPATIBILITY_MODE
      RteIocInteractionReturnValue = RTE_IOC
      RteValueRangeCheckEnabled = false
      RteCalibrationSupport = NONE
      RteCodeVendorId = 30
      RteDevErrorDetect = true
      RteDevErrorDetectUninit = false
      RteMeasurementSupport = false
      RteOptimizationMode = MEMORY
      RteVfbTraceEnabled = false
    RteBswGeneral: RteSchMVersionInfoApi=false, RteUseComShadowSignalApi=false
    RteOsInteraction
      6 x RteUsedOsActivation, all with RteExpectedActivationOffset=0, RteExpectedTickDuration=0:
        Rte_Al_TE2_EcuM_EcuM_MainFunction: RteActivationOsAlarmRef=Rte_Al_TE2_EcuM_EcuM_MainFunction, RteActivationOsTaskRef=OsTask_App10ms_Core1
        Rte_Al_TE2_OsTask_App10ms_Core2_0_5ms: RteActivationOsAlarmRef=Rte_Al_TE2_OsTask_App10ms_Core2_0_5ms, RteActivationOsTaskRef=OsTask_App10ms_Core2
        Rte_Al_TE2_OsTask_Bsw5ms_Core0_0_5ms: RteActivationOsAlarmRef=Rte_Al_TE2_OsTask_Bsw5ms_Core0_0_5ms, RteActivationOsTaskRef=OsTask_Bsw5ms_Core0
        Rte_Al_TE2_OsTask_Bsw5ms_Core0_0_10ms: RteActivationOsAlarmRef=Rte_Al_TE2_OsTask_Bsw5ms_Core0_0_10ms, RteActivationOsTaskRef=OsTask_Bsw5ms_Core0
        Rte_Al_TE2_OsTask_Bsw5ms_Core0_0_20ms: RteActivationOsAlarmRef=Rte_Al_TE2_OsTask_Bsw5ms_Core0_0_20ms, RteActivationOsTaskRef=OsTask_Bsw5ms_Core0
        Rte_Al_TE_lock_lock: RteActivationOsAlarmRef=Rte_Al_TE_lock_lock, RteActivationOsTaskRef=OsTask_Bsw5ms_Core0
    4 x RteBswModuleInstance:
      BswM: RteBswImplementationRef=BswM_Impl, RteBswModuleConfigurationRef=BswM
        BSWM_EXCLUSIVE_AREA_0 (RteBswExclusiveAreaImpl): RteExclusiveAreaImplMechanism=ALL_INTERRUPT_BLOCKING, RteBswExclusiveAreaRef=BSWM_EXCLUSIVE_AREA_0
        BswM_MainFunctionTimingEvent0 (RteBswEventToTaskMapping):
          RteBswImmediateRestart = false
          RteBswPositionInTask = 10
          RteBswEventRef = BswM_MainFunctionTimingEvent0
          RteBswMappedToTaskRef = OsTask_Bsw5ms_Core0
          RteBswUsedOsEventRef = Rte_Ev_Cyclic2_OsTask_Bsw5ms_Core0_0_5ms
          RteBswUsedOsAlarmRef = Rte_Al_TE2_OsTask_Bsw5ms_Core0_0_5ms
      Det: RteBswImplementationRef=Det_Impl, RteBswModuleConfigurationRef=Det
        DET_EXCLUSIVE_AREA_0 (RteBswExclusiveAreaImpl): RteExclusiveAreaImplMechanism=ALL_INTERRUPT_BLOCKING, RteBswExclusiveAreaRef=DET_EXCLUSIVE_AREA_0
      EcuM: RteBswImplementationRef=EcuM_Impl, RteBswModuleConfigurationRef=EcuM
        EcuM_MainFunctionTimingEvent0 (RteBswEventToTaskMapping):
          RteBswImmediateRestart = false
          RteBswPositionInTask = 0
          RteBswEventRef = EcuM_MainFunctionTimingEvent0
          RteBswMappedToTaskRef = OsTask_Bsw5ms_Core0
          RteBswUsedOsAlarmRef = Rte_Al_TE2_OsTask_Bsw5ms_Core0_0_5ms
          RteBswUsedOsEventRef = Rte_Ev_Cyclic2_OsTask_Bsw5ms_Core0_0_5ms
        3 x RteBswExclusiveAreaImpl, all with RteExclusiveAreaImplMechanism=ALL_INTERRUPT_BLOCKING:
          ECUM_EXCLUSIVE_AREA_{0..2}: RteBswExclusiveAreaRef=ECUM_EXCLUSIVE_AREA_{0..2}
        EcuM_MainFunctionTimingEvent1 (RteBswEventToTaskMapping):
          RteBswImmediateRestart = false
          RteBswPositionInTask = 1
          RteBswEventRef = EcuM_MainFunctionTimingEvent1
          RteBswMappedToTaskRef = OsTask_App10ms_Core1
          RteBswUsedOsEventRef = Rte_Ev_RunS2_EcuM_EcuM_MainFunction
          RteBswUsedOsAlarmRef = Rte_Al_TE2_EcuM_EcuM_MainFunction
        EcuM_MainFunctionTimingEvent2 (RteBswEventToTaskMapping):
          RteBswImmediateRestart = false
          RteBswPositionInTask = 1
          RteBswEventRef = EcuM_MainFunctionTimingEvent2
          RteBswMappedToTaskRef = OsTask_App10ms_Core2
          RteBswUsedOsEventRef = Rte_Ev_Cyclic2_OsTask_App10ms_Core2_0_5ms
          RteBswUsedOsAlarmRef = Rte_Al_TE2_OsTask_App10ms_Core2_0_5ms
      Rte: RteBswImplementationRef=Rte_Impl, RteBswModuleConfigurationRef=Rte
        Rte_ComSendSignalProxyPeriodicTimingEvent0 (RteBswEventToTaskMapping):
          RteBswImmediateRestart = false
          RteBswPositionInTask = 9
          RteBswEventRef = Rte_ComSendSignalProxyPeriodicTimingEvent0
          RteBswMappedToTaskRef = OsTask_Bsw5ms_Core0
    6 x RteSwComponentInstance:
      EcuM_EcuSwComposition: RteSoftwareComponentInstanceRef=EcuM
        8 x RteEventToTaskMapping, all with RteImmediateRestart=false:
          Timer_EcuM_MainFunction: RtePositionInTask=1, RteEventRef=Timer_EcuM_MainFunction, RteMappedToTaskRef=OsTask_App10ms_Core2, RteUsedOsEventRef=Rte_Ev_Cyclic2_OsTask_App10ms_Core2_0_5ms, RteUsedOsAlarmRef=Rte_Al_TE2_OsTask_App10ms_Core2_0_5ms
          OpEventSelectShutdownTarget_SelectShutdownTarget_EcuM_ShutdownTarget: RteEventRef=OpEventSelectShutdownTarget_SelectShutdownTarget_EcuM_ShutdownTarget
          OpEventGetShutdownTarget_GetShutdownTarget_EcuM_ShutdownTarget: RteEventRef=OpEventGetShutdownTarget_GetShutdownTarget_EcuM_ShutdownTarget
          OpEventGetLastShutdownTarget_GetLastShutdownTarget_EcuM_ShutdownTarget: RteEventRef=OpEventGetLastShutdownTarget_GetLastShutdownTarget_EcuM_ShutdownTarget
          OpEventSelectShutdownCause_SelectShutdownCause_EcuM_ShutdownTarget: RteEventRef=OpEventSelectShutdownCause_SelectShutdownCause_EcuM_ShutdownTarget
          OpEventGetShutdownCause_GetShutdownCause_EcuM_ShutdownTarget: RteEventRef=OpEventGetShutdownCause_GetShutdownCause_EcuM_ShutdownTarget
          OpEventSelectBootTarget_SelectBootTarget_EcuM_BootTarget: RteEventRef=OpEventSelectBootTarget_SelectBootTarget_EcuM_BootTarget
          OpEventGetBootTarget_GetBootTarget_EcuM_BootTarget: RteEventRef=OpEventGetBootTarget_GetBootTarget_EcuM_BootTarget
      Det_EcuSwComposition: RteSoftwareComponentInstanceRef=Det
        OpEventReportError_ReportError_DetModule (RteEventToTaskMapping): RteImmediateRestart=false, RtePositionInTask=15, RteEventRef=OpEventReportError_ReportError_DetModule, RteMappedToTaskRef=OsTask_Bsw5ms_Core0
      Os_OsCore0_swc_EcuSwComposition: RteSoftwareComponentInstanceRef=Os_OsCore0_swc
        OpEventGetCounterValue_GetCounterValue_OsService_SystemTimer_Core0 (RteEventToTaskMapping):
          RteImmediateRestart = false
          RtePositionInTask = 11
          RteEventRef = OpEventGetCounterValue_GetCounterValue_OsService_SystemTimer_Core0
          RteMappedToTaskRef = OsTask_Bsw5ms_Core0
        OpEventGetElapsedValue_GetElapsedValue_OsService_SystemTimer_Core0 (RteEventToTaskMapping):
          RteImmediateRestart = false
          RtePositionInTask = 12
          RteEventRef = OpEventGetElapsedValue_GetElapsedValue_OsService_SystemTimer_Core0
          RteMappedToTaskRef = OsTask_Bsw5ms_Core0
      Os_OsCore2_swc_EcuSwComposition: RteSoftwareComponentInstanceRef=Os_OsCore2_swc
        OpEventGetCounterValue_GetCounterValue_OsService_SystemTimer_Core2 (RteEventToTaskMapping):
          RteImmediateRestart = false
          RtePositionInTask = 4
          RteEventRef = OpEventGetCounterValue_GetCounterValue_OsService_SystemTimer_Core2
          RteMappedToTaskRef = OsTask_App10ms_Core2
        OpEventGetElapsedValue_GetElapsedValue_OsService_SystemTimer_Core2 (RteEventToTaskMapping):
          RteImmediateRestart = false
          RtePositionInTask = 5
          RteEventRef = OpEventGetElapsedValue_GetElapsedValue_OsService_SystemTimer_Core2
          RteMappedToTaskRef = OsTask_App10ms_Core2
      Os_OsCore1_swc_EcuSwComposition: RteSoftwareComponentInstanceRef=Os_OsCore1_swc
        OpEventGetCounterValue_GetCounterValue_OsService_SystemTimer_Core1 (RteEventToTaskMapping):
          RteImmediateRestart = false
          RtePositionInTask = 2
          RteEventRef = OpEventGetCounterValue_GetCounterValue_OsService_SystemTimer_Core1
          RteMappedToTaskRef = OsTask_App10ms_Core1
        OpEventGetElapsedValue_GetElapsedValue_OsService_SystemTimer_Core1 (RteEventToTaskMapping):
          RteImmediateRestart = false
          RtePositionInTask = 3
          RteEventRef = OpEventGetElapsedValue_GetElapsedValue_OsService_SystemTimer_Core1
          RteMappedToTaskRef = OsTask_App10ms_Core1
      BswM_EcuSwComposition: RteSoftwareComponentInstanceRef=BswM
        Timer_BswM_MainFunction (RteEventToTaskMapping):
          RteImmediateRestart = false
          RtePositionInTask = 10
          RteEventRef = Timer_BswM_MainFunction
          RteMappedToTaskRef = OsTask_Bsw5ms_Core0
          RteUsedOsAlarmRef = Rte_Al_TE2_OsTask_Bsw5ms_Core0_0_5ms
          RteUsedOsEventRef = Rte_Ev_Cyclic2_OsTask_Bsw5ms_Core0_0_5ms
    6 x RteBswModuleInstance:
      Mcu: RteBswImplementationRef=Mcu_Impl, RteBswModuleConfigurationRef=Mcu
      Can: RteBswImplementationRef=Can_Impl, RteBswModuleConfigurationRef=Can
        3 x RteBswEventToTaskMapping, all with RteBswImmediateRestart=false, RteBswMappedToTaskRef=OsTask_Bsw5ms_Core0, RteBswUsedOsEventRef=Rte_Ev_Cyclic2_OsTask_Bsw5ms_Core0_0_10ms, RteBswUsedOsAlarmRef=Rte_Al_TE2_OsTask_Bsw5ms_Core0_0_10ms:
          Can_MainFunction_BusOffTimingEvent0: RteBswPositionInTask=1, RteBswEventRef=Can_MainFunction_BusOffTimingEvent0
          Can_MainFunction_WakeupTimingEvent0: RteBswPositionInTask=5, RteBswEventRef=Can_MainFunction_WakeupTimingEvent0
          Can_MainFunction_ModeTimingEvent0: RteBswPositionInTask=2, RteBswEventRef=Can_MainFunction_ModeTimingEvent0
        8 x RteBswExclusiveAreaImpl, all with RteExclusiveAreaImplMechanism=ALL_INTERRUPT_BLOCKING:
          CAN_EXCLUSIVE_AREA_{0..7}: RteBswExclusiveAreaRef=CAN_EXCLUSIVE_AREA_{0..7}
        Can_MainFunction_ReadTimingEvent0 (RteBswEventToTaskMapping):
          RteBswImmediateRestart = false
          RteBswPositionInTask = 3
          RteBswEventRef = Can_MainFunction_ReadTimingEvent0
          RteBswMappedToTaskRef = OsTask_Bsw5ms_Core0
          RteBswUsedOsEventRef = Rte_Ev_Cyclic2_OsTask_Bsw5ms_Core0_0_10ms
          RteBswUsedOsAlarmRef = Rte_Al_TE2_OsTask_Bsw5ms_Core0_0_10ms
        Can_MainFunction_WriteTimingEvent0 (RteBswEventToTaskMapping):
          RteBswImmediateRestart = false
          RteBswPositionInTask = 4
          RteBswEventRef = Can_MainFunction_WriteTimingEvent0
          RteBswMappedToTaskRef = OsTask_Bsw5ms_Core0
          RteBswUsedOsEventRef = Rte_Ev_Cyclic2_OsTask_Bsw5ms_Core0_0_10ms
          RteBswUsedOsAlarmRef = Rte_Al_TE2_OsTask_Bsw5ms_Core0_0_10ms
      CanIf: RteBswImplementationRef=CanIf_Impl, RteBswModuleConfigurationRef=CanIf
        8 x RteBswExclusiveAreaImpl, all with RteExclusiveAreaImplMechanism=ALL_INTERRUPT_BLOCKING:
          CANIF_EXCLUSIVE_AREA_{0..7}: RteBswExclusiveAreaRef=CANIF_EXCLUSIVE_AREA_{0..7}
      Com: RteBswImplementationRef=Com_Impl, RteBswModuleConfigurationRef=Com
        3 x RteBswExclusiveAreaImpl, all with RteExclusiveAreaImplMechanism=ALL_INTERRUPT_BLOCKING:
          COM_EXCLUSIVE_AREA_TX: RteBswExclusiveAreaRef=COM_EXCLUSIVE_AREA_TX
          COM_EXCLUSIVE_AREA_RX: RteBswExclusiveAreaRef=COM_EXCLUSIVE_AREA_RX
          COM_EXCLUSIVE_AREA_BOTH: RteBswExclusiveAreaRef=COM_EXCLUSIVE_AREA_BOTH
        Com_MainFunctionTxTimingEvent0 (RteBswEventToTaskMapping):
          RteBswImmediateRestart = false
          RteBswPositionInTask = 7
          RteBswEventRef = Com_MainFunctionTxTimingEvent0
          RteBswMappedToTaskRef = OsTask_Bsw5ms_Core0
          RteBswUsedOsEventRef = Rte_Ev_Cyclic2_OsTask_Bsw5ms_Core0_0_10ms
          RteBswUsedOsAlarmRef = Rte_Al_TE2_OsTask_Bsw5ms_Core0_0_10ms
        Com_MainFunctionRxTimingEvent0 (RteBswEventToTaskMapping):
          RteBswImmediateRestart = false
          RteBswPositionInTask = 6
          RteBswEventRef = Com_MainFunctionRxTimingEvent0
          RteBswMappedToTaskRef = OsTask_Bsw5ms_Core0
          RteBswUsedOsEventRef = Rte_Ev_Cyclic2_OsTask_Bsw5ms_Core0_0_10ms
          RteBswUsedOsAlarmRef = Rte_Al_TE2_OsTask_Bsw5ms_Core0_0_10ms
      PduR: RteBswImplementationRef=PduR_Impl, RteBswModuleConfigurationRef=PduR
        PDUR_EXCLUSIVE_AREA_0 (RteBswExclusiveAreaImpl): RteExclusiveAreaImplMechanism=ALL_INTERRUPT_BLOCKING, RteBswExclusiveAreaRef=PDUR_EXCLUSIVE_AREA_0
      CanSM: RteBswImplementationRef=CanSM_Impl, RteBswModuleConfigurationRef=CanSM
        CanSM_MainFunctionTimingEvent0 (RteBswEventToTaskMapping):
          RteBswImmediateRestart = false
          RteBswPositionInTask = 14
          RteBswEventRef = CanSM_MainFunctionTimingEvent0
          RteBswMappedToTaskRef = OsTask_Bsw5ms_Core0
          RteBswUsedOsEventRef = Rte_Ev_Cyclic2_OsTask_Bsw5ms_Core0_0_5ms
          RteBswUsedOsAlarmRef = Rte_Al_TE2_OsTask_Bsw5ms_Core0_0_5ms
        6 x RteBswExclusiveAreaImpl, all with RteExclusiveAreaImplMechanism=ALL_INTERRUPT_BLOCKING:
          CANSM_EXCLUSIVE_AREA_{1..6}: RteBswExclusiveAreaRef=CANSM_EXCLUSIVE_AREA_{1..6}
    ComM_EcuSwComposition (RteSwComponentInstance): RteSoftwareComponentInstanceRef=ComM
      13 x RteEventToTaskMapping, all with RteImmediateRestart=false:
        Timer_ComM_MainFunction_0: RtePositionInTask=13, RteEventRef=Timer_ComM_MainFunction_0, RteMappedToTaskRef=OsTask_Bsw5ms_Core0, RteUsedOsEventRef=Rte_Ev_Cyclic2_OsTask_Bsw5ms_Core0_0_20ms, RteUsedOsAlarmRef=Rte_Al_TE2_OsTask_Bsw5ms_Core0_0_20ms
        OpEventGetInhibitionStatus_GetInhibitionStatus_CL_CN_CAN00_5e566ad9: RteEventRef=OpEventGetInhibitionStatus_GetInhibitionStatus_CL_CN_CAN00_5e566ad9
        OpEventGetInhibitionStatus_GetInhibitionStatus_CW_CN_CAN00_5e566ad9: RteEventRef=OpEventGetInhibitionStatus_GetInhibitionStatus_CW_CN_CAN00_5e566ad9
        OpEventLimitECUToNoComMode_LimitECUToNoComMode_modeLimitation: RteEventRef=OpEventLimitECUToNoComMode_LimitECUToNoComMode_modeLimitation
        OpEventReadInhibitCounter_ReadInhibitCounter_modeLimitation: RteEventRef=OpEventReadInhibitCounter_ReadInhibitCounter_modeLimitation
        OpEventResetInhibitCounter_ResetInhibitCounter_modeLimitation: RteEventRef=OpEventResetInhibitCounter_ResetInhibitCounter_modeLimitation
        OpEventSetECUGroupClassification_SetECUGroupClassification_modeLimitation: RteEventRef=OpEventSetECUGroupClassification_SetECUGroupClassification_modeLimitation
        OpEventLimitChannelToNoComMode_LimitChannelToNoComMode_CL_CN_CAN00_5e566ad9: RteEventRef=OpEventLimitChannelToNoComMode_LimitChannelToNoComMode_CL_CN_CAN00_5e566ad9
        OpEventPreventWakeUp_PreventWakeUp_CW_CN_CAN00_5e566ad9: RteEventRef=OpEventPreventWakeUp_PreventWakeUp_CW_CN_CAN00_5e566ad9
        OpEventRequestComMode_RequestComMode_UR_ComMUser: RteEventRef=OpEventRequestComMode_RequestComMode_UR_ComMUser
        OpEventGetCurrentComMode_GetCurrentComMode_UR_ComMUser: RteEventRef=OpEventGetCurrentComMode_GetCurrentComMode_UR_ComMUser
        OpEventGetMaxComMode_GetMaxComMode_UR_ComMUser: RteEventRef=OpEventGetMaxComMode_GetMaxComMode_UR_ComMUser
        OpEventGetRequestedComMode_GetRequestedComMode_UR_ComMUser: RteEventRef=OpEventGetRequestedComMode_GetRequestedComMode_UR_ComMUser
    3 x RteBswModuleInstance:
      ComM: RteBswImplementationRef=ComM_Impl, RteBswModuleConfigurationRef=ComM
        ComM_MainFunction_0TimingEvent0 (RteBswEventToTaskMapping):
          RteBswImmediateRestart = false
          RteBswPositionInTask = 13
          RteBswEventRef = ComM_MainFunction_0TimingEvent0
          RteBswMappedToTaskRef = OsTask_Bsw5ms_Core0
          RteBswUsedOsEventRef = Rte_Ev_Cyclic2_OsTask_Bsw5ms_Core0_0_20ms
          RteBswUsedOsAlarmRef = Rte_Al_TE2_OsTask_Bsw5ms_Core0_0_20ms
        COMM_EXCLUSIVE_AREA_0 (RteBswExclusiveAreaImpl): RteExclusiveAreaImplMechanism=ALL_INTERRUPT_BLOCKING, RteBswExclusiveAreaRef=COMM_EXCLUSIVE_AREA_0
        COMM_EXCLUSIVE_AREA_1 (RteBswExclusiveAreaImpl): RteExclusiveAreaImplMechanism=ALL_INTERRUPT_BLOCKING, RteBswExclusiveAreaRef=COMM_EXCLUSIVE_AREA_1
      CanNm: RteBswImplementationRef=CanNm_Impl, RteBswModuleConfigurationRef=CanNm
        CanNm_MainFunctionTimingEvent0 (RteBswEventToTaskMapping):
          RteBswImmediateRestart = false
          RteBswPositionInTask = 16
          RteBswEventRef = CanNm_MainFunctionTimingEvent0
          RteBswMappedToTaskRef = OsTask_Bsw5ms_Core0
          RteBswUsedOsEventRef = Rte_Ev_Cyclic2_OsTask_Bsw5ms_Core0_0_10ms
          RteBswUsedOsAlarmRef = Rte_Al_TE2_OsTask_Bsw5ms_Core0_0_10ms
        7 x RteBswExclusiveAreaImpl, all with RteExclusiveAreaImplMechanism=ALL_INTERRUPT_BLOCKING:
          CANNM_EXCLUSIVE_AREA_{0..6}: RteBswExclusiveAreaRef=CANNM_EXCLUSIVE_AREA_{0..6}
      Nm: RteBswImplementationRef=Nm_Impl, RteBswModuleConfigurationRef=Nm
        NM_EXCLUSIVE_AREA_0 (RteBswExclusiveAreaImpl): RteExclusiveAreaImplMechanism=ALL_INTERRUPT_BLOCKING, RteBswExclusiveAreaRef=NM_EXCLUSIVE_AREA_0
        NM_EXCLUSIVE_AREA_1 (RteBswExclusiveAreaImpl): RteExclusiveAreaImplMechanism=ALL_INTERRUPT_BLOCKING, RteBswExclusiveAreaRef=NM_EXCLUSIVE_AREA_1
    lock (RteSwComponentType): RteComponentTypeRef=lock, RteImplementationRef=lock_Implementation
      ComponentTypeCalibration (RteComponentTypeCalibration): RteCalibrationSupportEnabled=false
    lock_EcuSwComposition (RteSwComponentInstance): RteSoftwareComponentInstanceRef=lock
      TMT_Runnable (RteEventToTaskMapping):
        RteImmediateRestart = false
        RtePositionInTask = 8
        RteEventRef = TMT_Runnable
        RteMappedToTaskRef = OsTask_Bsw5ms_Core0
        RteUsedOsEventRef = Rte_Ev_Run_lock_lock
        RteUsedOsAlarmRef = Rte_Al_TE_lock_lock
    Dio (RteBswModuleInstance): RteBswImplementationRef=Dio_Impl, RteBswModuleConfigurationRef=Dio
    Port (RteBswModuleInstance): RteBswImplementationRef=Port_Impl, RteBswModuleConfigurationRef=Port
