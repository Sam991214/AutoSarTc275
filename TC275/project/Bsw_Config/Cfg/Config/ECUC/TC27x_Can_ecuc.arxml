AUTOSAR XML (schema 00046)
package /ActiveEcuC
  module config Can: implementation-config-variant=VARIANT-PRE-COMPILE, module-description=Can_Impl
    CanConfigSet
      CT_CAN00_9df8a959 (CanController):
        CanControllerActivation = true
        CanBusoffProcessing = INTERRUPT
        CanControllerBaseAddress = 4026630656
        CanControllerId = 0
        CanRxProcessing = INTERRUPT
        CanTxProcessing = INTERRUPT
        CanWakeupProcessing = INTERRUPT
        CanWakeupSupport = false
        CanWakeupSourceId = 0
        CanPhysicalNode = Node0
        CanIOPort = b_001
        CanInterruptPriority = 10
        CanSRC = 0
        CanChannelCanObjectStartIndex = 0
        CanNumberOfCANObj = 7
        CanSrcTos = CPU0
        CanInterruptGroupPriority = 0
        CanClockFrequency = 80000000
        CanControllerDefaultBaudrate = CanControllerBaudrateConfig
        CanControllerSystemRef = CT_CAN00
        CanWakeupSourceRef = ECUM_WKSOURCE_KL15
        CanCpuClockRef = McuClockReferencePoint
        CanControllerBaudrateConfig:
          CanControllerBaudRate = 500
          CanControllerBaudRateConfigID = 0
          CanControllerPropSeg = 11
          CanControllerSeg1 = 4
          CanControllerSeg2 = 4
          CanControllerSyncJumpWidth = 1
          CanBaudrateClock = 80000
          CanBaudratePrescaler = 8
          CanBaudrateDiv8 = false
        CanFilterMask: CanFilterMaskValue=2047, CanFilterCodeValue=1024, IsLocked=false
        CanFilterMask_001 (CanFilterMask): CanFilterMaskValue=0, CanFilterCodeValue=0, IsLocked=false
      4 x CanHardwareObject, all with CanIdType=STANDARD, CanHwProcessing=false, CanMaxDataLen=8, CanFdPaddingValue=0, CanObjectMultiplexedTransmission=false, CanObjectHwFifo=false, CanControllerRef=CT_CAN00_9df8a959:
        CanHardwareObject_TX: CanHandleType=BASIC, CanIdValue=0, CanObjectId=1, CanObjectType=TRANSMIT, CanObjectHwSize=1, CanObjectHwHandle=1
        CanHardwareObject_RX: CanHandleType=BASIC, CanIdValue=1024, CanObjectId=3, CanObjectType=RECEIVE, CanObjectHwSize=2, CanObjectHwHandle=4, CanFilterMaskRef=CanFilterMask
        CanHardwareObject_APP_RX: CanHandleType=BASIC, CanIdValue=0, CanObjectId=2, CanObjectType=RECEIVE, CanObjectHwSize=2, CanObjectHwHandle=2, CanFilterMaskRef=CanFilterMask_001
        CanHardwareObject_msg_nm_TX_MyECU_oCAN00_720bbb34_Tx: CanHandleType=FULL, CanIdValue=1537, CanObjectId=0, CanObjectType=TRANSMIT, CanObjectHwSize=1, CanObjectHwHandle=0, CanCommonCANNode=A
    CanGeneral:
      CanIndex = 0
      CanChangeBaudrateApi = false
      CanDevErrorDetection = false
      CanHardwareCancellation = false
      CanIdenticalIdCancellation = false
      CanMainFunctionBusoffPeriod = 0.01
      CanMainFunctionModePeriod = 0.01
      CanMainFunctionWakeupPeriod = 0.01
      CanMultiplexedTransmission = true
      CanSetBaudrateApi = false
      CanTimeoutDuration = 0.01
      CanVersionInfoApi = false
      CanGenericPrecopy = false
      CanHardwareLoopCheck = true
      CanRxFullCANSupport = false
      CanTxFullCANSupport = true
      CanRxBasicCANSupport = true
      CanUseNestedCANInterrupts = false
      CanHardwareCancelByAppl = false
      CanIndividualProcessing = false
      CanGenericConfirmation = false
      CanGenericConfirmationAPI2 = false
      CanRxQueue = false
      CanSupportMixedID = false
      CanRxQueueSize = 10
      CanMultipleBasicCANObjects = true
      CanMultipleBasicCANTxObjects = true
      CanHardwareHandleType = UINT8
      CanOptimizeOneController = true
      CanInterruptCategory = CATEGORY2
      CanGetStatus = false
      CanInterruptLock = DRIVER
      CanWakeupSupport = false
      CanRamCheck = None
      CanOverrunNotification = None
      CanReinitStart = false
      CanGenericPreTransmit = false
      CanFdSupport = NONE
      CanRuntimeMeasurementSupport = false
      CanMaxRxDataLen = 8
      CanMaxTxDataLen = 8
      CanUsePeripheralAccessApi = false
      CanEnableMultipleCanDriver = false
      CanMaxNumberOfHwCANChannels = 4
      CanMaxNumberOfHwCANChannelsR = 0
      CanMaxNumberOfHwCANObj = 256
      CanMaxNumberOfHwCANObjR = 0
      CanClockDividerMode = NORMAL
      CanClockDivider = 1
      CanBaseAddress = 4026630144
      CanBaseAddressR = 0
      CanSrcAddress = 4026763520
      CanSrcAddressR = 0
      CanClockSourceSelection = Fclc
      CanFreezeDisable = false
      CanMirrorModeSupport = false
      CanUseOsInterruptControl = true
      CanRxHwFiFoFullNotification = false
      CanFdIsoSupport = false
      CanFdNiso = false
      CanFdPed = false
      CanSafeBswChecks = false
      CanSilentModeSupport = false
      CanHwTxFifoSupport = false
      CanCheckWakeupCanRetType = false
      CanFdHardwareBufferOptimization = false
      CanCounterRef = SystemTimer_Core0
      CanMainFunctionRWPeriods: CanMainFunctionReadPeriod=0.01, CanMainFunctionWritePeriod=0.01
