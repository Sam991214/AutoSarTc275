AUTOSAR XML (schema 00046)
package /ActiveEcuC
  module config vLinkGen: implementation-config-variant=VARIANT-PRE-COMPILE, module-description=vLinkGen_Impl
    vLinkGenMemLayout
      MemRegion_DSPR_Core0 (vLinkGenLinkerMemoryRegion): vLinkGenMemoryRegionAddrOffset=0, vLinkGenMemoryRegionSize=114688, vLinkGenMemoryRegionHwRegion=DSPR0
        RegionBlock_0_DSPR_Core0 (vLinkGenMemoryRegionBlock):
          vLinkGenMemoryRegionBlockInitCore = 0
          vLinkGenMemoryRegionBlockPosition = 0
          vLinkGenMemoryRegionBlockSize = 114688
          vLinkGenMemoryRegionBlockBoundary = LOWER
          vLinkGenMemoryRegionBlockInitPolicy = NONE
      MemRegion_PFlash0_Cached (vLinkGenLinkerMemoryRegion): vLinkGenMemoryRegionAddrOffset=24576, vLinkGenMemoryRegionSize=2072576, vLinkGenMemoryRegionHwRegion=PFlash0_Cached
        RegionBlock_0_PFlash0_Cached (vLinkGenMemoryRegionBlock):
          vLinkGenMemoryRegionBlockSize = 2072576
          vLinkGenMemoryRegionBlockPosition = 0
          vLinkGenMemoryRegionBlockBoundary = LOWER
          vLinkGenMemoryRegionBlockInitPolicy = NONE
      8 x vLinkGenLinkerSectionConstGroup, all with vLinkGenConstGroupPosition=0, vLinkGenConstGroupGapSize=0, vLinkGenConstGroupHwRegion=RegionBlock_PFlash0_NonCached:
        OS_CODE: vLinkGenConstGroupAlignment=4
          OS_CODE (vLinkGenConstGroupCodeSection):
            vLinkGenCodeSectionPosition = 0
            vLinkGenCodeSectionCachePolicyCache = false
            vLinkGenCodeSectionCachePolicyNoCache = false
            vLinkGenCodeSectionAddressingModeNear = false
            vLinkGenCodeSectionAddressingModeFar = true
            vLinkGenCodeSectionFlagNoLoad = false
            vLinkGenCodeSectionFlagKeep = false
            vLinkGenCodeSectionRef = OS_OS_COREINITHOOK_CODE
            vLinkGenCodeSectionRef = vLinkGenLinkerSections/OS_CODE
        OS_INTVEC_CODE: vLinkGenConstGroupAlignment=32
          OS_INTVEC_CODE (vLinkGenConstGroupCodeSection):
            vLinkGenCodeSectionPosition = 0
            vLinkGenCodeSectionCachePolicyCache = false
            vLinkGenCodeSectionCachePolicyNoCache = false
            vLinkGenCodeSectionAddressingModeNear = false
            vLinkGenCodeSectionAddressingModeFar = true
            vLinkGenCodeSectionFlagNoLoad = false
            vLinkGenCodeSectionFlagKeep = false
            vLinkGenCodeSectionRef = vLinkGenLinkerSections/OS_INTVEC_CODE
        OS_INTVEC_CORE0_CODE: vLinkGenConstGroupAlignment=32
          OS_INTVEC_CORE0_CODE (vLinkGenConstGroupCodeSection):
            vLinkGenCodeSectionPosition = 0
            vLinkGenCodeSectionCachePolicyCache = false
            vLinkGenCodeSectionCachePolicyNoCache = false
            vLinkGenCodeSectionAddressingModeNear = false
            vLinkGenCodeSectionAddressingModeFar = true
            vLinkGenCodeSectionFlagNoLoad = false
            vLinkGenCodeSectionFlagKeep = false
            vLinkGenCodeSectionRef = vLinkGenLinkerSections/OS_INTVEC_CORE0_CODE
        OS_EXCVEC_CORE0_CODE: vLinkGenConstGroupAlignment=32
          OS_EXCVEC_CORE0_CODE (vLinkGenConstGroupCodeSection):
            vLinkGenCodeSectionPosition = 0
            vLinkGenCodeSectionCachePolicyCache = false
            vLinkGenCodeSectionCachePolicyNoCache = false
            vLinkGenCodeSectionAddressingModeNear = false
            vLinkGenCodeSectionAddressingModeFar = true
            vLinkGenCodeSectionFlagNoLoad = false
            vLinkGenCodeSectionFlagKeep = false
            vLinkGenCodeSectionRef = vLinkGenLinkerSections/OS_EXCVEC_CORE0_CODE
        OS_CONST: vLinkGenConstGroupAlignment=4
          OS_CONST (vLinkGenConstGroupConstSection):
            vLinkGenConstSectionPosition = 0
            vLinkGenConstSectionCachePolicyCache = false
            vLinkGenConstSectionCachePolicyNoCache = false
            vLinkGenConstSectionAddressingModeNear = true
            vLinkGenConstSectionAddressingModeFar = true
            vLinkGenConstSectionFlagNoLoad = false
            vLinkGenConstSectionFlagKeep = false
            vLinkGenConstSectionRef = OS_SystemApplication_OsCore2_CONST
            vLinkGenConstSectionRef = OS_SystemApplication_OsCore1_CONST
            vLinkGenConstSectionRef = OS_SystemApplication_OsCore0_CONST
            vLinkGenConstSectionRef = OS_CORE2_CONST
            vLinkGenConstSectionRef = OS_CORE1_CONST
            vLinkGenConstSectionRef = OS_CORE0_CONST
            vLinkGenConstSectionRef = OS_GLOBALSHARED_CONST
            vLinkGenConstSectionRef = vLinkGenLinkerSections/OS_INTVEC_CONST
            vLinkGenConstSectionRef = vLinkGenLinkerSections/OS_CONST
        OS_INTVEC_CONST: vLinkGenConstGroupAlignment=8192
        OS_INTVEC_CORE0_CONST: vLinkGenConstGroupAlignment=32
          OS_INTVEC_CORE0_CONST (vLinkGenConstGroupConstSection):
            vLinkGenConstSectionPosition = 0
            vLinkGenConstSectionCachePolicyCache = false
            vLinkGenConstSectionCachePolicyNoCache = false
            vLinkGenConstSectionAddressingModeNear = true
            vLinkGenConstSectionAddressingModeFar = true
            vLinkGenConstSectionFlagNoLoad = false
            vLinkGenConstSectionFlagKeep = false
            vLinkGenConstSectionRef = vLinkGenLinkerSections/OS_INTVEC_CORE0_CONST
        OS_EXCVEC_CORE0_CONST: vLinkGenConstGroupAlignment=32
          OS_EXCVEC_CORE0_CONST (vLinkGenConstGroupConstSection):
            vLinkGenConstSectionPosition = 0
            vLinkGenConstSectionCachePolicyCache = false
            vLinkGenConstSectionCachePolicyNoCache = false
            vLinkGenConstSectionAddressingModeNear = true
            vLinkGenConstSectionAddressingModeFar = true
            vLinkGenConstSectionFlagNoLoad = false
            vLinkGenConstSectionFlagKeep = false
            vLinkGenConstSectionRef = vLinkGenLinkerSections/OS_EXCVEC_CORE0_CONST
      3 x vLinkGenLinkerSectionVarGroup, all with vLinkGenVarGroupAlignment=4, vLinkGenVarGroupPosition=0, vLinkGenVarGroupGapSize=0, vLinkGenVarGroupHwRegion=RegionBlock_0_DSPR_Core0:
        OS_STACKS_CORE0: vLinkGenVarGroupInitPolicy=NONE
          OS_STACKS_CORE0 (vLinkGenVarGroupStackSection):
            vLinkGenStackSectionPosition = 0
            vLinkGenStackSectionInitPolicyInit = false
            vLinkGenStackSectionInitPolicyNoInit = true
            vLinkGenStackSectionInitPolicyZeroInit = false
            vLinkGenStackSectionCachePolicyCache = false
            vLinkGenStackSectionCachePolicyNoCache = false
            vLinkGenStackSectionAddressingModeNear = false
            vLinkGenStackSectionAddressingModeFar = true
            vLinkGenStackSectionFlagNoLoad = false
            vLinkGenStackSectionFlagKeep = false
            vLinkGenStackSectionRef = OS_STACK_OSCORE0_TASK_PRIO4294967295_VAR
            vLinkGenStackSectionRef = OS_STACK_OSCORE0_ISR_CORE_VAR
            vLinkGenStackSectionRef = OS_STACK_OSCORE0_KERNEL_VAR
            vLinkGenStackSectionRef = OS_STACK_OSCORE0_INIT_VAR
            vLinkGenStackSectionRef = OS_STACK_OSCORE0_ERROR_VAR
            vLinkGenStackSectionRef = OS_STACK_OSTASK_BSW5MS_CORE0_VAR
            vLinkGenStackSectionRef = OS_STACK_OSCORE0_TASK_PRIO30_VAR
            vLinkGenStackSectionRef = OS_STACK_OSCORE0_SHUTDOWN_VAR
            vLinkGenStackSectionRef = OS_STACK_OSCORE0_STARTUP_VAR
        OS_DATA_CORE0: vLinkGenVarGroupInitPolicy=ALWAYS, vLinkGenVarGroupInitCore=0, vLinkGenVarGroupInitDataHwRegion=RegionBlock_PFlash0_NonCached
          OS_DATA_CORE0 (vLinkGenVarGroupVarSection):
            vLinkGenVarSectionPosition = 0
            vLinkGenVarSectionInitPolicyInit = false
            vLinkGenVarSectionInitPolicyNoInit = true
            vLinkGenVarSectionInitPolicyZeroInit = false
            vLinkGenVarSectionCachePolicyCache = true
            vLinkGenVarSectionCachePolicyNoCache = true
            vLinkGenVarSectionAddressingModeNear = false
            vLinkGenVarSectionAddressingModeFar = true
            vLinkGenVarSectionFlagNoLoad = false
            vLinkGenVarSectionFlagKeep = false
            vLinkGenVarSectionRef = OS_SystemApplication_OsCore0_VAR
            vLinkGenVarSectionRef = OS_CORE0_VAR
        OS_DATA_SHARED: vLinkGenVarGroupInitPolicy=ALWAYS, vLinkGenVarGroupInitCore=0, vLinkGenVarGroupInitDataHwRegion=RegionBlock_PFlash0_NonCached
          OS_DATA_SHARED (vLinkGenVarGroupVarSection):
            vLinkGenVarSectionPosition = 0
            vLinkGenVarSectionInitPolicyInit = true
            vLinkGenVarSectionInitPolicyNoInit = false
            vLinkGenVarSectionInitPolicyZeroInit = false
            vLinkGenVarSectionCachePolicyCache = true
            vLinkGenVarSectionCachePolicyNoCache = false
            vLinkGenVarSectionAddressingModeNear = false
            vLinkGenVarSectionAddressingModeFar = true
            vLinkGenVarSectionFlagNoLoad = false
            vLinkGenVarSectionFlagKeep = false
            vLinkGenVarSectionRef = OS_BARRIER_CORE2_VAR
            vLinkGenVarSectionRef = OS_PUBLIC_CORE2_VAR
            vLinkGenVarSectionRef = OS_CORESTATUS_CORE2_VAR
            vLinkGenVarSectionRef = OS_BARRIER_CORE1_VAR
            vLinkGenVarSectionRef = OS_PUBLIC_CORE1_VAR
            vLinkGenVarSectionRef = OS_CORESTATUS_CORE1_VAR
            vLinkGenVarSectionRef = OS_BARRIER_CORE0_VAR
            vLinkGenVarSectionRef = OS_PUBLIC_CORE0_VAR
            vLinkGenVarSectionRef = OS_CORESTATUS_CORE0_VAR
            vLinkGenVarSectionRef = OS_GLOBALSHARED_VAR
            vLinkGenVarSectionRef = OS_VAR
      7 x vLinkGenLinkerMemoryRegion:
        MemRegion_BMHD0: vLinkGenMemoryRegionAddrOffset=0, vLinkGenMemoryRegionSize=32, vLinkGenMemoryRegionHwRegion=BMHD0
          RegionBlock_BMHD0 (vLinkGenMemoryRegionBlock):
            vLinkGenMemoryRegionBlockPosition = 0
            vLinkGenMemoryRegionBlockSize = 32
            vLinkGenMemoryRegionBlockBoundary = LOWER
            vLinkGenMemoryRegionBlockInitPolicy = NONE
        MemRegion_BMHD1: vLinkGenMemoryRegionAddrOffset=0, vLinkGenMemoryRegionSize=32, vLinkGenMemoryRegionHwRegion=BMHD1
          RegionBlock_BMHD1 (vLinkGenMemoryRegionBlock):
            vLinkGenMemoryRegionBlockPosition = 0
            vLinkGenMemoryRegionBlockSize = 32
            vLinkGenMemoryRegionBlockBoundary = LOWER
            vLinkGenMemoryRegionBlockInitPolicy = NONE
        MemRegion_BMHD2: vLinkGenMemoryRegionAddrOffset=0, vLinkGenMemoryRegionSize=32, vLinkGenMemoryRegionHwRegion=BMHD2
          RegionBlock_BMHD2 (vLinkGenMemoryRegionBlock):
            vLinkGenMemoryRegionBlockPosition = 0
            vLinkGenMemoryRegionBlockSize = 32
            vLinkGenMemoryRegionBlockBoundary = LOWER
            vLinkGenMemoryRegionBlockInitPolicy = NONE
        MemRegion_BMHD3: vLinkGenMemoryRegionSize=32, vLinkGenMemoryRegionAddrOffset=0, vLinkGenMemoryRegionHwRegion=BMHD3
          RegionBlock_BMHD3 (vLinkGenMemoryRegionBlock):
            vLinkGenMemoryRegionBlockPosition = 0
            vLinkGenMemoryRegionBlockSize = 32
            vLinkGenMemoryRegionBlockBoundary = LOWER
            vLinkGenMemoryRegionBlockInitPolicy = NONE
        MemRegion_PSPR_Core0: vLinkGenMemoryRegionAddrOffset=0, vLinkGenMemoryRegionSize=8192, vLinkGenMemoryRegionHwRegion=PSPR0
          RegionBlock_0_PSPR_Core0 (vLinkGenMemoryRegionBlock):
            vLinkGenMemoryRegionBlockInitCore = 0
            vLinkGenMemoryRegionBlockPosition = 0
            vLinkGenMemoryRegionBlockSize = 8192
            vLinkGenMemoryRegionBlockBoundary = LOWER
            vLinkGenMemoryRegionBlockInitPolicy = NONE
        MemRegion_PFlash0_NonCached: vLinkGenMemoryRegionAddrOffset=24576, vLinkGenMemoryRegionSize=2072576, vLinkGenMemoryRegionHwRegion=PFlash0_NonCached
          RegionBlock_PFlash0_NonCached (vLinkGenMemoryRegionBlock):
            vLinkGenMemoryRegionBlockSize = 2072576
            vLinkGenMemoryRegionBlockPosition = 0
            vLinkGenMemoryRegionBlockBoundary = LOWER
            vLinkGenMemoryRegionBlockInitPolicy = NONE
        MemRegion_Startup: vLinkGenMemoryRegionSize=32, vLinkGenMemoryRegionAddrOffset=0, vLinkGenMemoryRegionHwRegion=STARTUP
          RegionBlock_Startup (vLinkGenMemoryRegionBlock):
            vLinkGenMemoryRegionBlockPosition = 0
            vLinkGenMemoryRegionBlockSize = 32
            vLinkGenMemoryRegionBlockBoundary = LOWER
            vLinkGenMemoryRegionBlockInitPolicy = NONE
      ARCH (vLinkGenLinkerSectionUserGroup): vLinkGenUserGroupPlacement=PRE, vLinkGenUserGroupPosition=0
        4 x vLinkGenUserGroupUserSection:
          ARCH: vLinkGenUserGroupUserSectionPosition=0, vLinkGenUserGroupUserSectionValue=architecture TC { endianness { little; } space linear { id = 1; mau = 8; map (src_offset=0x00000000, dest_offset=0x00000000, size=4G, dest=bus:fpi_bus); } space abs24 { id = 2; mau = 8; map (src_offset=0x00000000, dest_offset=0x00000000, size=2M, dest=space:linear); map (src_offset=0x10000000, dest_offset=0x10000000, size=2M, dest=space:linear); map (src_offset=0x20000000, dest_offset=0x20000000, size=2M, dest=space:linear); map (src_offset=0x30000000, dest_offset=0x30000000, size=2M, dest=space:linear); map (src_offset=0x40000000, dest_offset=0x40000000, size=2M, dest=space:linear); map (src_offset=0x50000000, dest_offset=0x50000000, size=2M, dest=space:linear); map (src_offset=0x60000000, dest_offset=0x60000000, size=2M, dest=space:linear); map (src_offset=0x70000000, dest_offset=0x70000000, size=2M, dest=space:linear); map (src_offset=0x80000000, dest_offset=0x80000000, size=2M, dest=space:linear); map (src_offset=0x90000000, dest_offset=0x90000000, size=2M, dest=space:linear); map (src_offset=0xa0000000, dest_offset=0xa0000000, size=2M, dest=space:linear); map (src_offset=0xb0000000, dest_offset=0xb0000000, size=2M, dest=space:linear); map (src_offset=0xc0000000, dest_offset=0xc0000000, size=2M, dest=space:linear); map (src_offset=0xd0000000, dest_offset=0xd0000000, size=2M, dest=space:linear); map (src_offset=0xe0000000, dest_offset=0xe0000000, size=2M, dest=space:linear); map (src_offset=0xf0000000, dest_offset=0xf0000000, size=2M, dest=space:linear); } space abs18 { id = 3; mau = 8; map (src_offset=0x00000000, dest_offset=0x00000000, size=16k, dest=space:linear); map (src_offset=0x10000000, dest_offset=0x10000000, size=16k, dest=space:linear); map (src_offset=0x20000000, dest_offset=0x20000000, size=16k, dest=space:linear); map (src_offset=0x30000000, dest_offset=0x30000000, size=16k, dest=space:linear); map (src_offset=0x40000000, dest_offset=0x40000000, size=16k, dest=space:linear); map (src_offset=0x50000000, dest_offset=0x50000000, size=16k, dest=space:linear); map (src_offset=0x60000000, dest_offset=0x60000000, size=16k, dest=space:linear); map (src_offset=0x70000000, dest_offset=0x70000000, size=16k, dest=space:linear); map (src_offset=0x80000000, dest_offset=0x80000000, size=16k, dest=space:linear); map (src_offset=0x90000000, dest_offset=0x90000000, size=16k, dest=space:linear); map (src_offset=0xa0000000, dest_offset=0xa0000000, size=16k, dest=space:linear); map (src_offset=0xb0000000, dest_offset=0xb0000000, size=16k, dest=space:linear); map (src_offset=0xc0000000, dest_offset=0xc0000000, size=16k, dest=space:linear); map (src_offset=0xd0000000, dest_offset=0xd0000000, size=16k, dest=space:linear); map (src_offset=0xe0000000, dest_offset=0xe0000000, size=16k, dest=space:linear); map (src_offset=0xf0000000, dest_offset=0xf0000000, size=16k, dest=space:linear); } space csa { id = 4; mau = 8; // // CSA area should be mapped on dsprn map (src_offset=0xd0000000, dest_offset=0xd0000000, size=4M, dest=space:linear); } bus fpi_bus { mau = 8; width = 32; } } architecture TC1V1.6.X extends TC { } processor mpe { derivative = tc27x; } #define DF_EEPROM_SIZE 384k #define DF_UCB_SIZE 16k #define DF_EEPROM_ADDR 0xaf000000 #define DF_UCB_ADDR 0xaf100000 derivative tc27x { core tc0 { architecture = TC1V1.6.X; space_id_offset = 100; // add 100 to all space IDs in the architecture definition copytable_space = vtc:linear; // use the copy table in the virtual core for 'bss' and initialized data sections } core tc1 { architecture = TC1V1.6.X; space_id_offset = 200; // add 100 to all space IDs in the architecture definition copytable_space = vtc:linear; // use the copy table in the virtual core for 'bss' and initialized data sections } core tc2 { architecture = TC1V1.6.X; space_id_offset = 300; // add 100 to all space IDs in the architecture definition copytable_space = vtc:linear; // use the copy table in the virtual core for 'bss' and initialized data sections } core vtc { architecture = TC1V1.6.X; import tc0; // add all address spaces of core tc0 to core vtc for linking and locating import tc1; // add all address spaces of core tc0 to core vtc for linking and locating import tc2; // add all address spaces of core tc0 to core vtc for linking and locating } bus sri { mau = 8; width = 32; // map shared addresses one-to-one to real cores and virtual cores map (dest=bus:tc0:fpi_bus, src_offset=0, dest_offset=0, size=0x50000000 + 0*0x10000000); map (dest=bus:tc1:fpi_bus, src_offset=0, dest_offset=0, size=0x50000000 + 0*0x10000000); map (dest=bus:tc2:fpi_bus, src_offset=0, dest_offset=0, size=0x50000000 + 0*0x10000000); map (dest=bus:vtc:fpi_bus, src_offset=0, dest_offset=0, size=0x50000000 + 0*0x10000000); // map shared addresses one-to-one to real cores and virtual cores map (dest=bus:tc0:fpi_bus, src_offset=0x80000000, dest_offset=0x80000000, size=0x40000000); map (dest=bus:tc1:fpi_bus, src_offset=0x80000000, dest_offset=0x80000000, size=0x40000000); map (dest=bus:tc2:fpi_bus, src_offset=0x80000000, dest_offset=0x80000000, size=0x40000000); map (dest=bus:vtc:fpi_bus, src_offset=0x80000000, dest_offset=0x80000000, size=0x40000000); // map shared addresses one-to-one to real cores and virtual map (dest=bus:tc0:fpi_bus, src_offset=0xe0000000, dest_offset=0xe0000000, size=0x20000000); map (dest=bus:tc1:fpi_bus, src_offset=0xe0000000, dest_offset=0xe0000000, size=0x20000000); map (dest=bus:tc2:fpi_bus, src_offset=0xe0000000, dest_offset=0xe0000000, size=0x20000000); map (dest=bus:vtc:fpi_bus, src_offset=0xe0000000, dest_offset=0xe0000000, size=0x20000000); // map local memory map (dest=bus:tc0:fpi_bus, src_offset=0x70000000, dest_offset=0x70000000, size=0x00100000, priority=1, exec_priority=0); map (dest=bus:tc1:fpi_bus, src_offset=0x60000000, dest_offset=0x60000000, size=0x00100000, priority=1, exec_priority=0); map (dest=bus:tc2:fpi_bus, src_offset=0x50000000, dest_offset=0x50000000, size=0x00100000, priority=1, exec_priority=0); map (dest=bus:tc0:fpi_bus, src_offset=0x70100000, dest_offset=0x70100000, size=0x10000000-0x00100000, exec_priority=1); map (dest=bus:tc1:fpi_bus, src_offset=0x60100000, dest_offset=0x60100000, size=0x10000000-0x00100000, exec_priority=1); map (dest=bus:tc2:fpi_bus, src_offset=0x50100000, dest_offset=0x50100000, size=0x10000000-0x00100000, exec_priority=1); map (dest=bus:vtc:fpi_bus, src_offset=0x50000000 + 0*0x10000000, dest_offset=0x50000000 + 0*0x10000000, size=3*0x10000000); map (dest=bus:tc0:fpi_bus, src_offset=0x60000000, dest_offset=0x60000000, size=0x10000000); map (dest=bus:tc0:fpi_bus, src_offset=0x50000000, dest_offset=0x50000000, size=0x10000000); map (dest=bus:tc1:fpi_bus, src_offset=0x70000000, dest_offset=0x70000000, size=0x10000000); map (dest=bus:tc1:fpi_bus, src_offset=0x50000000, dest_offset=0x50000000, size=0x10000000); map (dest=bus:tc2:fpi_bus, src_offset=0x70000000, dest_offset=0x70000000, size=0x10000000); map (dest=bus:tc2:fpi_bus, src_offset=0x60000000, dest_offset=0x60000000, size=0x10000000); } section_setup :vtc:linear { copytable ( align = 4, dest = linear, table { symbol = "_lc_ub_table"; space = :tc0:linear,:tc0:abs18; } , table { symbol = "_lc_ub_table_tc1"; space = :tc1:linear,:tc1:abs18; } , table { symbol = "_lc_ub_table_tc2"; space = :tc2:linear, :tc2:abs18; } ); start_address ( run_addr = (0xA0000020), symbol = "brsStartupEntry" ); }
          MEMORYDEF: vLinkGenUserGroupUserSectionPosition=1, vLinkGenUserGroupUserSectionValue=memory dspr0 // Data Scratch Pad Ram { mau = 8; size = 112k; type = ram; map (dest=bus:tc0:fpi_bus, dest_offset=0xd0000000, size=112k, priority=1, exec_priority=0); map (dest=bus:sri, dest_offset=0x70000000, size=112k); } memory pspr0 // Program Scratch Pad Ram { mau = 8; size = 24k; type = ram; map (dest=bus:tc0:fpi_bus, dest_offset=0xc0000000, size=24k, exec_priority=1); map (dest=bus:sri, dest_offset=0x70100000, size=24k); } memory dspr1 // Data Scratch Pad Ram { mau = 8; size = 120k; type = ram; map (dest=bus:tc1:fpi_bus, dest_offset=0xd0000000, size=120k, priority=1, exec_priority=0); map (dest=bus:sri, dest_offset=0x60000000, size=120k); } memory pspr1 // Program Scratch Pad Ram { mau = 8; size = 32k; type = ram; map (dest=bus:tc1:fpi_bus, dest_offset=0xc0000000, size=32k, exec_priority=1); map (dest=bus:sri, dest_offset=0x60100000, size=32k); } memory dspr2 // Data Scratch Pad Ram { mau = 8; size = 120k; type = ram; map (dest=bus:tc2:fpi_bus, dest_offset=0xd0000000, size=120k, priority=1, exec_priority=0); map (dest=bus:sri, dest_offset=0x50000000, size=120k); } memory pspr2 // Program Scratch Pad Ram { mau = 8; size = 32k; type = ram; map (dest=bus:tc2:fpi_bus, dest_offset=0xc0000000, size=32k, exec_priority=1); map (dest=bus:sri, dest_offset=0x50100000, size=32k); } memory pflash0 { mau = 8; size = 2M; type = rom; map cached (dest=bus:sri, dest_offset=0x80000000, size=2M); map not_cached (dest=bus:sri, dest_offset=0xa0000000, reserved, size=2M); } memory pflash1 { mau = 8; size = 2M; type = rom; map cached (dest=bus:sri, dest_offset=0x80200000, size=2M); map not_cached (dest=bus:sri, dest_offset=0xa0200000, reserved, size=2M); } memory brom { mau = 8; size = 32k; type = reserved rom; map cached (dest=bus:sri, dest_offset=0x8fff8000, size=32k); map not_cached (dest=bus:sri, dest_offset=0xafff8000, reserved, size=32k); } memory dflash0 { mau = 8; size = DF_EEPROM_SIZE + DF_UCB_SIZE; type = reserved nvram; map (dest=bus:sri, src_offset=0, dest_offset=DF_EEPROM_ADDR, size=DF_EEPROM_SIZE); map (dest=bus:sri, src_offset=DF_EEPROM_SIZE, dest_offset=DF_UCB_ADDR, size=DF_UCB_SIZE); } memory dflash1 { mau = 8; size = 64k; type = reserved nvram; map (dest=bus:sri, dest_offset=0xaf110000, size=64k); } memory lmuram { mau = 8; size = 32k; type = ram; priority = 2; map cached (dest=bus:sri, dest_offset=0x90000000, size=32k); map not_cached (dest=bus:sri, dest_offset=0xb0000000, reserved, size=32k); } }
          TRAPTAB: vLinkGenUserGroupUserSectionPosition=2, vLinkGenUserGroupUserSectionValue=#ifndef INTTAB #define INTTAB 0xa00f0000 /* start address of interrupt table */ #endif #ifndef TRAPTAB #define TRAPTAB (INTTAB + 0x6000) /* start address of trap table */ #endif #ifndef TRAPTAB0 #define TRAPTAB0 (TRAPTAB) #endif #ifndef TRAPTAB1 #define TRAPTAB1 (TRAPTAB0 + 0x100) #endif #ifndef TRAPTAB2 #define TRAPTAB2 (TRAPTAB1 + 0x100) #endif section_layout :vtc:linear { "_lc_u_trap_tab_tc0" = (TRAPTAB0); "_lc_u_trap_tab_tc1" = (TRAPTAB1); "_lc_u_trap_tab_tc2" = (TRAPTAB2); "_lc_u_trap_tab" = "_lc_u_trap_tab_tc0"; /* common cstart interface for first or single core */ // trapvector tables group trap_tab_tc0 (ordered) { #include "traptab0.lsl" } group trap_tab_tc1 (ordered) { #include "traptab1.lsl" } group trap_tab_tc2 (ordered) { #include "traptab2.lsl" } }
          INTTAB: vLinkGenUserGroupUserSectionPosition=3, vLinkGenUserGroupUserSectionValue=#ifndef CSA_START_TC0 #define CSA_START_TC0 0xd0004000 /* start address of CSA tc0 */ #endif #ifndef CSA_START_TC1 #define CSA_START_TC1 0xd0004000 /* start address of CSA tc1 */ #endif #ifndef CSA_START_TC2 #define CSA_START_TC2 0xd0004000 /* start address of CSA tc2 */ #endif #ifndef CSA_TC0 #define CSA_TC0 64 /* number of context blocks tc0 */ #endif #ifndef CSA_TC1 #define CSA_TC1 64 /* number of context blocks tc1 */ #endif #ifndef CSA_TC2 #define CSA_TC2 64 /* number of context blocks tc2 */ #endif #ifndef INTTAB0 #define INTTAB0 (INTTAB) #endif #ifndef INTTAB1 #define INTTAB1 (INTTAB0 + 0x2000) #endif #ifndef INTTAB2 #define INTTAB2 (INTTAB1 + 0x2000) #endif section_layout :vtc:linear { "_lc_u_int_tab_tc0" = (INTTAB0); "_lc_u_int_tab_tc1" = (INTTAB1); "_lc_u_int_tab_tc2" = (INTTAB2); "_lc_u_int_tab" = "_lc_u_int_tab_tc0"; /* common cstart interface for first or single core */ // interrupt vector tables group int_tab_tc0 (ordered) { #include "inttab0.lsl" } group int_tab_tc1 (ordered) { #include "inttab1.lsl" } group int_tab_tc2 (ordered) { #include "inttab2.lsl" } } section_layout :tc0:csa { group (ordered, align = 64, attributes=rw, run_addr=(CSA_START_TC0)) reserved "csa_tc0" (size = 64 * (CSA_TC0)); "_lc_ub_csa_01" := "_lc_ub_csa_tc0"; /* common cstart interface for first or single core */ "_lc_ue_csa_01" := "_lc_ue_csa_tc0"; /* common cstart interface for first or single core */ } section_layout :tc1:csa { group (ordered, align = 64, attributes=rw, run_addr=(CSA_START_TC1)) reserved "csa_tc1" (size = 64 * (CSA_TC1)); } section_layout :tc2:csa { group (ordered, align = 64, attributes=rw, run_addr=(CSA_START_TC2)) reserved "csa_tc2" (size = 64 * (CSA_TC2)); } section_layout :tc0:linear { "_lc_ue_ustack" := "_lc_ue_ustack_tc0"; /* common cstart interface for first or single core */ "_lc_ue_istack" := "_lc_ue_istack_tc0"; /* common cstart interface for first or single core */ }
      csa_tc0 (vLinkGenLinkerSectionVarGroup):
        vLinkGenVarGroupAlignment = 64
        vLinkGenVarGroupPosition = 0
        vLinkGenVarGroupInitPolicy = NONE
        vLinkGenVarGroupGapSize = 0
        vLinkGenVarGroupHwRegion = RegionBlock_0_DSPR_Core0
        csa_tc0 (vLinkGenVarGroupUserSection): vLinkGenVarGroupUserSectionPosition=0, vLinkGenVarGroupUserSectionValue=reserved "csa_tc0" (size = 64 * 64);
      istack_tc0 (vLinkGenLinkerSectionVarGroup):
        vLinkGenVarGroupAlignment = 4
        vLinkGenVarGroupPosition = 0
        vLinkGenVarGroupInitPolicy = NONE
        vLinkGenVarGroupGapSize = 32
        vLinkGenVarGroupInitCore = 0
        vLinkGenVarGroupHwRegion = RegionBlock_0_DSPR_Core0
        vLinkGenVarGroupStackSection:
          vLinkGenStackSectionPosition = 0
          vLinkGenStackSectionInitPolicyInit = false
          vLinkGenStackSectionInitPolicyNoInit = false
          vLinkGenStackSectionInitPolicyZeroInit = true
          vLinkGenStackSectionCachePolicyCache = false
          vLinkGenStackSectionCachePolicyNoCache = false
          vLinkGenStackSectionAddressingModeNear = false
          vLinkGenStackSectionAddressingModeFar = true
          vLinkGenStackSectionFlagNoLoad = false
          vLinkGenStackSectionFlagKeep = false
          vLinkGenStackSectionRef = LinkerStackSection_istack_tc0
        vLinkGenVarGroupUserSection: vLinkGenVarGroupUserSectionPosition=0, vLinkGenVarGroupUserSectionValue=reserved "istack_tc0" (size = 1024);
      Code_Default (vLinkGenLinkerSectionConstGroup): vLinkGenConstGroupAlignment=8, vLinkGenConstGroupPosition=0, vLinkGenConstGroupGapSize=0, vLinkGenConstGroupHwRegion=RegionBlock_PFlash0_NonCached
        OS_ERRORHOOK_CODE (vLinkGenConstGroupCodeSection):
          vLinkGenCodeSectionAddressingModeNear = false
          vLinkGenCodeSectionCachePolicyCache = false
          vLinkGenCodeSectionCachePolicyNoCache = false
          vLinkGenCodeSectionPosition = 0
          vLinkGenCodeSectionAddressingModeFar = true
          vLinkGenCodeSectionFlagNoLoad = false
          vLinkGenCodeSectionFlagKeep = false
          vLinkGenCodeSectionRef = vLinkGenLinkerSections/OS_ERRORHOOK_CODE
        Code_Default (vLinkGenConstGroupUserSection): vLinkGenConstGroupUserSectionValue=select "[.]text.*"; select ".text.Shared*";, vLinkGenConstGroupUserSectionPosition=0
      Const_Default (vLinkGenLinkerSectionConstGroup): vLinkGenConstGroupAlignment=8, vLinkGenConstGroupPosition=0, vLinkGenConstGroupGapSize=0, vLinkGenConstGroupHwRegion=RegionBlock_PFlash0_NonCached
        Const_Default (vLinkGenConstGroupUserSection): vLinkGenConstGroupUserSectionValue=select "[.]rodata.*"; select "[.]zrodata.*";, vLinkGenConstGroupUserSectionPosition=0
      Bss_Default (vLinkGenLinkerSectionVarGroup):
        vLinkGenVarGroupAlignment = 8
        vLinkGenVarGroupPosition = 4
        vLinkGenVarGroupInitCore = 0
        vLinkGenVarGroupInitPolicy = ALWAYS
        vLinkGenVarGroupGapSize = 0
        vLinkGenVarGroupHwRegion = RegionBlock_0_DSPR_Core0
        Bss_Default (vLinkGenVarGroupUserSection):
          vLinkGenVarGroupUserSectionValue = select "[.]bss.*"; select "[.]zbss.*"; select ".bss.CPU0.Private*"; select ".bss.CPU0_DSPR_RAM_NOINIT";
          vLinkGenVarGroupUserSectionPosition = 0
      Startup_Code (vLinkGenLinkerSectionConstGroup): vLinkGenConstGroupAlignment=8, vLinkGenConstGroupPosition=0, vLinkGenConstGroupGapSize=0, vLinkGenConstGroupHwRegion=RegionBlock_PFlash0_NonCached
        vLinkGenConstGroupUserSection:
          vLinkGenConstGroupUserSectionValue = select ".text.brsStartup"; "_RESET" = "brsStartupEntry"; "_start" = "brsStartupEntry"; "_start_tc0" = "brsStartupEntry"; "_start_tc1" = "brsStartupEntry"; "_start_tc2" = "brsStartupEntry"; "_start_tc3" = "brsStartupEntry"; "_start_tc4" = "brsStartupEntry"; "_start_tc5" = "brsStartupEntry"; "_brsStartupEntry" = "brsStartupEntry";
          vLinkGenConstGroupUserSectionPosition = 0
      BMHD (vLinkGenLinkerSectionUserGroup): vLinkGenUserGroupPlacement=PRE, vLinkGenUserGroupPosition=1
        4 x vLinkGenUserGroupUserSection:
          BMHD0: vLinkGenUserGroupUserSectionPosition=0, vLinkGenUserGroupUserSectionValue=section_layout mpe:vtc:linear { /* RegionBlock_0_BMHD0 (32 Byte) */ group RegionBlock_0_BMHD0(ordered, run_addr = 0xA0000000) { group BMHD0(ordered, contiguous, fill, align=32) { select ".rodata.BMHD0"; } "_BMHD0_START" = "_lc_gb_BMHD0"; "_BMHD0_END" = ("_lc_ge_BMHD0" == 0) ? 0 : "_lc_ge_BMHD0" - 1; "_BMHD0_LIMIT" = "_lc_ge_BMHD0"; } "_RegionBlock_0_BMHD0_START" = "_lc_gb_RegionBlock_0_BMHD0"; "_RegionBlock_0_BMHD0_END" = ("_lc_ge_RegionBlock_0_BMHD0" == 0) ? 0 : "_lc_ge_RegionBlock_0_BMHD0" - 1; "_RegionBlock_0_BMHD0_LIMIT" = "_lc_ge_RegionBlock_0_BMHD0";
          BMHD1: vLinkGenUserGroupUserSectionPosition=1, vLinkGenUserGroupUserSectionValue=/* RegionBlock_0_BMHD1 (32 Byte) */ group RegionBlock_0_BMHD1(ordered, run_addr = 0xA0020000) { group BMHD1(ordered, contiguous, fill, align=32) { select ".rodata.BMHD1"; } "_BMHD1_START" = "_lc_gb_BMHD1"; "_BMHD1_END" = ("_lc_ge_BMHD1" == 0) ? 0 : "_lc_ge_BMHD1" - 1; "_BMHD1_LIMIT" = "_lc_ge_BMHD1"; } "_RegionBlock_0_BMHD1_START" = "_lc_gb_RegionBlock_0_BMHD1"; "_RegionBlock_0_BMHD1_END" = ("_lc_ge_RegionBlock_0_BMHD1" == 0) ? 0 : "_lc_ge_RegionBlock_0_BMHD1" - 1; "_RegionBlock_0_BMHD1_LIMIT" = "_lc_ge_RegionBlock_0_BMHD1";
          BMHD2: vLinkGenUserGroupUserSectionPosition=2, vLinkGenUserGroupUserSectionValue=/* RegionBlock_0_BMHD2 (32 Byte) */ group RegionBlock_0_BMHD2(ordered, run_addr = 0xA000FFE0) { group BMHD2(ordered, contiguous, fill, align=32) { select ".rodata.BMHD2"; } "_BMHD2_START" = "_lc_gb_BMHD2"; "_BMHD2_END" = ("_lc_ge_BMHD2" == 0) ? 0 : "_lc_ge_BMHD2" - 1; "_BMHD2_LIMIT" = "_lc_ge_BMHD2"; } "_RegionBlock_0_BMHD2_START" = "_lc_gb_RegionBlock_0_BMHD2"; "_RegionBlock_0_BMHD2_END" = ("_lc_ge_RegionBlock_0_BMHD2" == 0) ? 0 : "_lc_ge_RegionBlock_0_BMHD2" - 1; "_RegionBlock_0_BMHD2_LIMIT" = "_lc_ge_RegionBlock_0_BMHD2";
          BMHD3: vLinkGenUserGroupUserSectionPosition=3, vLinkGenUserGroupUserSectionValue=/* RegionBlock_0_BMHD3 (32 Byte) */ group RegionBlock_0_BMHD3(ordered, run_addr = 0xA001FFE0) { group BMHD3(ordered, contiguous, fill, align=32) { select ".rodata.BMHD3"; } "_BMHD3_START" = "_lc_gb_BMHD3"; "_BMHD3_END" = ("_lc_ge_BMHD3" == 0) ? 0 : "_lc_ge_BMHD3" - 1; "_BMHD3_LIMIT" = "_lc_ge_BMHD3"; } "_RegionBlock_0_BMHD3_START" = "_lc_gb_RegionBlock_0_BMHD3"; "_RegionBlock_0_BMHD3_END" = ("_lc_ge_RegionBlock_0_BMHD3" == 0) ? 0 : "_lc_ge_RegionBlock_0_BMHD3" - 1; "_RegionBlock_0_BMHD3_LIMIT" = "_lc_ge_RegionBlock_0_BMHD3"; }
      vLinkGenLinkerSections
        10 x vLinkGenLinkerCodeSection:
          OS_ERRORHOOK_CODE: vLinkGenLinkerCodeSectionName=OS_ERRORHOOK_CODE, vLinkGenLinkerCodeSectionAlignment=0
          OS_INTVEC_CORE2_CODE: vLinkGenLinkerCodeSectionName=OS_INTVEC_CORE2_CODE, vLinkGenLinkerCodeSectionAlignment=32
          OS_EXCVEC_CORE2_CODE: vLinkGenLinkerCodeSectionName=OS_EXCVEC_CORE2_CODE, vLinkGenLinkerCodeSectionAlignment=32
          OS_INTVEC_CORE1_CODE: vLinkGenLinkerCodeSectionName=OS_INTVEC_CORE1_CODE, vLinkGenLinkerCodeSectionAlignment=32
          OS_EXCVEC_CORE1_CODE: vLinkGenLinkerCodeSectionName=OS_EXCVEC_CORE1_CODE, vLinkGenLinkerCodeSectionAlignment=32
          OS_INTVEC_CORE0_CODE: vLinkGenLinkerCodeSectionName=OS_INTVEC_CORE0_CODE, vLinkGenLinkerCodeSectionAlignment=32
          OS_EXCVEC_CORE0_CODE: vLinkGenLinkerCodeSectionName=OS_EXCVEC_CORE0_CODE, vLinkGenLinkerCodeSectionAlignment=32
          OS_INTVEC_CODE: vLinkGenLinkerCodeSectionName=OS_INTVEC_CODE, vLinkGenLinkerCodeSectionAlignment=32
          OS_OS_COREINITHOOK_CODE: vLinkGenLinkerCodeSectionName=OS_OS_COREINITHOOK_CODE, vLinkGenLinkerCodeSectionAlignment=0
          OS_CODE: vLinkGenLinkerCodeSectionName=OS_CODE, vLinkGenLinkerCodeSectionAlignment=0
        15 x vLinkGenLinkerConstSection:
          OS_SystemApplication_OsCore2_CONST: vLinkGenLinkerConstSectionName=OS_SystemApplication_OsCore2_CONST, vLinkGenLinkerConstSectionAlignment=0
          OS_SystemApplication_OsCore1_CONST: vLinkGenLinkerConstSectionName=OS_SystemApplication_OsCore1_CONST, vLinkGenLinkerConstSectionAlignment=0
          OS_SystemApplication_OsCore0_CONST: vLinkGenLinkerConstSectionName=OS_SystemApplication_OsCore0_CONST, vLinkGenLinkerConstSectionAlignment=0
          OS_INTVEC_CORE2_CONST: vLinkGenLinkerConstSectionName=OS_INTVEC_CORE2_CONST, vLinkGenLinkerConstSectionAlignment=32
          OS_EXCVEC_CORE2_CONST: vLinkGenLinkerConstSectionName=OS_EXCVEC_CORE2_CONST, vLinkGenLinkerConstSectionAlignment=32
          OS_CORE2_CONST: vLinkGenLinkerConstSectionName=OS_CORE2_CONST, vLinkGenLinkerConstSectionAlignment=0
          OS_INTVEC_CORE1_CONST: vLinkGenLinkerConstSectionName=OS_INTVEC_CORE1_CONST, vLinkGenLinkerConstSectionAlignment=32
          OS_EXCVEC_CORE1_CONST: vLinkGenLinkerConstSectionName=OS_EXCVEC_CORE1_CONST, vLinkGenLinkerConstSectionAlignment=32
          OS_CORE1_CONST: vLinkGenLinkerConstSectionName=OS_CORE1_CONST, vLinkGenLinkerConstSectionAlignment=0
          OS_INTVEC_CORE0_CONST: vLinkGenLinkerConstSectionName=OS_INTVEC_CORE0_CONST, vLinkGenLinkerConstSectionAlignment=32
          OS_EXCVEC_CORE0_CONST: vLinkGenLinkerConstSectionName=OS_EXCVEC_CORE0_CONST, vLinkGenLinkerConstSectionAlignment=32
          OS_CORE0_CONST: vLinkGenLinkerConstSectionName=OS_CORE0_CONST, vLinkGenLinkerConstSectionAlignment=0
          OS_GLOBALSHARED_CONST: vLinkGenLinkerConstSectionName=OS_GLOBALSHARED_CONST, vLinkGenLinkerConstSectionAlignment=0
          OS_INTVEC_CONST: vLinkGenLinkerConstSectionName=OS_INTVEC_CONST, vLinkGenLinkerConstSectionAlignment=0
          OS_CONST: vLinkGenLinkerConstSectionName=OS_CONST, vLinkGenLinkerConstSectionAlignment=0
        15 x vLinkGenLinkerStackSection, all with vLinkGenLinkerStackSectionAlignment=8:
          OS_STACK_OSCORE2_ISR_CORE_VAR: vLinkGenLinkerStackSectionName=OS_STACK_OSCORE2_ISR_CORE_VAR
          OS_STACK_OSCORE2_TASK_PRIO4294967295_VAR: vLinkGenLinkerStackSectionName=OS_STACK_OSCORE2_TASK_PRIO4294967295_VAR
          OS_STACK_OSCORE2_KERNEL_VAR: vLinkGenLinkerStackSectionName=OS_STACK_OSCORE2_KERNEL_VAR
          OS_STACK_OSCORE2_INIT_VAR: vLinkGenLinkerStackSectionName=OS_STACK_OSCORE2_INIT_VAR
          OS_STACK_OSCORE2_ERROR_VAR: vLinkGenLinkerStackSectionName=OS_STACK_OSCORE2_ERROR_VAR
          OS_STACK_OSCORE1_ISR_CORE_VAR: vLinkGenLinkerStackSectionName=OS_STACK_OSCORE1_ISR_CORE_VAR
          OS_STACK_OSCORE1_KERNEL_VAR: vLinkGenLinkerStackSectionName=OS_STACK_OSCORE1_KERNEL_VAR
          OS_STACK_OSCORE1_INIT_VAR: vLinkGenLinkerStackSectionName=OS_STACK_OSCORE1_INIT_VAR
          OS_STACK_OSCORE1_ERROR_VAR: vLinkGenLinkerStackSectionName=OS_STACK_OSCORE1_ERROR_VAR
          OS_STACK_OSCORE1_TASK_PRIO4294967295_VAR: vLinkGenLinkerStackSectionName=OS_STACK_OSCORE1_TASK_PRIO4294967295_VAR
          OS_STACK_OSCORE0_TASK_PRIO4294967295_VAR: vLinkGenLinkerStackSectionName=OS_STACK_OSCORE0_TASK_PRIO4294967295_VAR
          OS_STACK_OSCORE0_ISR_CORE_VAR: vLinkGenLinkerStackSectionName=OS_STACK_OSCORE0_ISR_CORE_VAR
          OS_STACK_OSCORE0_KERNEL_VAR: vLinkGenLinkerStackSectionName=OS_STACK_OSCORE0_KERNEL_VAR
          OS_STACK_OSCORE0_INIT_VAR: vLinkGenLinkerStackSectionName=OS_STACK_OSCORE0_INIT_VAR
          OS_STACK_OSCORE0_ERROR_VAR: vLinkGenLinkerStackSectionName=OS_STACK_OSCORE0_ERROR_VAR
        17 x vLinkGenLinkerVarSection, all with vLinkGenLinkerVarSectionAlignment=0:
          OS_SystemApplication_OsCore2_VAR: vLinkGenLinkerVarSectionName=OS_SystemApplication_OsCore2_VAR
          OS_SystemApplication_OsCore1_VAR: vLinkGenLinkerVarSectionName=OS_SystemApplication_OsCore1_VAR
          OS_SystemApplication_OsCore0_VAR: vLinkGenLinkerVarSectionName=OS_SystemApplication_OsCore0_VAR
          OS_BARRIER_CORE2_VAR: vLinkGenLinkerVarSectionName=OS_BARRIER_CORE2_VAR
          OS_PUBLIC_CORE2_VAR: vLinkGenLinkerVarSectionName=OS_PUBLIC_CORE2_VAR
          OS_CORE2_VAR: vLinkGenLinkerVarSectionName=OS_CORE2_VAR
          OS_CORESTATUS_CORE2_VAR: vLinkGenLinkerVarSectionName=OS_CORESTATUS_CORE2_VAR
          OS_BARRIER_CORE1_VAR: vLinkGenLinkerVarSectionName=OS_BARRIER_CORE1_VAR
          OS_PUBLIC_CORE1_VAR: vLinkGenLinkerVarSectionName=OS_PUBLIC_CORE1_VAR
          OS_CORE1_VAR: vLinkGenLinkerVarSectionName=OS_CORE1_VAR
          OS_CORESTATUS_CORE1_VAR: vLinkGenLinkerVarSectionName=OS_CORESTATUS_CORE1_VAR
          OS_BARRIER_CORE0_VAR: vLinkGenLinkerVarSectionName=OS_BARRIER_CORE0_VAR
          OS_PUBLIC_CORE0_VAR: vLinkGenLinkerVarSectionName=OS_PUBLIC_CORE0_VAR
          OS_CORE0_VAR: vLinkGenLinkerVarSectionName=OS_CORE0_VAR
          OS_CORESTATUS_CORE0_VAR: vLinkGenLinkerVarSectionName=OS_CORESTATUS_CORE0_VAR
          OS_GLOBALSHARED_VAR: vLinkGenLinkerVarSectionName=OS_GLOBALSHARED_VAR
          OS_VAR: vLinkGenLinkerVarSectionName=OS_VAR
        OS_Default_Init_Task_CODE (vLinkGenLinkerCodeSection): vLinkGenLinkerCodeSectionName=OS_Default_Init_Task_CODE, vLinkGenLinkerCodeSectionAlignment=0
        OS_Default_Init_Task_Core1_CODE (vLinkGenLinkerCodeSection): vLinkGenLinkerCodeSectionName=OS_Default_Init_Task_Core1_CODE, vLinkGenLinkerCodeSectionAlignment=0
        OS_STACK_OSCORE1_TASK_PRIO50_VAR (vLinkGenLinkerStackSection): vLinkGenLinkerStackSectionName=OS_STACK_OSCORE1_TASK_PRIO50_VAR, vLinkGenLinkerStackSectionAlignment=8
        OS_Default_Init_Task_Core2_CODE (vLinkGenLinkerCodeSection): vLinkGenLinkerCodeSectionName=OS_Default_Init_Task_Core2_CODE, vLinkGenLinkerCodeSectionAlignment=0
        7 x vLinkGenLinkerStackSection:
          OS_STACK_OSCORE2_TASK_PRIO50_VAR: vLinkGenLinkerStackSectionName=OS_STACK_OSCORE2_TASK_PRIO50_VAR, vLinkGenLinkerStackSectionAlignment=8
          LinkerStackSection_istack_tc{0..2}: vLinkGenLinkerStackSectionName=istack_tc{0..2}, vLinkGenLinkerStackSectionAlignment=0
          LinkerStackSection_ustack_tc2: vLinkGenLinkerStackSectionName=ustack_tc2, vLinkGenLinkerStackSectionAlignment=0
          LinkerStackSection_ustack_tc1: vLinkGenLinkerStackSectionName=ustack_tc1, vLinkGenLinkerStackSectionAlignment=0
          LinkerStackSection_ustack_tc0: vLinkGenLinkerStackSectionName=ustack_tc0, vLinkGenLinkerStackSectionAlignment=0
        LinkerVarSection_data (vLinkGenLinkerVarSection): vLinkGenLinkerVarSectionName=data, vLinkGenLinkerVarSectionAlignment=0
        3 x vLinkGenLinkerCodeSection, all with vLinkGenLinkerCodeSectionAlignment=0:
          OS_OsTask_App10ms_Core1_CODE: vLinkGenLinkerCodeSectionName=OS_OsTask_App10ms_Core1_CODE
          OS_OsTask_Bsw5ms_Core0_CODE: vLinkGenLinkerCodeSectionName=OS_OsTask_Bsw5ms_Core0_CODE
          OS_OsTask_App10ms_Core2_CODE: vLinkGenLinkerCodeSectionName=OS_OsTask_App10ms_Core2_CODE
        4 x vLinkGenLinkerStackSection, all with vLinkGenLinkerStackSectionAlignment=8:
          OS_STACK_OSTASK_BSW5MS_CORE0_VAR: vLinkGenLinkerStackSectionName=OS_STACK_OSTASK_BSW5MS_CORE0_VAR
          OS_STACK_OSCORE0_TASK_PRIO30_VAR: vLinkGenLinkerStackSectionName=OS_STACK_OSCORE0_TASK_PRIO30_VAR
          OS_STACK_OSTASK_APP10MS_CORE2_VAR: vLinkGenLinkerStackSectionName=OS_STACK_OSTASK_APP10MS_CORE2_VAR
          OS_STACK_OSTASK_APP10MS_CORE1_VAR: vLinkGenLinkerStackSectionName=OS_STACK_OSTASK_APP10MS_CORE1_VAR
        3 x vLinkGenLinkerCodeSection, all with vLinkGenLinkerCodeSectionAlignment=0:
          OS_POSTTASKHOOK_CODE: vLinkGenLinkerCodeSectionName=OS_POSTTASKHOOK_CODE
          OS_PRETASKHOOK_CODE: vLinkGenLinkerCodeSectionName=OS_PRETASKHOOK_CODE
          OS_SHUTDOWNHOOK_CODE: vLinkGenLinkerCodeSectionName=OS_SHUTDOWNHOOK_CODE
        3 x vLinkGenLinkerStackSection, all with vLinkGenLinkerStackSectionAlignment=8:
          OS_STACK_OSCORE2_SHUTDOWN_VAR: vLinkGenLinkerStackSectionName=OS_STACK_OSCORE2_SHUTDOWN_VAR
          OS_STACK_OSCORE1_SHUTDOWN_VAR: vLinkGenLinkerStackSectionName=OS_STACK_OSCORE1_SHUTDOWN_VAR
          OS_STACK_OSCORE0_SHUTDOWN_VAR: vLinkGenLinkerStackSectionName=OS_STACK_OSCORE0_SHUTDOWN_VAR
        OS_STARTUPHOOK_CODE (vLinkGenLinkerCodeSection): vLinkGenLinkerCodeSectionName=OS_STARTUPHOOK_CODE, vLinkGenLinkerCodeSectionAlignment=0
        3 x vLinkGenLinkerStackSection, all with vLinkGenLinkerStackSectionAlignment=8:
          OS_STACK_OSCORE2_STARTUP_VAR: vLinkGenLinkerStackSectionName=OS_STACK_OSCORE2_STARTUP_VAR
          OS_STACK_OSCORE1_STARTUP_VAR: vLinkGenLinkerStackSectionName=OS_STACK_OSCORE1_STARTUP_VAR
          OS_STACK_OSCORE0_STARTUP_VAR: vLinkGenLinkerStackSectionName=OS_STACK_OSCORE0_STARTUP_VAR
        OS_CanIsr_0_CODE (vLinkGenLinkerCodeSection): vLinkGenLinkerCodeSectionName=OS_CanIsr_0_CODE, vLinkGenLinkerCodeSectionAlignment=0
      8 x vLinkGenLinkerSectionConstGroup, all with vLinkGenConstGroupPosition=0, vLinkGenConstGroupAlignment=32, vLinkGenConstGroupGapSize=0, vLinkGenConstGroupHwRegion=RegionBlock_PFlash0_NonCached:
        OS_INTVEC_CORE2_CODE
          OS_INTVEC_CORE2_CODE (vLinkGenConstGroupCodeSection):
            vLinkGenCodeSectionPosition = 0
            vLinkGenCodeSectionCachePolicyCache = false
            vLinkGenCodeSectionCachePolicyNoCache = false
            vLinkGenCodeSectionAddressingModeNear = false
            vLinkGenCodeSectionAddressingModeFar = true
            vLinkGenCodeSectionFlagNoLoad = false
            vLinkGenCodeSectionFlagKeep = false
            vLinkGenCodeSectionRef = vLinkGenLinkerSections/OS_INTVEC_CORE2_CODE
        OS_EXCVEC_CORE2_CODE
          OS_EXCVEC_CORE2_CODE (vLinkGenConstGroupCodeSection):
            vLinkGenCodeSectionPosition = 0
            vLinkGenCodeSectionCachePolicyCache = false
            vLinkGenCodeSectionCachePolicyNoCache = false
            vLinkGenCodeSectionAddressingModeNear = false
            vLinkGenCodeSectionAddressingModeFar = true
            vLinkGenCodeSectionFlagNoLoad = false
            vLinkGenCodeSectionFlagKeep = false
            vLinkGenCodeSectionRef = vLinkGenLinkerSections/OS_EXCVEC_CORE2_CODE
        OS_INTVEC_CORE1_CODE
          OS_INTVEC_CORE1_CODE (vLinkGenConstGroupCodeSection):
            vLinkGenCodeSectionPosition = 0
            vLinkGenCodeSectionCachePolicyCache = false
            vLinkGenCodeSectionCachePolicyNoCache = false
            vLinkGenCodeSectionAddressingModeNear = false
            vLinkGenCodeSectionAddressingModeFar = true
            vLinkGenCodeSectionFlagNoLoad = false
            vLinkGenCodeSectionFlagKeep = false
            vLinkGenCodeSectionRef = vLinkGenLinkerSections/OS_INTVEC_CORE1_CODE
        OS_EXCVEC_CORE1_CODE
          OS_EXCVEC_CORE1_CODE (vLinkGenConstGroupCodeSection):
            vLinkGenCodeSectionPosition = 0
            vLinkGenCodeSectionCachePolicyCache = false
            vLinkGenCodeSectionCachePolicyNoCache = false
            vLinkGenCodeSectionAddressingModeNear = false
            vLinkGenCodeSectionAddressingModeFar = true
            vLinkGenCodeSectionFlagNoLoad = false
            vLinkGenCodeSectionFlagKeep = false
            vLinkGenCodeSectionRef = vLinkGenLinkerSections/OS_EXCVEC_CORE1_CODE
        OS_INTVEC_CORE2_CONST
          OS_INTVEC_CORE2_CONST (vLinkGenConstGroupConstSection):
            vLinkGenConstSectionPosition = 0
            vLinkGenConstSectionCachePolicyCache = false
            vLinkGenConstSectionCachePolicyNoCache = false
            vLinkGenConstSectionAddressingModeNear = true
            vLinkGenConstSectionAddressingModeFar = true
            vLinkGenConstSectionFlagNoLoad = false
            vLinkGenConstSectionFlagKeep = false
            vLinkGenConstSectionRef = vLinkGenLinkerSections/OS_INTVEC_CORE2_CONST
        OS_EXCVEC_CORE2_CONST
          OS_EXCVEC_CORE2_CONST (vLinkGenConstGroupConstSection):
            vLinkGenConstSectionPosition = 0
            vLinkGenConstSectionCachePolicyCache = false
            vLinkGenConstSectionCachePolicyNoCache = false
            vLinkGenConstSectionAddressingModeNear = true
            vLinkGenConstSectionAddressingModeFar = true
            vLinkGenConstSectionFlagNoLoad = false
            vLinkGenConstSectionFlagKeep = false
            vLinkGenConstSectionRef = vLinkGenLinkerSections/OS_EXCVEC_CORE2_CONST
        OS_INTVEC_CORE1_CONST
          OS_INTVEC_CORE1_CONST (vLinkGenConstGroupConstSection):
            vLinkGenConstSectionPosition = 0
            vLinkGenConstSectionCachePolicyCache = false
            vLinkGenConstSectionCachePolicyNoCache = false
            vLinkGenConstSectionAddressingModeNear = true
            vLinkGenConstSectionAddressingModeFar = true
            vLinkGenConstSectionFlagNoLoad = false
            vLinkGenConstSectionFlagKeep = false
            vLinkGenConstSectionRef = vLinkGenLinkerSections/OS_INTVEC_CORE1_CONST
        OS_EXCVEC_CORE1_CONST
          OS_EXCVEC_CORE1_CONST (vLinkGenConstGroupConstSection):
            vLinkGenConstSectionPosition = 0
            vLinkGenConstSectionCachePolicyCache = false
            vLinkGenConstSectionCachePolicyNoCache = false
            vLinkGenConstSectionAddressingModeNear = true
            vLinkGenConstSectionAddressingModeFar = true
            vLinkGenConstSectionFlagNoLoad = false
            vLinkGenConstSectionFlagKeep = false
            vLinkGenConstSectionRef = vLinkGenLinkerSections/OS_EXCVEC_CORE1_CONST
      4 x vLinkGenLinkerSectionVarGroup, all with vLinkGenVarGroupPosition=0, vLinkGenVarGroupAlignment=4, vLinkGenVarGroupInitPolicy=NONE, vLinkGenVarGroupGapSize=0:
        OS_STACKS_CORE1: vLinkGenVarGroupHwRegion=RegionBlock_0_DSPR_Core1
          OS_STACKS_CORE1 (vLinkGenVarGroupStackSection):
            vLinkGenStackSectionPosition = 0
            vLinkGenStackSectionInitPolicyInit = false
            vLinkGenStackSectionInitPolicyNoInit = true
            vLinkGenStackSectionInitPolicyZeroInit = false
            vLinkGenStackSectionCachePolicyCache = false
            vLinkGenStackSectionCachePolicyNoCache = false
            vLinkGenStackSectionAddressingModeNear = false
            vLinkGenStackSectionAddressingModeFar = true
            vLinkGenStackSectionFlagNoLoad = false
            vLinkGenStackSectionFlagKeep = false
            vLinkGenStackSectionRef = OS_STACK_OSCORE1_ISR_CORE_VAR
            vLinkGenStackSectionRef = OS_STACK_OSCORE1_KERNEL_VAR
            vLinkGenStackSectionRef = OS_STACK_OSCORE1_INIT_VAR
            vLinkGenStackSectionRef = OS_STACK_OSCORE1_ERROR_VAR
            vLinkGenStackSectionRef = OS_STACK_OSCORE1_TASK_PRIO4294967295_VAR
            vLinkGenStackSectionRef = OS_STACK_OSCORE1_TASK_PRIO50_VAR
            vLinkGenStackSectionRef = OS_STACK_OSTASK_APP10MS_CORE1_VAR
            vLinkGenStackSectionRef = OS_STACK_OSCORE1_SHUTDOWN_VAR
            vLinkGenStackSectionRef = OS_STACK_OSCORE1_STARTUP_VAR
        OS_STACKS_CORE2: vLinkGenVarGroupHwRegion=RegionBlock_0_DSPR_Core2
          OS_STACKS_CORE2 (vLinkGenVarGroupStackSection):
            vLinkGenStackSectionPosition = 0
            vLinkGenStackSectionInitPolicyInit = false
            vLinkGenStackSectionInitPolicyNoInit = true
            vLinkGenStackSectionInitPolicyZeroInit = false
            vLinkGenStackSectionCachePolicyCache = false
            vLinkGenStackSectionCachePolicyNoCache = false
            vLinkGenStackSectionAddressingModeNear = false
            vLinkGenStackSectionAddressingModeFar = true
            vLinkGenStackSectionFlagNoLoad = false
            vLinkGenStackSectionFlagKeep = false
            vLinkGenStackSectionRef = OS_STACK_OSCORE2_ISR_CORE_VAR
            vLinkGenStackSectionRef = OS_STACK_OSCORE2_TASK_PRIO4294967295_VAR
            vLinkGenStackSectionRef = OS_STACK_OSCORE2_KERNEL_VAR
            vLinkGenStackSectionRef = OS_STACK_OSCORE2_INIT_VAR
            vLinkGenStackSectionRef = OS_STACK_OSCORE2_ERROR_VAR
            vLinkGenStackSectionRef = OS_STACK_OSCORE2_TASK_PRIO50_VAR
            vLinkGenStackSectionRef = OS_STACK_OSTASK_APP10MS_CORE2_VAR
            vLinkGenStackSectionRef = OS_STACK_OSCORE2_SHUTDOWN_VAR
            vLinkGenStackSectionRef = OS_STACK_OSCORE2_STARTUP_VAR
        OS_DATA_CORE2: vLinkGenVarGroupHwRegion=RegionBlock_0_DSPR_Core2
          OS_DATA_CORE2 (vLinkGenVarGroupVarSection):
            vLinkGenVarSectionPosition = 0
            vLinkGenVarSectionInitPolicyInit = false
            vLinkGenVarSectionInitPolicyNoInit = true
            vLinkGenVarSectionInitPolicyZeroInit = false
            vLinkGenVarSectionCachePolicyCache = true
            vLinkGenVarSectionCachePolicyNoCache = true
            vLinkGenVarSectionAddressingModeNear = false
            vLinkGenVarSectionAddressingModeFar = true
            vLinkGenVarSectionFlagNoLoad = false
            vLinkGenVarSectionFlagKeep = false
            vLinkGenVarSectionRef = OS_SystemApplication_OsCore2_VAR
            vLinkGenVarSectionRef = OS_CORE2_VAR
        OS_DATA_CORE1: vLinkGenVarGroupHwRegion=RegionBlock_0_DSPR_Core1
          OS_DATA_CORE1 (vLinkGenVarGroupVarSection):
            vLinkGenVarSectionPosition = 0
            vLinkGenVarSectionInitPolicyInit = false
            vLinkGenVarSectionInitPolicyNoInit = true
            vLinkGenVarSectionInitPolicyZeroInit = false
            vLinkGenVarSectionCachePolicyCache = true
            vLinkGenVarSectionCachePolicyNoCache = true
            vLinkGenVarSectionAddressingModeNear = false
            vLinkGenVarSectionAddressingModeFar = true
            vLinkGenVarSectionFlagNoLoad = false
            vLinkGenVarSectionFlagKeep = false
            vLinkGenVarSectionRef = OS_SystemApplication_OsCore1_VAR
            vLinkGenVarSectionRef = OS_CORE1_VAR
      6 x vLinkGenLinkerMemoryRegion, all with vLinkGenMemoryRegionAddrOffset=0:
        MemRegion_DSPR_Core1: vLinkGenMemoryRegionSize=122880, vLinkGenMemoryRegionHwRegion=DSPR1
          RegionBlock_0_DSPR_Core1 (vLinkGenMemoryRegionBlock):
            vLinkGenMemoryRegionBlockInitCore = 0
            vLinkGenMemoryRegionBlockPosition = 0
            vLinkGenMemoryRegionBlockSize = 122880
            vLinkGenMemoryRegionBlockBoundary = LOWER
            vLinkGenMemoryRegionBlockInitPolicy = NONE
        MemRegion_DSPR_Core2: vLinkGenMemoryRegionSize=122880, vLinkGenMemoryRegionHwRegion=DSPR2
          RegionBlock_0_DSPR_Core2 (vLinkGenMemoryRegionBlock):
            vLinkGenMemoryRegionBlockInitCore = 0
            vLinkGenMemoryRegionBlockPosition = 0
            vLinkGenMemoryRegionBlockSize = 122880
            vLinkGenMemoryRegionBlockBoundary = LOWER
            vLinkGenMemoryRegionBlockInitPolicy = NONE
        MemRegion_PSPR_Core1: vLinkGenMemoryRegionSize=8192, vLinkGenMemoryRegionHwRegion=PSPR1
          RegionBlock_0_PSPR_Core1 (vLinkGenMemoryRegionBlock):
            vLinkGenMemoryRegionBlockInitCore = 0
            vLinkGenMemoryRegionBlockPosition = 0
            vLinkGenMemoryRegionBlockSize = 8192
            vLinkGenMemoryRegionBlockBoundary = LOWER
            vLinkGenMemoryRegionBlockInitPolicy = NONE
        MemRegion_PSPR_Core2: vLinkGenMemoryRegionSize=8192, vLinkGenMemoryRegionHwRegion=PSPR2
          RegionBlock_0_PSPR_Core2 (vLinkGenMemoryRegionBlock):
            vLinkGenMemoryRegionBlockInitCore = 0
            vLinkGenMemoryRegionBlockPosition = 0
            vLinkGenMemoryRegionBlockSize = 8192
            vLinkGenMemoryRegionBlockBoundary = LOWER
            vLinkGenMemoryRegionBlockInitPolicy = NONE
        MemRegion_PFlash1_Cached: vLinkGenMemoryRegionSize=2097152, vLinkGenMemoryRegionHwRegion=PFlash1_Cached
          RegionBlock_0_PFlash1_Cached (vLinkGenMemoryRegionBlock):
            vLinkGenMemoryRegionBlockSize = 2072576
            vLinkGenMemoryRegionBlockPosition = 0
            vLinkGenMemoryRegionBlockBoundary = LOWER
            vLinkGenMemoryRegionBlockInitPolicy = NONE
        MemRegion_PFlash1_NonCached: vLinkGenMemoryRegionSize=2097152, vLinkGenMemoryRegionHwRegion=PFlash1_NonCached
          RegionBlock_PFlash1_NonCached (vLinkGenMemoryRegionBlock):
            vLinkGenMemoryRegionBlockSize = 2072576
            vLinkGenMemoryRegionBlockPosition = 0
            vLinkGenMemoryRegionBlockBoundary = LOWER
            vLinkGenMemoryRegionBlockInitPolicy = NONE
      4 x vLinkGenLinkerSectionVarGroup:
        istack_tc1: vLinkGenVarGroupAlignment=4, vLinkGenVarGroupPosition=0, vLinkGenVarGroupInitPolicy=NONE, vLinkGenVarGroupGapSize=32, vLinkGenVarGroupInitCore=1, vLinkGenVarGroupHwRegion=RegionBlock_0_DSPR_Core1
          istack_tc1 (vLinkGenVarGroupUserSection): vLinkGenVarGroupUserSectionPosition=0, vLinkGenVarGroupUserSectionValue=reserved "istack_tc1" (size = 1024);
          vLinkGenVarGroupStackSection:
            vLinkGenStackSectionPosition = 0
            vLinkGenStackSectionInitPolicyInit = false
            vLinkGenStackSectionInitPolicyNoInit = false
            vLinkGenStackSectionInitPolicyZeroInit = true
            vLinkGenStackSectionCachePolicyCache = false
            vLinkGenStackSectionCachePolicyNoCache = false
            vLinkGenStackSectionAddressingModeNear = false
            vLinkGenStackSectionAddressingModeFar = true
            vLinkGenStackSectionFlagNoLoad = false
            vLinkGenStackSectionFlagKeep = false
            vLinkGenStackSectionRef = LinkerStackSection_istack_tc1
        istack_tc2: vLinkGenVarGroupAlignment=4, vLinkGenVarGroupPosition=0, vLinkGenVarGroupInitPolicy=NONE, vLinkGenVarGroupGapSize=32, vLinkGenVarGroupInitCore=2, vLinkGenVarGroupHwRegion=RegionBlock_0_DSPR_Core2
          istack_tc2 (vLinkGenVarGroupUserSection): vLinkGenVarGroupUserSectionPosition=0, vLinkGenVarGroupUserSectionValue=reserved "istack_tc2" (size = 1024);
          vLinkGenVarGroupStackSection:
            vLinkGenStackSectionPosition = 0
            vLinkGenStackSectionInitPolicyInit = false
            vLinkGenStackSectionInitPolicyNoInit = false
            vLinkGenStackSectionInitPolicyZeroInit = true
            vLinkGenStackSectionCachePolicyCache = false
            vLinkGenStackSectionCachePolicyNoCache = false
            vLinkGenStackSectionAddressingModeNear = false
            vLinkGenStackSectionAddressingModeFar = true
            vLinkGenStackSectionFlagNoLoad = false
            vLinkGenStackSectionFlagKeep = false
            vLinkGenStackSectionRef = LinkerStackSection_istack_tc2
        Bss_Default_Core1: vLinkGenVarGroupAlignment=8, vLinkGenVarGroupPosition=4, vLinkGenVarGroupInitCore=1, vLinkGenVarGroupInitPolicy=ALWAYS, vLinkGenVarGroupGapSize=0, vLinkGenVarGroupHwRegion=RegionBlock_0_DSPR_Core1
          Bss_Default (vLinkGenVarGroupUserSection): vLinkGenVarGroupUserSectionValue=, vLinkGenVarGroupUserSectionPosition=0
        Bss_Default_Core2: vLinkGenVarGroupAlignment=8, vLinkGenVarGroupPosition=4, vLinkGenVarGroupInitCore=2, vLinkGenVarGroupInitPolicy=ALWAYS, vLinkGenVarGroupGapSize=0, vLinkGenVarGroupHwRegion=RegionBlock_0_DSPR_Core2
          Bss_Default (vLinkGenVarGroupUserSection): vLinkGenVarGroupUserSectionValue=, vLinkGenVarGroupUserSectionPosition=0
      MemoryRegion_lmuram_Cahed (vLinkGenLinkerMemoryRegion): vLinkGenMemoryRegionAddrOffset=0, vLinkGenMemoryRegionSize=32768, vLinkGenMemoryRegionHwRegion=lmuram_Cahed
        MemoryRegion_lmuram_Cahed (vLinkGenMemoryRegionBlock):
          vLinkGenMemoryRegionBlockPosition = 0
          vLinkGenMemoryRegionBlockSize = 32768
          vLinkGenMemoryRegionBlockBoundary = LOWER
          vLinkGenMemoryRegionBlockInitPolicy = NONE
      MemoryRegion_lmuram_NonCahed (vLinkGenLinkerMemoryRegion): vLinkGenMemoryRegionAddrOffset=0, vLinkGenMemoryRegionSize=32768, vLinkGenMemoryRegionHwRegion=lmuram_NonCahed
        MemoryRegion_lmuram_NonCahed (vLinkGenMemoryRegionBlock):
          vLinkGenMemoryRegionBlockPosition = 0
          vLinkGenMemoryRegionBlockSize = 32768
          vLinkGenMemoryRegionBlockBoundary = LOWER
          vLinkGenMemoryRegionBlockInitPolicy = NONE
      4 x vLinkGenLinkerSectionVarGroup, all with vLinkGenVarGroupAlignment=4:
        ustack_tc2: vLinkGenVarGroupPosition=0, vLinkGenVarGroupInitPolicy=NONE, vLinkGenVarGroupGapSize=32, vLinkGenVarGroupInitCore=2, vLinkGenVarGroupHwRegion=RegionBlock_0_DSPR_Core2
          vLinkGenVarGroupStackSection:
            vLinkGenStackSectionPosition = 0
            vLinkGenStackSectionInitPolicyInit = false
            vLinkGenStackSectionInitPolicyNoInit = false
            vLinkGenStackSectionInitPolicyZeroInit = true
            vLinkGenStackSectionCachePolicyCache = false
            vLinkGenStackSectionCachePolicyNoCache = false
            vLinkGenStackSectionAddressingModeNear = false
            vLinkGenStackSectionAddressingModeFar = true
            vLinkGenStackSectionFlagNoLoad = false
            vLinkGenStackSectionFlagKeep = false
            vLinkGenStackSectionRef = LinkerStackSection_ustack_tc2
          vLinkGenVarGroupUserSection: vLinkGenVarGroupUserSectionPosition=0, vLinkGenVarGroupUserSectionValue=reserved "ustack_tc2" (size = 1024);
        ustack_tc0: vLinkGenVarGroupPosition=0, vLinkGenVarGroupInitPolicy=NONE, vLinkGenVarGroupGapSize=32, vLinkGenVarGroupInitCore=0, vLinkGenVarGroupHwRegion=RegionBlock_0_DSPR_Core0
          vLinkGenVarGroupStackSection:
            vLinkGenStackSectionPosition = 0
            vLinkGenStackSectionInitPolicyInit = false
            vLinkGenStackSectionInitPolicyNoInit = false
            vLinkGenStackSectionInitPolicyZeroInit = true
            vLinkGenStackSectionCachePolicyCache = false
            vLinkGenStackSectionCachePolicyNoCache = false
            vLinkGenStackSectionAddressingModeNear = false
            vLinkGenStackSectionAddressingModeFar = true
            vLinkGenStackSectionFlagNoLoad = false
            vLinkGenStackSectionFlagKeep = false
            vLinkGenStackSectionRef = LinkerStackSection_ustack_tc0
          vLinkGenVarGroupUserSection: vLinkGenVarGroupUserSectionPosition=0, vLinkGenVarGroupUserSectionValue=reserved "ustack_tc0" (size = 0x4000);
        ustack_tc1: vLinkGenVarGroupPosition=0, vLinkGenVarGroupInitPolicy=NONE, vLinkGenVarGroupGapSize=32, vLinkGenVarGroupInitCore=1, vLinkGenVarGroupHwRegion=RegionBlock_0_DSPR_Core1
          vLinkGenVarGroupStackSection:
            vLinkGenStackSectionPosition = 0
            vLinkGenStackSectionInitPolicyInit = false
            vLinkGenStackSectionInitPolicyNoInit = false
            vLinkGenStackSectionInitPolicyZeroInit = true
            vLinkGenStackSectionCachePolicyCache = false
            vLinkGenStackSectionCachePolicyNoCache = false
            vLinkGenStackSectionAddressingModeNear = false
            vLinkGenStackSectionAddressingModeFar = true
            vLinkGenStackSectionFlagNoLoad = false
            vLinkGenStackSectionFlagKeep = false
            vLinkGenStackSectionRef = LinkerStackSection_ustack_tc1
          vLinkGenVarGroupUserSection: vLinkGenVarGroupUserSectionPosition=0, vLinkGenVarGroupUserSectionValue=reserved "ustack_tc1" (size = 1024);
        Data_Default: vLinkGenVarGroupPosition=6, vLinkGenVarGroupInitPolicy=ALWAYS, vLinkGenVarGroupInitCore=0, vLinkGenVarGroupGapSize=0, vLinkGenVarGroupHwRegion=RegionBlock_0_DSPR_Core0, vLinkGenVarGroupInitDataHwRegion=RegionBlock_PFlash0_NonCached
          vLinkGenVarGroupVarSection:
            vLinkGenVarSectionPosition = 0
            vLinkGenVarSectionInitPolicyInit = true
            vLinkGenVarSectionInitPolicyNoInit = false
            vLinkGenVarSectionInitPolicyZeroInit = false
            vLinkGenVarSectionCachePolicyCache = false
            vLinkGenVarSectionCachePolicyNoCache = false
            vLinkGenVarSectionAddressingModeNear = false
            vLinkGenVarSectionAddressingModeFar = true
            vLinkGenVarSectionFlagNoLoad = false
            vLinkGenVarSectionFlagKeep = false
            vLinkGenVarSectionRef = LinkerVarSection_data
