AUTOSAR XML (schema 00046)
package /ActiveEcuC
  module config CanIf: implementation-config-variant=VARIANT-PRE-COMPILE, module-description=CanIf_Impl
    CanIfCtrlDrvCfg_7d254554 (CanIfCtrlDrvCfg): CanIfCtrlDrvTxCancellation=false, CanIfCtrlDrvInitHohConfigRef=CanIfInitHohCfg, CanIfCtrlDrvNameRef=CanGeneral
      CT_CAN00_9df8a959 (CanIfCtrlCfg): CanIfCtrlId=0, CanIfCtrlWakeupSupport=false, CanIfCtrlJ1939DynAddrSupport=DISABLED, CanIfCtrlCanCtrlRef=CT_CAN00_9df8a959
    CanIfInitCfg
      3 x CanIfRxPduCfg, all with CanIfRxPduCanIdType=STANDARD_CAN, CanIfRxPduUserRxIndicationName=NULL_PTR, CanIfRxPduUserRxIndicationUL=NONE, CanIfRxPduReadData=false, CanIfRxPduReadNotifyStatus=false, CanIfRxPduDlcCheck=true, CanIfRxPduHrhIdRef=CanIfHrhCfg:
        LOCK_Control_oCAN00_8a3e41f4_Rx: CanIfRxPduCanId=560, CanIfRxPduDlc=1, CanIfRxPduId=2, CanIfRxPduRef=Canif2PDUR_lockcontrol
        msg_Receive2_oCAN00_d580e241_Rx: CanIfRxPduCanId=544, CanIfRxPduDlc=8, CanIfRxPduId=3, CanIfRxPduRef=canif2PDUR_msg_receive2
        msg_Receive_oCAN00_76f25845_Rx: CanIfRxPduCanId=528, CanIfRxPduDlc=8, CanIfRxPduId=4, CanIfRxPduRef=canif2PDUR_msg_receive
      5 x CanIfTxPduCfg, all with CanIfTxPduCanIdType=STANDARD_CAN, CanIfTxPduDlc=8, CanIfTxPduUserTxConfirmationName=PduR_CanIfTxConfirmation, CanIfTxPduUserTxConfirmationUL=PDUR, CanIfTxPduReadNotifyStatus=false, CanIfTxPduType=STATIC, CanIfTxPduTruncation=true, CanIfTxPduBufferRef=CanIfBufferCfg_TX:
        LOCK_status_oCAN00_59bc3f35_Tx: CanIfTxPduCanId=561, CanIfTxPduId=3, CanIfTxPduRef=PDUR2CanIf_lockstatus
        Rear_MyECU_oCAN00_8f6ea3fe_Tx: CanIfTxPduCanId=773, CanIfTxPduId=2, CanIfTxPduRef=PDUR2CanIf_Rearmyecu
        msg_MyECU_Lamp_oCAN00_41befc25_Tx: CanIfTxPduCanId=1297, CanIfTxPduId=0, CanIfTxPduRef=PDUR2CanIf_lamp
        msg_Transmit2_oCAN00_ca9f319c_Tx: CanIfTxPduCanId=784, CanIfTxPduId=1, CanIfTxPduRef=PDUR2CanIf_Transmit2
        msg_Transmit_oCAN00_29db34a4_Tx: CanIfTxPduCanId=512, CanIfTxPduId=4, CanIfTxPduRef=PDUR2CanIf_Transmit
      CanIfInitHohCfg: CanIfInitRefCfgSet=CanConfigSet
        CN_CAN00_5e566ad9_Tx (CanIfHthCfg): CanIfHthCanCtrlIdRef=CT_CAN00_9df8a959, CanIfHthIdSymRef=CanHardwareObject_TX
        CN_CAN00_770af0b0_Rx (CanIfHrhCfg): CanIfHrhSoftwareFilter=true, CanIfHrhCanCtrlIdRef=CT_CAN00_9df8a959, CanIfHrhIdSymRef=CanHardwareObject_RX
        CanIfHrhCfg: CanIfHrhSoftwareFilter=true, CanIfHrhCanCtrlIdRef=CT_CAN00_9df8a959, CanIfHrhIdSymRef=CanHardwareObject_APP_RX
        CanIfHthCfg_msg_nm_TX_MyECU_oCAN00_720bbb34_Tx (CanIfHthCfg): CanIfHthCanCtrlIdRef=CT_CAN00_9df8a959, CanIfHthIdSymRef=CanHardwareObject_msg_nm_TX_MyECU_oCAN00_720bbb34_Tx
      CanIfBufferCfg_TX (CanIfBufferCfg):
        CanIfBufferSize = 5
        CanIfTxBufferHandlingType = PRIO_BY_CANID
        CanIfTxBufferMappedTxPdus = 5
        CanIfTxBufferMaxPduLength = 8
        CanIfBufferHthRef = CN_CAN00_5e566ad9_Tx
      msg_nm_TX_MyECU_oCAN00_720bbb34_Tx (CanIfTxPduCfg):
        CanIfTxPduCanId = 1537
        CanIfTxPduCanIdType = STANDARD_CAN
        CanIfTxPduDlc = 8
        CanIfTxPduId = 5
        CanIfTxPduReadNotifyStatus = false
        CanIfTxPduType = STATIC
        CanIfTxPduUserTxConfirmationUL = CAN_NM
        CanIfTxPduTruncation = true
        CanIfTxPduUserTxConfirmationName = CanNm_TxConfirmation
        CanIfTxPduBufferRef = CanIfBufferCfg_msg_nm_TX_MyECU_oCAN00_720bbb34_Tx
        CanIfTxPduRef = msg_nm_TX_MyECU_oCAN00_720bbb34_Tx
      CanIfBufferCfg_msg_nm_TX_MyECU_oCAN00_720bbb34_Tx (CanIfBufferCfg):
        CanIfBufferSize = 0
        CanIfTxBufferHandlingType = NONE
        CanIfTxBufferMappedTxPdus = 1
        CanIfTxBufferMaxPduLength = 8
        CanIfBufferHthRef = CanIfHthCfg_msg_nm_TX_MyECU_oCAN00_720bbb34_Tx
      msg_nm_MyECU_oCAN00_dfbc2140_Rx (CanIfRxPduCfg):
        CanIfRxPduCanId = 1536
        CanIfRxPduCanIdType = STANDARD_CAN
        CanIfRxPduDlc = 8
        CanIfRxPduUserRxIndicationName = CanNm_RxIndication
        CanIfRxPduUserRxIndicationUL = CAN_NM
        CanIfRxPduId = 0
        CanIfRxPduReadData = false
        CanIfRxPduReadNotifyStatus = false
        CanIfRxPduDlcCheck = true
        CanIfRxPduHrhIdRef = CanIfHrhCfg
        CanIfRxPduRef = msg_nm_MyECU
      msg_nm_RearECU_oCAN00_108e14bb_Rx (CanIfRxPduCfg):
        CanIfRxPduCanId = 1025
        CanIfRxPduCanIdType = STANDARD_CAN
        CanIfRxPduDlc = 8
        CanIfRxPduUserRxIndicationName = CanNm_RxIndication
        CanIfRxPduUserRxIndicationUL = CAN_NM
        CanIfRxPduId = 1
        CanIfRxPduReadData = false
        CanIfRxPduReadNotifyStatus = false
        CanIfRxPduDlcCheck = true
        CanIfRxPduHrhIdRef = CanIfHrhCfg
        CanIfRxPduRef = msg_nm_MyECU
    CanIfPrivateCfg:
      CanIfPrivateSoftwareFilterType = LINEAR
      CanIfPrivateDlcCheck = true
      CanIfSupportTTCAN = false
      CanIfTransceiverMapping = false
      CanIfTransceiverHandling = false
      CanIfSupportExtendedIds = false
      CanIfSupportNmOsek = false
      CanIfTxBufferType = BYTE_QUEUE
      CanIfOptimizeOneController = true
      CanIfWakeupSupport = true
      CanIfStaticFdTxBufferSupport = false
      CanIfRxSearchConsiderMsgType = false
      CanIfTxBufferFifoSupport = false
      CanIfSetPduReceptionModeSupport = false
      CanIfCheckWakeupCanRetType = false
      CanIfDataChecksumRxSupport = false
      CanIfDataChecksumTxSupport = false
      CanIfWakeupValidateAllRxMsgs = false
    CanIfPublicCfg:
      CanIfPublicPnSupport = false
      CanIfPublicCancelTransmitSupport = false
      CanIfPublicDevErrorDetect = false
      CanIfPublicHandleTypeEnum = UINT8
      CanIfPublicMultipleDrvSupport = false
      CanIfPublicNumberOfCanHwUnits = 1
      CanIfPublicReadRxPduDataApi = false
      CanIfPublicReadRxPduNotifyStatusApi = false
      CanIfPublicReadTxPduNotifyStatusApi = false
      CanIfPublicSetDynamicTxIdApi = false
      CanIfPublicTxBuffering = true
      CanIfPublicTxConfirmPollingSupport = false
      CanIfPublicVersionInfoApi = false
      CanIfPublicWakeupCheckValidSupport = false
      CanIfPnWakeupTxPduFilterSupport = false
      CanIfPnTrcvHandlingSupport = false
      CanIfJ1939DynAddrSupport = DISABLED
      CanIfSafeBswChecks = false
      CanIfBusMirroringSupport = false
      CanIfSetBaudrateApi = false
      CanIfPublicWakeupCheckValidByNM = false
    CanIfDispatchCfg:
      CanIfDispatchUserCtrlBusOffName = CanSM_ControllerBusOff
      CanIfDispatchUserCtrlBusOffUL = CAN_SM
      CanIfDispatchUserCtrlModeIndicationName = CanSM_ControllerModeIndication
      CanIfDispatchUserCtrlModeIndicationUL = CAN_SM
