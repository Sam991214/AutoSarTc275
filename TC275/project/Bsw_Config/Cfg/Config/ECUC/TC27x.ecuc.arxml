AUTOSAR XML (schema 00046)
package /ActiveEcuC
  ecuc value collection ActiveEcuC: ecu-extract=SYSTEM, ecuc-values=[Rte, EcuM, Os, Det, EcuC, BswM, vSet, vLinkGen, vBaseEnv, vBRS, Resource, Mcu, PduR, CanIf, Can, Com, CanSM, ComM, Nm, CanNm, Dio, Port]
