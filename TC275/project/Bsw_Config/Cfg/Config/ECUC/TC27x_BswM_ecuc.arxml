AUTOSAR XML (schema 00046)
package /ActiveEcuC
  module config BswM: implementation-config-variant=VARIANT-PRE-COMPILE, module-description=BswM_Impl
    BswMConfig
      BswMArbitration
        CC_CN_CAN00_5e566ad9_RX (BswMRule):
          BswMNestedExecutionOnly = false
          BswMRuleId = 0
          BswMRuleInitState = BSWM_FALSE
          BswMRuleExpressionRef = CC_LE_CN_CAN00_5e566ad9_RX
          BswMRuleFalseActionList = CC_AL_CN_CAN00_5e566ad9_RX_Disable
          BswMRuleTrueActionList = CC_AL_CN_CAN00_5e566ad9_RX_EnableNoinit
        CC_LE_CN_CAN00_5e566ad9_RX (BswMLogicalExpression): BswMLogicalOperator=BSWM_AND, BswMArgumentRef=CC_Cond_CanSMIndication_CN_CAN00_5e566ad9_NEQ_CANSM_BSWM_NO_COMMUNICATION
        CC_Cond_CanSMIndication_CN_CAN00_5e566ad9_NEQ_CANSM_BSWM_NO_COMMUNICATION (BswMModeCondition): BswMConditionType=BSWM_EQUALS_NOT, BswMConditionMode=CC_CanSMIndication_CN_CAN00_5e566ad9
          BswMConditionValue
            BswMBswMode: BswMBswRequestedMode=CANSM_BSWM_NO_COMMUNICATION
        CC_CanSMIndication_CN_CAN00_5e566ad9 (BswMModeRequestPort): BswMArbitrateOnInit=false, BswMRequestProcessing=BSWM_IMMEDIATE
          BswMModeRequestSource
            BswMCanSMIndication: BswMCanSMChannelRef=CN_CAN00_5e566ad9
          BswMModeInitValue
            BswMBswModeInitValue: BswMBswModeInitValueMode=CANSM_BSWM_NO_COMMUNICATION
        CC_CN_CAN00_5e566ad9_TX (BswMRule):
          BswMNestedExecutionOnly = false
          BswMRuleId = 2
          BswMRuleInitState = BSWM_FALSE
          BswMRuleExpressionRef = CC_LE_CN_CAN00_5e566ad9_TX
          BswMRuleFalseActionList = CC_AL_CN_CAN00_5e566ad9_TX_Disable
          BswMRuleTrueActionList = CC_AL_CN_CAN00_5e566ad9_TX_EnableNoinit
        CC_LE_CN_CAN00_5e566ad9_TX (BswMLogicalExpression): BswMLogicalOperator=BSWM_AND, BswMArgumentRef=CC_Cond_CanSMIndication_CN_CAN00_5e566ad9_EQ_CANSM_BSWM_FULL_COMMUNICATION
        CC_Cond_CanSMIndication_CN_CAN00_5e566ad9_EQ_CANSM_BSWM_FULL_COMMUNICATION (BswMModeCondition): BswMConditionType=BSWM_EQUALS, BswMConditionMode=CC_CanSMIndication_CN_CAN00_5e566ad9
          BswMConditionValue
            BswMBswMode: BswMBswRequestedMode=CANSM_BSWM_FULL_COMMUNICATION
        CC_CN_CAN00_5e566ad9_RX_DM (BswMRule):
          BswMNestedExecutionOnly = false
          BswMRuleId = 1
          BswMRuleInitState = BSWM_FALSE
          BswMRuleExpressionRef = CC_LE_CN_CAN00_5e566ad9_RX_DM
          BswMRuleFalseActionList = CC_AL_CN_CAN00_5e566ad9_Disable_DM
          BswMRuleTrueActionList = CC_AL_CN_CAN00_5e566ad9_Enable_DM
        CC_LE_CN_CAN00_5e566ad9_RX_DM (BswMLogicalExpression): BswMLogicalOperator=BSWM_AND, BswMArgumentRef=CC_Cond_CanSMIndication_CN_CAN00_5e566ad9_EQ_CANSM_BSWM_FULL_COMMUNICATION
        ESH_RunToPostRun (BswMRule):
          BswMNestedExecutionOnly = false
          BswMRuleId = 8
          BswMRuleInitState = BSWM_FALSE
          BswMRuleExpressionRef = ESH_LE_RunToPostRunTransition
          BswMRuleTrueActionList = ESH_AL_ExitRun
        ESH_LE_RunToPostRunTransition (BswMLogicalExpression): BswMLogicalOperator=BSWM_AND, BswMArgumentRef=ESH_LE_RunReached, BswMArgumentRef=ESH_LE_NoRunAndNoKillAllRequest
        ESH_LE_RunReached (BswMLogicalExpression):
          BswMLogicalOperator = BSWM_AND
          BswMArgumentRef = ESH_Cond_StateIsRun
          BswMArgumentRef = ESH_Cond_ModeIsRun
          BswMArgumentRef = Cond_ESH_EcuMState_EQ_ECUM_STATE_APP_RUN
        ESH_Cond_StateIsRun (BswMModeCondition): BswMConditionType=BSWM_EQUALS, BswMConditionMode=ESH_State
          BswMConditionValue
            BswMBswMode: BswMBswRequestedMode=ESH_RUN
        ESH_State (BswMModeRequestPort): BswMArbitrateOnInit=true, BswMRequestProcessing=BSWM_IMMEDIATE
          BswMModeRequestSource
            BswMGenericRequest: BswMModeRequesterId=230, BswMRequestedModeMax=7
              7 x BswMGenericRequestMode:
                ESH_INIT: BswMGenericRequestModeValue=0
                ESH_RUN: BswMGenericRequestModeValue=1
                ESH_POST_RUN: BswMGenericRequestModeValue=2
                ESH_PREP_SHUTDOWN: BswMGenericRequestModeValue=3
                ESH_WAIT_FOR_NVM: BswMGenericRequestModeValue=4
                ESH_SHUTDOWN: BswMGenericRequestModeValue=5
                ESH_WAKEUP: BswMGenericRequestModeValue=6
          BswMModeInitValue
            BswMBswModeInitValue: BswMBswModeInitValueMode=ESH_INIT
        ESH_Cond_ModeIsRun (BswMModeCondition): BswMConditionType=BSWM_EQUALS, BswMConditionMode=ESH_ModeNotification
          BswMConditionValue
            BswMModeDeclaration: BswMModeValueRef=RUN
        ESH_ModeNotification (BswMModeRequestPort): BswMArbitrateOnInit=false, BswMRequestProcessing=BSWM_DEFERRED
          BswMModeRequestSource
            BswMSwcModeNotification: BswMSwcModeNotificationModeDeclarationGroupPrototypeRef=BswM_MDGP_ESH_Mode
          BswMModeInitValue
            BswMSwcModeInitValue: BswMSwcModeInitValueRef=STARTUP
        3 x BswMLogicalExpression:
          ESH_LE_NoRunAndNoKillAllRequest: BswMLogicalOperator=BSWM_OR, BswMArgumentRef=ESH_LE_NoRunReasons
          ESH_LE_NoRunReasons: BswMLogicalOperator=BSWM_AND, BswMArgumentRef=ESH_LE_AllChannelsNoCom, BswMArgumentRef=ESH_LE_RunReleased, BswMArgumentRef=Cond_ESH_EcuMRequest_RUN_EQ_ECUM_RUNSTATUS_RELEASED, BswMArgumentRef=ESH_Cond_SelfRunReqTimerExpired
          ESH_LE_RunReleased: BswMLogicalOperator=BSWM_AND, BswMArgumentRef=ESH_Cond_RunRequest0IsReleased
        ESH_Cond_RunRequest0IsReleased (BswMModeCondition): BswMConditionType=BSWM_EQUALS, BswMConditionMode=ESH_RunRequest_0
          BswMConditionValue
            BswMModeDeclaration: BswMModeValueRef=RELEASED
        ESH_RunRequest_0 (BswMModeRequestPort): BswMArbitrateOnInit=false, BswMRequestProcessing=BSWM_DEFERRED
          BswMModeRequestSource
            BswMSwcModeRequest: BswMModeRequestDataElementPrototypeName=requestedMode, BswMSwcModeRequestModeDeclarationGroupPrototypeRef=BswM_MDGP_ESH_RunRequest
          BswMModeInitValue
            BswMSwcModeInitValue: BswMSwcModeInitValueRef=RELEASED
        ESH_Cond_SelfRunReqTimerExpired (BswMModeCondition): BswMConditionType=BSWM_EQUALS, BswMConditionMode=ESH_SelfRunRequestTimer
          BswMConditionValue
            BswMBswMode: BswMBswRequestedMode=BSWM_TIMER_EXPIRED
        ESH_SelfRunRequestTimer (BswMModeRequestPort): BswMArbitrateOnInit=false, BswMRequestProcessing=BSWM_DEFERRED
          BswMModeRequestSource
            BswMTimer
          BswMModeInitValue
            BswMBswModeInitValue: BswMBswModeInitValueMode=BSWM_TIMER_STOPPED
        ESH_WaitToShutdown (BswMRule):
          BswMNestedExecutionOnly = false
          BswMRuleId = 10
          BswMRuleInitState = BSWM_FALSE
          BswMRuleExpressionRef = ESH_LE_WaitForNvMToShutdown
          BswMRuleTrueActionList = ESH_AL_WaitForNvMToShutdown
        ESH_LE_WaitForNvMToShutdown (BswMLogicalExpression): BswMLogicalOperator=BSWM_AND, BswMArgumentRef=ESH_Cond_StateIsWaitForNvm, BswMArgumentRef=ESH_LE_NoWakeupOrKillAll
        ESH_Cond_StateIsWaitForNvm (BswMModeCondition): BswMConditionType=BSWM_EQUALS, BswMConditionMode=ESH_State
          BswMConditionValue
            BswMBswMode: BswMBswRequestedMode=ESH_WAIT_FOR_NVM
        ESH_LE_NoWakeupOrKillAll (BswMLogicalExpression): BswMLogicalOperator=BSWM_OR, BswMArgumentRef=ESH_LE_NoWakeup
        ESH_LE_NoWakeup (BswMLogicalExpression): BswMLogicalOperator=BSWM_AND, BswMArgumentRef=ESH_Cond_NoValidatedWakeups, BswMArgumentRef=ESH_Cond_ComMNoPendingRequests
        ESH_Cond_NoValidatedWakeups (BswMModeCondition): BswMConditionType=BSWM_EQUALS, BswMConditionMode=ESH_EcuM_GetValidatedWakeupEvents
          BswMConditionValue
            BswMBswMode: BswMBswRequestedMode=0
        ESH_EcuM_GetValidatedWakeupEvents (BswMModeRequestPort): BswMArbitrateOnInit=false, BswMRequestProcessing=BSWM_DEFERRED
          BswMModeRequestSource
            BswMUserConditionRequest: BswMUserCondition=EcuM_GetValidatedWakeupEvents()
        ESH_WakeupToPrep (BswMRule):
          BswMNestedExecutionOnly = false
          BswMRuleId = 12
          BswMRuleInitState = BSWM_FALSE
          BswMRuleExpressionRef = ESH_LE_WakeupToPrepShutdown
          BswMRuleTrueActionList = ESH_AL_WakeupToPrep
        ESH_LE_WakeupToPrepShutdown (BswMLogicalExpression):
          BswMLogicalOperator = BSWM_AND
          BswMArgumentRef = ESH_Cond_StateIsWakeup
          BswMArgumentRef = ESH_Cond_NoPendingWakeups
          BswMArgumentRef = ESH_LE_NoWakeup
          BswMArgumentRef = ESH_Cond_ModeIsWakeup
        ESH_Cond_StateIsWakeup (BswMModeCondition): BswMConditionType=BSWM_EQUALS, BswMConditionMode=ESH_State
          BswMConditionValue
            BswMBswMode: BswMBswRequestedMode=ESH_WAKEUP
        ESH_Cond_NoPendingWakeups (BswMModeCondition): BswMConditionType=BSWM_EQUALS, BswMConditionMode=ESH_EcuM_GetPendingWakeupEvents
          BswMConditionValue
            BswMBswMode: BswMBswRequestedMode=0
        ESH_EcuM_GetPendingWakeupEvents (BswMModeRequestPort): BswMArbitrateOnInit=false, BswMRequestProcessing=BSWM_DEFERRED
          BswMModeRequestSource
            BswMUserConditionRequest: BswMUserCondition=EcuM_GetPendingWakeupEvents()
        ESH_Cond_ModeIsWakeup (BswMModeCondition): BswMConditionType=BSWM_EQUALS, BswMConditionMode=ESH_ModeNotification
          BswMConditionValue
            BswMModeDeclaration: BswMModeValueRef=WAKEUP
        ESH_WaitToWakeup (BswMRule):
          BswMNestedExecutionOnly = false
          BswMRuleId = 11
          BswMRuleInitState = BSWM_FALSE
          BswMRuleExpressionRef = ESH_LE_WaitForNvMToWakeup
          BswMRuleTrueActionList = ESH_AL_WaitForNvMWakeup
        ESH_LE_WaitForNvMToWakeup (BswMLogicalExpression): BswMLogicalOperator=BSWM_AND, BswMArgumentRef=ESH_Cond_StateIsWaitForNvm, BswMArgumentRef=ESH_LE_ValidWakeup
        ESH_LE_ValidWakeup (BswMLogicalExpression): BswMLogicalOperator=BSWM_OR, BswMArgumentRef=ESH_Cond_ValidatedWakeups, BswMArgumentRef=ESH_Cond_ComMPendingRequests
        ESH_Cond_ValidatedWakeups (BswMModeCondition): BswMConditionType=BSWM_EQUALS_NOT, BswMConditionMode=ESH_EcuM_GetValidatedWakeupEvents
          BswMConditionValue
            BswMBswMode: BswMBswRequestedMode=0
        ESH_WakeupToRun (BswMRule):
          BswMNestedExecutionOnly = false
          BswMRuleId = 13
          BswMRuleInitState = BSWM_FALSE
          BswMRuleExpressionRef = ESH_LE_WakeupToRun
          BswMRuleTrueActionList = ESH_AL_WakeupToRun
        ESH_LE_WakeupToRun (BswMLogicalExpression): BswMLogicalOperator=BSWM_AND, BswMArgumentRef=ESH_Cond_StateIsWakeup, BswMArgumentRef=ESH_LE_ValidWakeup, BswMArgumentRef=ESH_Cond_ModeIsWakeup
        ESH_InitToWakeup (BswMRule):
          BswMNestedExecutionOnly = false
          BswMRuleId = 3
          BswMRuleInitState = BSWM_FALSE
          BswMRuleExpressionRef = ESH_LE_InitToWakeup
          BswMRuleTrueActionList = ESH_AL_InitToWakeup
        ESH_LE_InitToWakeup (BswMLogicalExpression): BswMLogicalOperator=BSWM_AND, BswMArgumentRef=ESH_Cond_StateIsInit, BswMArgumentRef=Cond_ESH_EcuMState_EQ_ECUM_STATE_STARTUP
        ESH_Cond_StateIsInit (BswMModeCondition): BswMConditionType=BSWM_EQUALS, BswMConditionMode=ESH_State
          BswMConditionValue
            BswMBswMode: BswMBswRequestedMode=ESH_INIT
        ESH_PostRunToPrepNested (BswMRule):
          BswMNestedExecutionOnly = true
          BswMRuleId = 6
          BswMRuleInitState = BSWM_FALSE
          BswMRuleExpressionRef = ESH_LE_PostRunToPrep
          BswMRuleTrueActionList = ESH_AL_PostRunToPrepShutdown
        ESH_LE_PostRunToPrep (BswMLogicalExpression): BswMLogicalOperator=BSWM_OR, BswMArgumentRef=ESH_LE_PostRunReleased
        ESH_LE_PostRunReleased (BswMLogicalExpression):
          BswMLogicalOperator = BSWM_AND
          BswMArgumentRef = ESH_Cond_PostRunRequest0IsReleased
          BswMArgumentRef = Cond_ESH_EcuMRequest_POSTRUN_EQ_ECUM_RUNSTATUS_RELEASED
        ESH_Cond_PostRunRequest0IsReleased (BswMModeCondition): BswMConditionType=BSWM_EQUALS, BswMConditionMode=ESH_PostRunRequest_0
          BswMConditionValue
            BswMModeDeclaration: BswMModeValueRef=RELEASED
        ESH_PostRunRequest_0 (BswMModeRequestPort): BswMArbitrateOnInit=false, BswMRequestProcessing=BSWM_DEFERRED
          BswMModeRequestSource
            BswMSwcModeRequest: BswMModeRequestDataElementPrototypeName=requestedMode, BswMSwcModeRequestModeDeclarationGroupPrototypeRef=BswM_MDGP_ESH_RunRequest
          BswMModeInitValue
            BswMSwcModeInitValue: BswMSwcModeInitValueRef=RELEASED
        ESH_PostRunNested (BswMRule):
          BswMNestedExecutionOnly = true
          BswMRuleId = 5
          BswMRuleInitState = BSWM_FALSE
          BswMRuleExpressionRef = ESH_LE_PostRunToRun
          BswMRuleFalseActionList = ESH_AL_ESH_PostRunToPrepCheck
          BswMRuleTrueActionList = ESH_AL_PostRunToRun
        3 x BswMLogicalExpression:
          ESH_LE_PostRunToRun: BswMLogicalOperator=BSWM_AND, BswMArgumentRef=ESH_LE_RunRequestsOrWakeup
          ESH_LE_RunRequestsOrWakeup: BswMLogicalOperator=BSWM_OR, BswMArgumentRef=ESH_LE_RunRequested, BswMArgumentRef=Cond_ESH_EcuMRequest_RUN_EQ_ECUM_RUNSTATUS_REQUESTED, BswMArgumentRef=ESH_LE_ValidWakeup
          ESH_LE_RunRequested: BswMLogicalOperator=BSWM_OR, BswMArgumentRef=ESH_Cond_RunRequest0IsRequested
        ESH_Cond_RunRequest0IsRequested (BswMModeCondition): BswMConditionType=BSWM_EQUALS, BswMConditionMode=ESH_RunRequest_0
          BswMConditionValue
            BswMModeDeclaration: BswMModeValueRef=REQUESTED
        ESH_PostRun (BswMRule):
          BswMNestedExecutionOnly = false
          BswMRuleId = 4
          BswMRuleInitState = BSWM_FALSE
          BswMRuleExpressionRef = ESH_LE_PostRun
          BswMRuleTrueActionList = ESH_AL_ExitPostRun
        ESH_LE_PostRun (BswMLogicalExpression):
          BswMLogicalOperator = BSWM_AND
          BswMArgumentRef = ESH_Cond_StateIsPostRun
          BswMArgumentRef = ESH_Cond_ModeIsPostRun
          BswMArgumentRef = Cond_ESH_EcuMState_EQ_ECUM_STATE_APP_POST_RUN
        ESH_Cond_StateIsPostRun (BswMModeCondition): BswMConditionType=BSWM_EQUALS, BswMConditionMode=ESH_State
          BswMConditionValue
            BswMBswMode: BswMBswRequestedMode=ESH_POST_RUN
        ESH_Cond_ModeIsPostRun (BswMModeCondition): BswMConditionType=BSWM_EQUALS, BswMConditionMode=ESH_ModeNotification
          BswMConditionValue
            BswMModeDeclaration: BswMModeValueRef=POSTRUN
        ESH_PrepToWait (BswMRule):
          BswMNestedExecutionOnly = false
          BswMRuleId = 7
          BswMRuleInitState = BSWM_FALSE
          BswMRuleExpressionRef = ESH_LE_PrepShutdownToWaitForNvM
          BswMRuleTrueActionList = ESH_AL_PrepShutdownToWaitForNvM
        ESH_LE_PrepShutdownToWaitForNvM (BswMLogicalExpression):
          BswMLogicalOperator = BSWM_AND
          BswMArgumentRef = ESH_Cond_StateIsPrepShutdown
          BswMArgumentRef = ESH_Cond_ModeIsShutdown
          BswMArgumentRef = ESH_LE_EcuMStateSleepOrShutdown
        3 x BswMModeCondition, all with BswMConditionType=BSWM_EQUALS:
          ESH_Cond_StateIsPrepShutdown: BswMConditionMode=ESH_State
            BswMConditionValue
              BswMBswMode: BswMBswRequestedMode=ESH_PREP_SHUTDOWN
          ESH_Cond_ModeIsShutdown: BswMConditionMode=ESH_ModeNotification
            BswMConditionValue
              BswMModeDeclaration: BswMModeValueRef=SHUTDOWN
          Cond_ESH_EcuMState_EQ_ECUM_STATE_APP_RUN: BswMConditionMode=ESH_EcuMState
            BswMConditionValue
              BswMBswMode: BswMBswRequestedMode=ECUM_STATE_APP_RUN
        ESH_EcuMState (BswMModeRequestPort): BswMArbitrateOnInit=false, BswMRequestProcessing=BSWM_DEFERRED
          BswMModeRequestSource
            BswMEcuMIndication
          BswMModeInitValue
            BswMBswModeInitValue: BswMBswModeInitValueMode=ECUM_STATE_OFF
        ESH_LE_AllChannelsNoCom (BswMLogicalExpression): BswMLogicalOperator=BSWM_AND, BswMArgumentRef=ESH_Cond_NoComOn_CN_CAN00_5e566ad9
        ESH_Cond_NoComOn_CN_CAN00_5e566ad9 (BswMModeCondition): BswMConditionType=BSWM_EQUALS, BswMConditionMode=ESH_ComMIndication_CN_CAN00_5e566ad9
          BswMConditionValue
            BswMBswMode: BswMBswRequestedMode=COMM_NO_COMMUNICATION
        ESH_ComMIndication_CN_CAN00_5e566ad9 (BswMModeRequestPort): BswMArbitrateOnInit=false, BswMRequestProcessing=BSWM_DEFERRED
          BswMModeRequestSource
            BswMComMIndication: BswMComMChannelRef=CN_CAN00_5e566ad9
          BswMModeInitValue
            BswMBswModeInitValue: BswMBswModeInitValueMode=COMM_NO_COMMUNICATION
        Cond_ESH_EcuMRequest_RUN_EQ_ECUM_RUNSTATUS_RELEASED (BswMModeCondition): BswMConditionType=BSWM_EQUALS, BswMConditionMode=ESH_EcuMRequest_RUN
          BswMConditionValue
            BswMBswMode: BswMBswRequestedMode=ECUM_RUNSTATUS_RELEASED
        ESH_EcuMRequest_RUN (BswMModeRequestPort): BswMArbitrateOnInit=false, BswMRequestProcessing=BSWM_DEFERRED
          BswMModeRequestSource
            BswMEcuMRUNRequestIndication: BswMEcuMRUNRequestProtocolPort=RUN
          BswMModeInitValue
            BswMBswModeInitValue: BswMBswModeInitValueMode=ECUM_RUNSTATUS_RELEASED
        ESH_RunToPostRunNested (BswMRule):
          BswMNestedExecutionOnly = true
          BswMRuleId = 9
          BswMRuleInitState = BSWM_FALSE
          BswMRuleExpressionRef = ESH_LE_ComMNoPendingRequests
          BswMRuleTrueActionList = ESH_AL_RunToPostRun
        ESH_LE_ComMNoPendingRequests (BswMLogicalExpression): BswMLogicalOperator=BSWM_OR, BswMArgumentRef=ESH_Cond_ComMNoPendingRequests
        ESH_Cond_ComMNoPendingRequests (BswMModeCondition): BswMConditionType=BSWM_EQUALS, BswMConditionMode=ESH_ComMPendingRequests
          BswMConditionValue
            BswMBswMode: BswMBswRequestedMode=ESH_COMM_NO_REQUEST
        ESH_ComMPendingRequests (BswMModeRequestPort): BswMArbitrateOnInit=false, BswMRequestProcessing=BSWM_DEFERRED
          BswMModeRequestSource
            BswMGenericRequest: BswMModeRequesterId=232, BswMRequestedModeMax=2
              ESH_COMM_NO_REQUEST (BswMGenericRequestMode): BswMGenericRequestModeValue=0
              ESH_COMM_PENDING_REQUEST (BswMGenericRequestMode): BswMGenericRequestModeValue=1
          BswMModeInitValue
            BswMBswModeInitValue: BswMBswModeInitValueMode=ESH_COMM_NO_REQUEST
        3 x BswMModeCondition, all with BswMConditionType=BSWM_EQUALS:
          ESH_Cond_ComMPendingRequests: BswMConditionMode=ESH_ComMPendingRequests
            BswMConditionValue
              BswMBswMode: BswMBswRequestedMode=ESH_COMM_PENDING_REQUEST
          Cond_ESH_EcuMState_EQ_ECUM_STATE_STARTUP: BswMConditionMode=ESH_EcuMState
            BswMConditionValue
              BswMBswMode: BswMBswRequestedMode=ECUM_STATE_STARTUP
          Cond_ESH_EcuMRequest_POSTRUN_EQ_ECUM_RUNSTATUS_RELEASED: BswMConditionMode=ESH_EcuMRequest_POSTRUN
            BswMConditionValue
              BswMBswMode: BswMBswRequestedMode=ECUM_RUNSTATUS_RELEASED
        ESH_EcuMRequest_POSTRUN (BswMModeRequestPort): BswMArbitrateOnInit=false, BswMRequestProcessing=BSWM_DEFERRED
          BswMModeRequestSource
            BswMEcuMRUNRequestIndication: BswMEcuMRUNRequestProtocolPort=POST_RUN
          BswMModeInitValue
            BswMBswModeInitValue: BswMBswModeInitValueMode=ECUM_RUNSTATUS_RELEASED
        Cond_ESH_EcuMRequest_RUN_EQ_ECUM_RUNSTATUS_REQUESTED (BswMModeCondition): BswMConditionType=BSWM_EQUALS, BswMConditionMode=ESH_EcuMRequest_RUN
          BswMConditionValue
            BswMBswMode: BswMBswRequestedMode=ECUM_RUNSTATUS_REQUESTED
        Cond_ESH_EcuMState_EQ_ECUM_STATE_APP_POST_RUN (BswMModeCondition): BswMConditionType=BSWM_EQUALS, BswMConditionMode=ESH_EcuMState
          BswMConditionValue
            BswMBswMode: BswMBswRequestedMode=ECUM_STATE_APP_POST_RUN
        ESH_LE_EcuMStateSleepOrShutdown (BswMLogicalExpression): BswMLogicalOperator=BSWM_OR, BswMArgumentRef=Cond_ESH_EcuMState_EQ_ECUM_STATE_SHUTDOWN, BswMArgumentRef=Cond_ESH_EcuMState_EQ_ECUM_STATE_SLEEP
        Cond_ESH_EcuMState_EQ_ECUM_STATE_SHUTDOWN (BswMModeCondition): BswMConditionType=BSWM_EQUALS, BswMConditionMode=ESH_EcuMState
          BswMConditionValue
            BswMBswMode: BswMBswRequestedMode=ECUM_STATE_SHUTDOWN
        Cond_ESH_EcuMState_EQ_ECUM_STATE_SLEEP (BswMModeCondition): BswMConditionType=BSWM_EQUALS, BswMConditionMode=ESH_EcuMState
          BswMConditionValue
            BswMBswMode: BswMBswRequestedMode=ECUM_STATE_SLEEP
      BswMModeControl: BswMInitActionListRef=INIT_AL_Initialize
        INIT_AL_Initialize (BswMActionList): BswMActionListExecution=BSWM_CONDITION
          11 x BswMActionListItem, all with BswMAbortOnFail=false:
            INIT_Action_Det_Init: BswMActionListItemIndex=0, BswMActionListItemRef=BswMModeControl/INIT_Action_Det_Init
            INIT_Action_Can_Init: BswMActionListItemIndex=1, BswMActionListItemRef=BswMModeControl/INIT_Action_Can_Init
            INIT_Action_CanIf_Init: BswMActionListItemIndex=2, BswMActionListItemRef=BswMModeControl/INIT_Action_CanIf_Init
            INIT_Action_Com_Init: BswMActionListItemIndex=3, BswMActionListItemRef=BswMModeControl/INIT_Action_Com_Init
            INIT_Action_PduR_Init: BswMActionListItemIndex=4, BswMActionListItemRef=BswMModeControl/INIT_Action_PduR_Init
            INIT_Action_CanSM_Init: BswMActionListItemIndex=5, BswMActionListItemRef=BswMModeControl/INIT_Action_CanSM_Init
            INIT_Action_EnableInterrupts: BswMActionListItemIndex=8, BswMActionListItemRef=BswMModeControl/INIT_Action_EnableInterrupts
            INIT_Action_ComM_Init: BswMActionListItemIndex=9, BswMActionListItemRef=BswMModeControl/INIT_Action_ComM_Init
            INIT_Action_Rte_Start: BswMActionListItemIndex=10, BswMActionListItemRef=BswMModeControl/INIT_Action_Rte_Start
            INIT_Action_CanNm_Init: BswMActionListItemIndex=6, BswMActionListItemRef=BswMModeControl/INIT_Action_CanNm_Init
            INIT_Action_Nm_Init: BswMActionListItemIndex=7, BswMActionListItemRef=BswMModeControl/INIT_Action_Nm_Init
        9 x BswMAction:
          INIT_Action_Det_Init
            BswMAvailableActions
              BswMUserCallout: BswMUserCalloutFunction=Det_Init(Det_Config_Ptr), BswMCreateCallout=false, BswMUserIncludeFile=Det.h
          INIT_Action_Can_Init
            BswMAvailableActions
              BswMUserCallout: BswMUserCalloutFunction=Can_Init(Can_Config_Ptr), BswMCreateCallout=false, BswMUserIncludeFile=Can.h
          INIT_Action_CanIf_Init
            BswMAvailableActions
              BswMUserCallout: BswMUserCalloutFunction=CanIf_Init(CanIf_Config_Ptr), BswMCreateCallout=false, BswMUserIncludeFile=CanIf.h
          INIT_Action_Com_Init
            BswMAvailableActions
              BswMUserCallout: BswMUserCalloutFunction=Com_Init(Com_Config_Ptr), BswMCreateCallout=false, BswMUserIncludeFile=Com.h
          INIT_Action_PduR_Init
            BswMAvailableActions
              BswMUserCallout: BswMUserCalloutFunction=PduR_Init(PduR_Config_Ptr), BswMCreateCallout=false, BswMUserIncludeFile=PduR.h
          INIT_Action_CanSM_Init
            BswMAvailableActions
              BswMUserCallout: BswMUserCalloutFunction=CanSM_Init(CanSM_Config_Ptr), BswMCreateCallout=false, BswMUserIncludeFile=CanSM_EcuM.h
          INIT_Action_EnableInterrupts
            BswMAvailableActions
              BswMUserCallout: BswMUserCalloutFunction=BswM_AL_SetProgrammableInterrupts(), BswMCreateCallout=true
          INIT_Action_ComM_Init
            BswMAvailableActions
              BswMUserCallout: BswMUserCalloutFunction=ComM_Init(), BswMCreateCallout=false, BswMUserIncludeFile=ComM.h
          INIT_Action_Rte_Start
            BswMAvailableActions
              BswMUserCallout: BswMUserCalloutFunction=Rte_Start(), BswMCreateCallout=false, BswMUserIncludeFile=Rte_Main.h
        CC_AL_CN_CAN00_5e566ad9_RX_Disable (BswMActionList): BswMActionListExecution=BSWM_TRIGGER
          CC_DisablePDUGroup_MyECU_oCAN00_Rx_4cbf71f7 (BswMActionListItem): BswMAbortOnFail=false, BswMActionListItemIndex=0, BswMActionListItemRef=BswMModeControl/CC_DisablePDUGroup_MyECU_oCAN00_Rx_4cbf71f7
        CC_DisablePDUGroup_MyECU_oCAN00_Rx_4cbf71f7 (BswMAction)
          BswMAvailableActions
            BswMPduGroupSwitch: BswMPduGroupSwitchReinit=false, BswMDisabledPduGroupRef=MyECU_oCAN00_Rx_4cbf71f7
        CC_AL_CN_CAN00_5e566ad9_RX_EnableNoinit (BswMActionList): BswMActionListExecution=BSWM_TRIGGER
          CC_EnablePDUGroup_MyECU_oCAN00_Rx_4cbf71f7 (BswMActionListItem): BswMAbortOnFail=false, BswMActionListItemIndex=0, BswMActionListItemRef=BswMModeControl/CC_EnablePDUGroup_MyECU_oCAN00_Rx_4cbf71f7
        CC_EnablePDUGroup_MyECU_oCAN00_Rx_4cbf71f7 (BswMAction)
          BswMAvailableActions
            BswMPduGroupSwitch: BswMPduGroupSwitchReinit=false, BswMEnabledPduGroupRef=MyECU_oCAN00_Rx_4cbf71f7
        CC_AL_CN_CAN00_5e566ad9_TX_Disable (BswMActionList): BswMActionListExecution=BSWM_TRIGGER
          CC_DisablePDUGroup_MyECU_oCAN00_Tx_1ae5d671 (BswMActionListItem): BswMAbortOnFail=false, BswMActionListItemIndex=0, BswMActionListItemRef=BswMModeControl/CC_DisablePDUGroup_MyECU_oCAN00_Tx_1ae5d671
        CC_DisablePDUGroup_MyECU_oCAN00_Tx_1ae5d671 (BswMAction)
          BswMAvailableActions
            BswMPduGroupSwitch: BswMPduGroupSwitchReinit=false, BswMDisabledPduGroupRef=MyECU_oCAN00_Tx_1ae5d671
        CC_AL_CN_CAN00_5e566ad9_TX_EnableNoinit (BswMActionList): BswMActionListExecution=BSWM_TRIGGER
          CC_EnablePDUGroup_MyECU_oCAN00_Tx_1ae5d671 (BswMActionListItem): BswMAbortOnFail=false, BswMActionListItemIndex=0, BswMActionListItemRef=BswMModeControl/CC_EnablePDUGroup_MyECU_oCAN00_Tx_1ae5d671
        CC_EnablePDUGroup_MyECU_oCAN00_Tx_1ae5d671 (BswMAction)
          BswMAvailableActions
            BswMPduGroupSwitch: BswMPduGroupSwitchReinit=false, BswMEnabledPduGroupRef=MyECU_oCAN00_Tx_1ae5d671
        CC_AL_CN_CAN00_5e566ad9_Disable_DM (BswMActionList): BswMActionListExecution=BSWM_TRIGGER
          CC_DisableDM_MyECU_oCAN00_Rx_4cbf71f7 (BswMActionListItem): BswMAbortOnFail=false, BswMActionListItemIndex=0, BswMActionListItemRef=BswMModeControl/CC_DisableDM_MyECU_oCAN00_Rx_4cbf71f7
        CC_DisableDM_MyECU_oCAN00_Rx_4cbf71f7 (BswMAction)
          BswMAvailableActions
            BswMDeadlineMonitoringControl: BswMDisabledDMPduGroupRef=MyECU_oCAN00_Rx_4cbf71f7
        CC_AL_CN_CAN00_5e566ad9_Enable_DM (BswMActionList): BswMActionListExecution=BSWM_TRIGGER
          CC_EnableDM_MyECU_oCAN00_Rx_4cbf71f7 (BswMActionListItem): BswMAbortOnFail=false, BswMActionListItemIndex=0, BswMActionListItemRef=BswMModeControl/CC_EnableDM_MyECU_oCAN00_Rx_4cbf71f7
        3 x BswMAction:
          CC_EnableDM_MyECU_oCAN00_Rx_4cbf71f7
            BswMAvailableActions
              BswMDeadlineMonitoringControl: BswMEnabledDMPduGroupRef=MyECU_oCAN00_Rx_4cbf71f7
          INIT_Action_CanNm_Init
            BswMAvailableActions
              BswMUserCallout: BswMUserCalloutFunction=CanNm_Init(CanNm_Config_Ptr), BswMCreateCallout=false, BswMUserIncludeFile=CanNm.h
          INIT_Action_Nm_Init
            BswMAvailableActions
              BswMUserCallout: BswMUserCalloutFunction=Nm_Init(), BswMCreateCallout=false, BswMUserIncludeFile=Nm.h
        ESH_AL_RunToPostRun (BswMActionList): BswMActionListExecution=BSWM_CONDITION
          6 x BswMActionListItem, all with BswMAbortOnFail=false:
            ESH_Action_EcuMClearValidatedWakeupEvents: BswMActionListItemIndex=1, BswMActionListItemRef=BswMModeControl/ESH_Action_EcuMClearValidatedWakeupEvents
            ESH_Action_OnEnterPostRun: BswMActionListItemIndex=2, BswMActionListItemRef=BswMModeControl/ESH_Action_OnEnterPostRun
            ESH_Action_SwitchPostRun: BswMActionListItemIndex=4, BswMActionListItemRef=BswMModeControl/ESH_Action_SwitchPostRun
            ESH_Action_ESH_PostRun: BswMActionListItemIndex=5, BswMActionListItemRef=BswMModeControl/ESH_Action_ESH_PostRun
            ESH_Action_ComMDisallow_CN_CAN00_5e566ad9: BswMActionListItemIndex=0, BswMActionListItemRef=BswMModeControl/ESH_Action_ComMDisallow_CN_CAN00_5e566ad9
            SwitchEcuMStateTo_POST_RUN: BswMActionListItemIndex=3, BswMActionListItemRef=BswMModeControl/SwitchEcuMStateTo_POST_RUN
        3 x BswMAction:
          ESH_Action_EcuMClearValidatedWakeupEvents
            BswMAvailableActions
              BswMUserCallout: BswMUserCalloutFunction=EcuM_ClearValidatedWakeupEvent(ECUM_WKSOURCE_ALL_SOURCES), BswMCreateCallout=false, BswMUserIncludeFile=EcuM.h
          ESH_Action_OnEnterPostRun
            BswMAvailableActions
              BswMUserCallout: BswMUserCalloutFunction=BswM_ESH_OnEnterPostRun(), BswMCreateCallout=true
          ESH_Action_SwitchPostRun
            BswMAvailableActions
              BswMRteSwitch: BswMSwitchedMode=POSTRUN, BswMRteSwitchPortRef=ESH_ModeSwitch
        ESH_ModeSwitch (BswMSwitchPort): BswMModeSwitchInterfaceRef=BswM_MSI_ESH_Mode
        ESH_Action_ESH_PostRun (BswMAction)
          BswMAvailableActions
            BswMGenericModeSwitch: BswMGenericRequestRef=ESH_State, BswMGenericRequestModeRef=ESH_POST_RUN
        ESH_AL_WaitForNvMToShutdown (BswMActionList): BswMActionListExecution=BSWM_CONDITION
          ESH_Action_OnEnterShutdown (BswMActionListItem): BswMAbortOnFail=false, BswMActionListItemIndex=0, BswMActionListItemRef=BswMModeControl/ESH_Action_OnEnterShutdown
          ESH_Action_EcuMGoToSelectedShutdownTarget (BswMActionListItem): BswMAbortOnFail=false, BswMActionListItemIndex=1, BswMActionListItemRef=BswMModeControl/ESH_Action_EcuMGoToSelectedShutdownTarget
        ESH_Action_OnEnterShutdown (BswMAction)
          BswMAvailableActions
            BswMUserCallout: BswMUserCalloutFunction=BswM_ESH_OnEnterShutdown(), BswMCreateCallout=true
        ESH_Action_EcuMGoToSelectedShutdownTarget (BswMAction)
          BswMAvailableActions
            BswMUserCallout: BswMUserCalloutFunction=(void)EcuM_GoToSelectedShutdownTarget(), BswMCreateCallout=false, BswMUserIncludeFile=EcuM.h
        ESH_AL_WakeupToPrep (BswMActionList): BswMActionListExecution=BSWM_CONDITION
          4 x BswMActionListItem, all with BswMAbortOnFail=false:
            ESH_Action_OnEnterPrepShutdown: BswMActionListItemIndex=0, BswMActionListItemRef=BswMModeControl/ESH_Action_OnEnterPrepShutdown
            ESH_Action_SwitchShutdown: BswMActionListItemIndex=2, BswMActionListItemRef=BswMModeControl/ESH_Action_SwitchShutdown
            ESH_Action_ESH_PrepShutdown: BswMActionListItemIndex=3, BswMActionListItemRef=BswMModeControl/ESH_Action_ESH_PrepShutdown
            SwitchEcuMStateTo_SHUTDOWN: BswMActionListItemIndex=1, BswMActionListItemRef=BswMModeControl/SwitchEcuMStateTo_SHUTDOWN
        3 x BswMAction:
          ESH_Action_OnEnterPrepShutdown
            BswMAvailableActions
              BswMUserCallout: BswMUserCalloutFunction=BswM_ESH_OnEnterPrepShutdown(), BswMCreateCallout=true
          ESH_Action_SwitchShutdown
            BswMAvailableActions
              BswMRteSwitch: BswMSwitchedMode=SHUTDOWN, BswMRteSwitchPortRef=ESH_ModeSwitch
          ESH_Action_ESH_PrepShutdown
            BswMAvailableActions
              BswMGenericModeSwitch: BswMGenericRequestRef=ESH_State, BswMGenericRequestModeRef=ESH_PREP_SHUTDOWN
        ESH_AL_WaitForNvMWakeup (BswMActionList): BswMActionListExecution=BSWM_CONDITION
          3 x BswMActionListItem, all with BswMAbortOnFail=false:
            ESH_Action_OnEnterWakeup: BswMActionListItemIndex=0, BswMActionListItemRef=BswMModeControl/ESH_Action_OnEnterWakeup
            ESH_Action_SwitchWakeup: BswMActionListItemIndex=1, BswMActionListItemRef=BswMModeControl/ESH_Action_SwitchWakeup
            ESH_Action_ESH_Wakeup: BswMActionListItemIndex=2, BswMActionListItemRef=BswMModeControl/ESH_Action_ESH_Wakeup
        3 x BswMAction:
          ESH_Action_OnEnterWakeup
            BswMAvailableActions
              BswMUserCallout: BswMUserCalloutFunction=BswM_ESH_OnEnterWakeup(), BswMCreateCallout=true
          ESH_Action_SwitchWakeup
            BswMAvailableActions
              BswMRteSwitch: BswMSwitchedMode=WAKEUP, BswMRteSwitchPortRef=ESH_ModeSwitch
          ESH_Action_ESH_Wakeup
            BswMAvailableActions
              BswMGenericModeSwitch: BswMGenericRequestRef=ESH_State, BswMGenericRequestModeRef=ESH_WAKEUP
        ESH_AL_WakeupToRun (BswMActionList): BswMActionListExecution=BSWM_CONDITION
          7 x BswMActionListItem, all with BswMAbortOnFail=false:
            ESH_Action_SelfRunRequestTimer_Start: BswMActionListItemIndex=1, BswMActionListItemRef=BswMModeControl/ESH_Action_SelfRunRequestTimer_Start
            ESH_Action_OnEnterRun: BswMActionListItemIndex=3, BswMActionListItemRef=BswMModeControl/ESH_Action_OnEnterRun
            ESH_Action_SwitchRun: BswMActionListItemIndex=5, BswMActionListItemRef=BswMModeControl/ESH_Action_SwitchRun
            ESH_Action_ESH_Run: BswMActionListItemIndex=6, BswMActionListItemRef=BswMModeControl/ESH_Action_ESH_Run
            Action_BSWM_FULL_COM_CN_DBCNetWork: BswMActionListItemIndex=2, BswMActionListItemRef=BswMModeControl/Action_BSWM_FULL_COM_CN_DBCNetWork
            ESH_Action_ComMAllow_CN_CAN00_5e566ad9: BswMActionListItemIndex=0, BswMActionListItemRef=BswMModeControl/ESH_Action_ComMAllow_CN_CAN00_5e566ad9
            SwitchEcuMStateTo_RUN: BswMActionListItemIndex=4, BswMActionListItemRef=BswMModeControl/SwitchEcuMStateTo_RUN
        4 x BswMAction:
          ESH_Action_SelfRunRequestTimer_Start
            BswMAvailableActions
              BswMTimerControl: BswMTimerAction=BSWM_TIMER_START, BswMTimerValue=0.1, BswMTimerRef=ESH_SelfRunRequestTimer
          ESH_Action_OnEnterRun
            BswMAvailableActions
              BswMUserCallout: BswMUserCalloutFunction=BswM_ESH_OnEnterRun(), BswMCreateCallout=true
          ESH_Action_SwitchRun
            BswMAvailableActions
              BswMRteSwitch: BswMSwitchedMode=RUN, BswMRteSwitchPortRef=ESH_ModeSwitch
          ESH_Action_ESH_Run
            BswMAvailableActions
              BswMGenericModeSwitch: BswMGenericRequestRef=ESH_State, BswMGenericRequestModeRef=ESH_RUN
        6 x BswMActionList, all with BswMActionListExecution=BSWM_CONDITION:
          ESH_AL_InitToWakeup
            3 x BswMActionListItem, all with BswMAbortOnFail=false:
              ESH_Action_OnEnterWakeup: BswMActionListItemIndex=0, BswMActionListItemRef=BswMModeControl/ESH_Action_OnEnterWakeup
              ESH_Action_SwitchWakeup: BswMActionListItemIndex=1, BswMActionListItemRef=BswMModeControl/ESH_Action_SwitchWakeup
              ESH_Action_ESH_Wakeup: BswMActionListItemIndex=2, BswMActionListItemRef=BswMModeControl/ESH_Action_ESH_Wakeup
          ESH_AL_PostRunToPrepShutdown
            4 x BswMActionListItem, all with BswMAbortOnFail=false:
              ESH_Action_OnEnterPrepShutdown: BswMActionListItemIndex=0, BswMActionListItemRef=BswMModeControl/ESH_Action_OnEnterPrepShutdown
              ESH_Action_SwitchShutdown: BswMActionListItemIndex=2, BswMActionListItemRef=BswMModeControl/ESH_Action_SwitchShutdown
              ESH_Action_ESH_PrepShutdown: BswMActionListItemIndex=3, BswMActionListItemRef=BswMModeControl/ESH_Action_ESH_PrepShutdown
              SwitchEcuMStateTo_SHUTDOWN: BswMActionListItemIndex=1, BswMActionListItemRef=BswMModeControl/SwitchEcuMStateTo_SHUTDOWN
          ESH_AL_ESH_PostRunToPrepCheck
            ESH_PostRunToPrepNested (BswMActionListItem): BswMAbortOnFail=false, BswMActionListItemIndex=0, BswMActionListItemRef=BswMArbitration/ESH_PostRunToPrepNested
          ESH_AL_PostRunToRun
            6 x BswMActionListItem, all with BswMAbortOnFail=false:
              ESH_Action_SelfRunRequestTimer_Start: BswMActionListItemIndex=1, BswMActionListItemRef=BswMModeControl/ESH_Action_SelfRunRequestTimer_Start
              ESH_Action_OnEnterRun: BswMActionListItemIndex=2, BswMActionListItemRef=BswMModeControl/ESH_Action_OnEnterRun
              ESH_Action_SwitchRun: BswMActionListItemIndex=4, BswMActionListItemRef=BswMModeControl/ESH_Action_SwitchRun
              ESH_Action_ESH_Run: BswMActionListItemIndex=5, BswMActionListItemRef=BswMModeControl/ESH_Action_ESH_Run
              ESH_Action_ComMAllow_CN_CAN00_5e566ad9: BswMActionListItemIndex=0, BswMActionListItemRef=BswMModeControl/ESH_Action_ComMAllow_CN_CAN00_5e566ad9
              SwitchEcuMStateTo_RUN: BswMActionListItemIndex=3, BswMActionListItemRef=BswMModeControl/SwitchEcuMStateTo_RUN
          ESH_AL_ExitPostRun
            4 x BswMActionListItem, all with BswMAbortOnFail=false:
              ESH_PostRunNested: BswMActionListItemIndex=2, BswMActionListItemRef=BswMArbitration/ESH_PostRunNested
              ESH_Action_EnterExclusiveArea: BswMActionListItemIndex=0, BswMActionListItemRef=BswMModeControl/ESH_Action_EnterExclusiveArea
              ESH_Action_ComMCheckPendingRequests: BswMActionListItemIndex=1, BswMActionListItemRef=BswMModeControl/ESH_Action_ComMCheckPendingRequests
              ESH_Action_ExitExclusiveArea: BswMActionListItemIndex=3, BswMActionListItemRef=BswMModeControl/ESH_Action_ExitExclusiveArea
          ESH_AL_PrepShutdownToWaitForNvM
            3 x BswMActionListItem, all with BswMAbortOnFail=false:
              ESH_Action_OnEnterWaitForNvm: BswMActionListItemIndex=1, BswMActionListItemRef=BswMModeControl/ESH_Action_OnEnterWaitForNvm
              ESH_Action_ESH_WaitForNvm: BswMActionListItemIndex=2, BswMActionListItemRef=BswMModeControl/ESH_Action_ESH_WaitForNvm
              ESH_Action_ComMCheckPendingRequests: BswMActionListItemIndex=0, BswMActionListItemRef=BswMModeControl/ESH_Action_ComMCheckPendingRequests
        3 x BswMAction:
          ESH_Action_OnEnterWaitForNvm
            BswMAvailableActions
              BswMUserCallout: BswMUserCalloutFunction=BswM_ESH_OnEnterWaitForNvm(), BswMCreateCallout=true
          ESH_Action_ESH_WaitForNvm
            BswMAvailableActions
              BswMGenericModeSwitch: BswMGenericRequestRef=ESH_State, BswMGenericRequestModeRef=ESH_WAIT_FOR_NVM
          Action_BSWM_FULL_COM_CN_DBCNetWork
            BswMAvailableActions
              BswMComMModeSwitch: BswMComMRequestedMode=BSWM_FULL_COM, BswMComMUserRef=ComMUser
        ESH_AL_ExitRun (BswMActionList): BswMActionListExecution=BSWM_CONDITION
          4 x BswMActionListItem, all with BswMAbortOnFail=false:
            ESH_Action_EnterExclusiveArea: BswMActionListItemIndex=0, BswMActionListItemRef=BswMModeControl/ESH_Action_EnterExclusiveArea
            ESH_Action_ComMCheckPendingRequests: BswMActionListItemIndex=1, BswMActionListItemRef=BswMModeControl/ESH_Action_ComMCheckPendingRequests
            ESH_RunToPostRunNested: BswMActionListItemIndex=2, BswMActionListItemRef=BswMArbitration/ESH_RunToPostRunNested
            ESH_Action_ExitExclusiveArea: BswMActionListItemIndex=3, BswMActionListItemRef=BswMModeControl/ESH_Action_ExitExclusiveArea
        8 x BswMAction:
          ESH_Action_EnterExclusiveArea
            BswMAvailableActions
              BswMUserCallout: BswMUserCalloutFunction=SchM_Enter_BswM_BSWM_EXCLUSIVE_AREA_0(), BswMCreateCallout=false, BswMUserIncludeFile=SchM_BswM.h
          ESH_Action_ComMCheckPendingRequests
            BswMAvailableActions
              BswMUserCallout:
                BswMUserCalloutFunction = ESH_ComM_CheckPendingRequests()
                BswMCreateCallout = true
                BswMUserCode = ComM_StateType CN_CAN00_5e566ad9 = COMM_NO_COM_NO_PENDING_REQUEST; (void)ComM_GetState(ComMConf_ComMChannel_CN_CAN00_5e566ad9, &CN_CAN00_5e566ad9); /* SBSW_BSWM_FCTCALL_LOCALVAR */ if(CN_CAN00_5e566ad9 != COMM_NO_COM_NO_PENDING_REQUEST) { BswM_RequestMode(BSWM_GENERIC_ESH_ComMPendingRequests, BSWM_GENERICVALUE_ESH_ComMPendingRequests_ESH_COMM_PENDING_REQUEST); } else { BswM_RequestMode(BSWM_GENERIC_ESH_ComMPendingRequests, BSWM_GENERICVALUE_ESH_ComMPendingRequests_ESH_COMM_NO_REQUEST); }
          ESH_Action_ComMDisallow_CN_CAN00_5e566ad9
            BswMAvailableActions
              BswMComMAllowCom: BswMComAllowed=false, BswMComMAllowChannelRef=CN_CAN00_5e566ad9
          SwitchEcuMStateTo_POST_RUN
            BswMAvailableActions
              BswMEcuMStateSwitch: BswMEcuMState=POST_RUN
          ESH_Action_ExitExclusiveArea
            BswMAvailableActions
              BswMUserCallout: BswMUserCalloutFunction=SchM_Exit_BswM_BSWM_EXCLUSIVE_AREA_0(), BswMCreateCallout=false, BswMUserIncludeFile=SchM_BswM.h
          SwitchEcuMStateTo_SHUTDOWN
            BswMAvailableActions
              BswMEcuMStateSwitch: BswMEcuMState=SHUTDOWN
          ESH_Action_ComMAllow_CN_CAN00_5e566ad9
            BswMAvailableActions
              BswMComMAllowCom: BswMComAllowed=true, BswMComMAllowChannelRef=CN_CAN00_5e566ad9
          SwitchEcuMStateTo_RUN
            BswMAvailableActions
              BswMEcuMStateSwitch: BswMEcuMState=RUN
      BswMDataTypeMappingSets: BswMDataTypeMappingSetRef=BswMMappingSet
      4 x BswMRteModeDclGroup:
        ModeDecl_ComFault_State: BswMInitMode=ComFaultPreCond_FAIL
          ComFaultPreCond_PASS (BswMRteMode): BswMModePhysicalValue=1
          ComFaultPreCond_FAIL (BswMRteMode): BswMModePhysicalValue=0
        ModeDecl_ComFault_State_WithKL15: BswMInitMode=ComFaultPreCondWithKL15_FAIL
          ComFaultPreCondWithKL15_FAIL (BswMRteMode): BswMModePhysicalValue=0
          ComFaultPreCondWithKL15_PASS (BswMRteMode): BswMModePhysicalValue=1
        ESH_Mode: BswMInitMode=STARTUP
          5 x BswMRteMode:
            STARTUP: BswMModePhysicalValue=0
            RUN: BswMModePhysicalValue=1
            POSTRUN: BswMModePhysicalValue=2
            WAKEUP: BswMModePhysicalValue=3
            SHUTDOWN: BswMModePhysicalValue=4
        ESH_RunRequest: BswMInitMode=RELEASED
          RELEASED (BswMRteMode): BswMModePhysicalValue=0
          REQUESTED (BswMRteMode): BswMModePhysicalValue=1
    BswMGeneral:
      BswMCanSMEnabled = true
      BswMComMEnabled = true
      BswMDcmEnabled = false
      BswMDevErrorDetect = true
      BswMEcuMEnabled = true
      BswMEthIfEnabled = false
      BswMEthSMEnabled = false
      BswMFrSMEnabled = false
      BswMGenericRequestEnabled = true
      BswMJ1939DcmEnabled = false
      BswMJ1939NmEnabled = false
      BswMLinSMEnabled = false
      BswMLinTPEnabled = false
      BswMNmEnabled = false
      BswMNvMEnabled = false
      BswMPduREnabled = false
      BswMRuleControlEnabled = false
      BswMSdEnabled = false
      BswMVersionInfoApi = false
      BswMWdgMEnabled = false
      BswMModeCheck = true
      BswMActionListQueueSearchAlgorithm = LINEAR_SEARCH
      BswMSafeBswChecks = false
      BswMMainFunctionPeriod = 0.005
      BswMCommonData
      BswMGeneration:
        BswMOutOfBoundsWriteSanitizer = false
        BswMOutOfBoundsReadSanitizer = false
        BswMReduceConstantData2Define = true
        BswMBoolDataInArrayOfStructStrategy = BITMASKING
        BswMInterfacesForDeactivatedData = false
