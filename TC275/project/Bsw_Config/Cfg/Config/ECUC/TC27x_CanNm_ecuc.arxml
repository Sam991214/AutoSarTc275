AUTOSAR XML (schema 00046)
package /ActiveEcuC
  module config CanNm: implementation-config-variant=VARIANT-PRE-COMPILE, module-description=CanNm_Impl
    CanNmGlobalConfig:
      CanNmBusSynchronizationEnabled = false
      CanNmPassiveModeEnabled = false
      CanNmPnEiraCalcEnabled = false
      CanNmRemoteSleepIndEnabled = false
      CanNmUserDataEnabled = true
      CanNmBusLoadReductionEnabled = false
      CanNmComUserDataSupport = false
      CanNmCoordinatorSyncSupport = false
      CanNmDevErrorDetect = false
      CanNmImmediateTxconfEnabled = false
      CanNmMainFunctionPeriod = 0.01
      CanNmPduRxIndicationEnabled = false
      CanNmStateChangeIndEnabled = false
      CanNmVersionInfoApi = false
      CanNmDisableTxErrReport = false
      CanNmApiOptimization = false
      CanNmCanIfRangeConfigDLCCheck = true
      CanNmRuntimeMeasurementSupport = false
      CanNmSafeBswChecks = false
      CAN00_CAN_5faa4e95 (CanNmChannelConfig):
        CanNmMsgCycleOffset = 0
        CanNmMsgReducedTime = 0.05
        CanNmNodeId = 1
        CanNmRepeatMessageTime = 0.4
        CanNmTimeoutTime = 1
        CanNmUserDataLength = 6
        CanNmWaitBusSleepTime = 0.75
        CanNmBusLoadReductionActive = false
        CanNmCarWakeUpRxEnabled = false
        CanNmImmediateNmTransmissions = 5
        CanNmMsgCycleTime = 1
        CanNmMsgTimeoutTime = 0.06
        CanNmPduCbvPosition = CANNM_PDU_BYTE_0
        CanNmPduNidPosition = CANNM_PDU_BYTE_1
        CanNmRemoteSleepIndTime = 0.5
        CanNmActiveWakeupBitEnabled = false
        CanNmNodeIdEnabled = true
        CanNmNodeDetectionEnabled = false
        CanNmRepeatMsgIndEnabled = false
        CanNmImmediateRestartEnabled = false
        CanNmComControlEnabled = false
        CanNmCriBitAlwaysEnabled = false
        CanNmImmediateNmCycleTime = 0.02
        CanNmComMNetworkHandleRef = CN_CAN00_5e566ad9
        CanNmRxPdu: CanNmRxPduId=0, CanNmRxPduRef=msg_nm_MyECU
        CanNmTxPdu: CanNmTxConfirmationPduId=0, CanNmTxPduRef=msg_nm_TX_MyECU_oCAN00_720bbb34_Tx
      CanNmGeneration: CanNmOutOfBoundsWriteSanitizer=false, CanNmOutOfBoundsReadSanitizer=false, CanNmInterfacesForDeactivatedData=false
