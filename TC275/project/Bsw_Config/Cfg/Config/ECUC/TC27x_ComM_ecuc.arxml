AUTOSAR XML (schema 00046)
package /ActiveEcuC
  module config ComM: implementation-config-variant=VARIANT-PRE-COMPILE, module-description=ComM_Impl
    ComMGeneral:
      ComMPncIdCounting = COMM_PNC_ID_COUNT_FROM_NM_MESSAGE
      ComMPncSupport = false
      ComMDevErrorDetect = true
      ComMEcuGroupClassification = 3
      ComMModeLimitationEnabled = false
      ComMSynchronousWakeUp = false
      ComMTMinFullComModeDuration = 5
      ComMVersionInfoApi = false
      ComMWakeupInhibitionEnabled = false
      ComMSafeBswChecks = false
      ComMNmPassiveModeEnable = false
      ComMGeneration: ComMOutOfBoundsWriteSanitizer=false, ComMOutOfBoundsReadSanitizer=false
    ComMConfigSet: ComMPncEnabled=false
      CN_CAN00_5e566ad9 (ComMChannel):
        ComMBusType = COMM_BUS_TYPE_CAN
        ComMChannelId = 0
        ComMFullCommRequestNotificationEnabled = false
        ComMMainFunctionPeriod = 0.02
        ComMNoCom = false
        ComMNoWakeup = false
        ComMGlobalNvmBlockDescriptor = false
        ComMPncGatewayType = COMM_GATEWAY_TYPE_NONE
        ComMNetworkManagement: ComMNmVariant=FULL, ComMPncNmRequest=false
        CN_CAN00_cd7594b0 (ComMUserPerChannel): ComMUserChannel=ComMUser
      ComMUser: ComMUserIdentifier=0, ComMUserModeNotification=false, ComMUserEcucPartitionRef=EcucPartition_ASILB_C0
