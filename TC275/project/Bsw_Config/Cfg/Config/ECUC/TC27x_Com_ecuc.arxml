AUTOSAR XML (schema 00046)
package /ActiveEcuC
  module config Com: implementation-config-variant=VARIANT-PRE-COMPILE, module-description=Com_Impl
    ComConfig: ComConfigurationId=0, ComRxDeferredNotificationCacheSize=0, ComRxImmediateNotificationCacheSize=0
      8 x ComIPdu, all with ComIPduType=NORMAL, ComIPduSignalProcessing=DEFERRED, ComIPduCancellationSupport=false:
        LOCK_Control_oCAN00_c7f57662_Rx: ComIPduDirection=RECEIVE, ComIPduHandleId=0, ComIPduGroupRef=MyECU_oCAN00_Rx_4cbf71f7, ComIPduSignalRef=lock_cmd_oLOCK_Control_oCAN00_cf665a91_Rx, ComPduIdRef=PDUR2COM_lockcontrol
        LOCK_status_oCAN00_02e31e72_Tx: ComIPduDirection=SEND, ComIPduHandleId=0, ComIPduGroupRef=MyECU_oCAN00_Tx_1ae5d671, ComIPduSignalRef=lock_status_oLOCK_status_oCAN00_d69a269d_Tx, ComPduIdRef=COM2PDUR_lockstatus
          ComTxIPdu: ComMinimumDelayTime=0, ComTxIPduUnusedAreasDefault=0
            ComTxModeFalse
              ComTxMode: ComTxModeMode=PERIODIC, ComTxModeTimeOffset=0, ComTxModeTimePeriod=0.1
            ComTxModeTrue
              ComTxMode: ComTxModeMode=PERIODIC, ComTxModeTimeOffset=0, ComTxModeTimePeriod=0.1
        Rear_MyECU_oCAN00_ca7e15e0_Tx: ComIPduDirection=SEND, ComIPduHandleId=1, ComIPduGroupRef=MyECU_oCAN00_Tx_1ae5d671, ComIPduSignalRef=Rear_LeftWindow_oRear_MyECU_oCAN00_0e89810b_Tx, ComIPduSignalRef=Rear_RighttWindow_oRear_MyECU_oCAN00_ce33e81a_Tx, ComPduIdRef=COM2PDUR_Rearmyecu
          ComTxIPdu: ComMinimumDelayTime=0, ComTxIPduUnusedAreasDefault=0
            ComTxModeFalse
              ComTxMode: ComTxModeMode=NONE
            ComTxModeTrue
              ComTxMode: ComTxModeMode=PERIODIC, ComTxModeTimeOffset=0, ComTxModeTimePeriod=0.1
        msg_MyECU_Lamp_oCAN00_818e1651_Tx: ComIPduDirection=SEND, ComIPduHandleId=2, ComIPduGroupRef=MyECU_oCAN00_Tx_1ae5d671, ComIPduSignalRef=sig_LampCnt_omsg_MyECU_Lamp_oCAN00_f37e68ea_Tx, ComPduIdRef=COM2PDUR_lamp
          ComTxIPdu: ComMinimumDelayTime=0, ComTxIPduUnusedAreasDefault=0
            ComTxModeFalse
              ComTxMode: ComTxModeMode=PERIODIC, ComTxModeTimeOffset=0, ComTxModeTimePeriod=0.1
            ComTxModeTrue
              ComTxMode: ComTxModeMode=PERIODIC, ComTxModeTimeOffset=0, ComTxModeTimePeriod=0.1
        msg_Receive2_oCAN00_adb9646b_Rx: ComIPduDirection=RECEIVE, ComIPduHandleId=1, ComIPduGroupRef=MyECU_oCAN00_Rx_4cbf71f7, ComIPduSignalRef=sig_RearLeftWindowPosition_omsg_Receive2_oCAN00_89d4d489_Rx, ComIPduSignalRef=sig_RearRightWindowPosition_omsg_Receive2_oCAN00_94575df2_Rx, ComPduIdRef=PDUR2COM_msg_receive2
        msg_Receive_oCAN00_2b456e3f_Rx: ComIPduDirection=RECEIVE, ComIPduHandleId=2, ComIPduGroupRef=MyECU_oCAN00_Rx_4cbf71f7, ComIPduSignalRef=sig_State_RearInteriorLight_omsg_Receive_oCAN00_63323183_Rx, ComIPduSignalRef=sig_State_RearLeftDoor_omsg_Receive_oCAN00_84ad4140_Rx, ComIPduSignalRef=sig_State_RearRightDoor_omsg_Receive_oCAN00_a8945098_Rx, ComPduIdRef=PDUR2COM_msg_receive
        msg_Transmit2_oCAN00_97205322_Tx: ComIPduDirection=SEND, ComIPduHandleId=3, ComIPduGroupRef=MyECU_oCAN00_Tx_1ae5d671, ComIPduSignalRef=sig_FrongtIntorLight_omsg_Transmit2_oCAN00_db11f0a8_Tx, ComPduIdRef=COM2PDUR_Transmit2
          ComTxIPdu: ComMinimumDelayTime=0, ComTxIPduUnusedAreasDefault=0
            ComTxModeFalse
              ComTxMode: ComTxModeMode=NONE
            ComTxModeTrue
              ComTxMode: ComTxModeMode=PERIODIC, ComTxModeTimeOffset=0, ComTxModeTimePeriod=0.1
        msg_Transmit_oCAN00_0723e95e_Tx: ComIPduDirection=SEND, ComIPduHandleId=4, ComIPduGroupRef=MyECU_oCAN00_Tx_1ae5d671, ComIPduSignalRef=sig_RearInteriorLight_omsg_Transmit_oCAN00_49a633c1_Tx, ComPduIdRef=COM2PDUR_Transmit
          ComTxIPdu: ComMinimumDelayTime=0, ComTxIPduUnusedAreasDefault=0
            ComTxModeFalse
              ComTxMode: ComTxModeMode=PERIODIC, ComTxModeTimeOffset=0, ComTxModeTimePeriod=0.1
            ComTxModeTrue
              ComTxMode: ComTxModeMode=PERIODIC, ComTxModeTimeOffset=0, ComTxModeTimePeriod=0.1
      MyECU_oCAN00_Rx_4cbf71f7 (ComIPduGroup): ComIPduGroupHandleId=0
      MyECU_oCAN00_Tx_1ae5d671 (ComIPduGroup): ComIPduGroupHandleId=1
      12 x ComSignal, all with ComSignalInitValue=0, ComSignalType=UINT8:
        Rear_LeftWindow_oRear_MyECU_oCAN00_0e89810b_Tx: ComBitPosition=0, ComBitSize=1, ComSignalEndianness=LITTLE_ENDIAN, ComTransferProperty=PENDING, ComSignalAccess=ACCESS_NEEDED_BY_OTHER, ComHandleId=0, ComSystemTemplateSystemSignalRef=Rear_LeftWindow
        Rear_RighttWindow_oRear_MyECU_oCAN00_ce33e81a_Tx: ComBitPosition=1, ComBitSize=1, ComSignalEndianness=LITTLE_ENDIAN, ComTransferProperty=PENDING, ComSignalAccess=ACCESS_NEEDED_BY_OTHER, ComHandleId=1, ComSystemTemplateSystemSignalRef=Rear_RighttWindow
        lock_cmd_oLOCK_Control_oCAN00_cf665a91_Rx: ComBitPosition=0, ComBitSize=2, ComSignalEndianness=LITTLE_ENDIAN, ComTimeout=0, ComSignalAccess=ACCESS_NEEDED_BY_SWC_OR_COM, ComHandleId=0, ComSystemTemplateSystemSignalRef=lock_cmd
        lock_status_oLOCK_status_oCAN00_d69a269d_Tx: ComBitPosition=0, ComBitSize=2, ComSignalEndianness=LITTLE_ENDIAN, ComTransferProperty=PENDING, ComSignalAccess=ACCESS_NEEDED_BY_OTHER, ComHandleId=2, ComSystemTemplateSystemSignalRef=lock_status
        sig_FrongtIntorLight_omsg_Transmit2_oCAN00_db11f0a8_Tx: ComBitPosition=0, ComBitSize=1, ComSignalEndianness=LITTLE_ENDIAN, ComTransferProperty=PENDING, ComSignalAccess=ACCESS_NEEDED_BY_OTHER, ComHandleId=3, ComSystemTemplateSystemSignalRef=sig_FrongtIntorLight
        sig_LampCnt_omsg_MyECU_Lamp_oCAN00_f37e68ea_Tx: ComBitPosition=7, ComBitSize=8, ComSignalEndianness=BIG_ENDIAN, ComTransferProperty=PENDING, ComSignalAccess=ACCESS_NEEDED_BY_OTHER, ComHandleId=4, ComSystemTemplateSystemSignalRef=sig_LampCnt
        sig_RearInteriorLight_omsg_Transmit_oCAN00_49a633c1_Tx: ComBitPosition=0, ComBitSize=1, ComSignalEndianness=LITTLE_ENDIAN, ComTransferProperty=PENDING, ComSignalAccess=ACCESS_NEEDED_BY_OTHER, ComHandleId=5, ComSystemTemplateSystemSignalRef=sig_RearInteriorLight
        sig_RearLeftWindowPosition_omsg_Receive2_oCAN00_89d4d489_Rx: ComBitPosition=56, ComBitSize=8, ComSignalEndianness=LITTLE_ENDIAN, ComTimeout=0, ComSignalAccess=ACCESS_NEEDED_BY_OTHER, ComHandleId=1, ComSystemTemplateSystemSignalRef=sig_RearLeftWindowPosition
        sig_RearRightWindowPosition_omsg_Receive2_oCAN00_94575df2_Rx: ComBitPosition=8, ComBitSize=8, ComSignalEndianness=LITTLE_ENDIAN, ComTimeout=0, ComSignalAccess=ACCESS_NEEDED_BY_OTHER, ComHandleId=2, ComSystemTemplateSystemSignalRef=sig_RearRightWindowPosition
        sig_State_RearInteriorLight_omsg_Receive_oCAN00_63323183_Rx: ComBitPosition=2, ComBitSize=1, ComSignalEndianness=LITTLE_ENDIAN, ComTimeout=0, ComSignalAccess=ACCESS_NEEDED_BY_OTHER, ComHandleId=3, ComSystemTemplateSystemSignalRef=sig_State_RearInteriorLight
        sig_State_RearLeftDoor_omsg_Receive_oCAN00_84ad4140_Rx: ComBitPosition=0, ComBitSize=1, ComSignalEndianness=LITTLE_ENDIAN, ComTimeout=0, ComSignalAccess=ACCESS_NEEDED_BY_OTHER, ComHandleId=4, ComSystemTemplateSystemSignalRef=sig_State_RearLeftDoor
        sig_State_RearRightDoor_omsg_Receive_oCAN00_a8945098_Rx: ComBitPosition=1, ComBitSize=1, ComSignalEndianness=LITTLE_ENDIAN, ComTimeout=0, ComSignalAccess=ACCESS_NEEDED_BY_OTHER, ComHandleId=5, ComSystemTemplateSystemSignalRef=sig_State_RearRightDoor
      ComTimeBase: ComRxTimeBase=0.01, ComTxTimeBase=0.01, ComGwTimeBase=0.01
    ComGeneral:
      ComConfigurationUseDet = true
      ComSafeBswChecks = false
      ComEnableSignalGroupArrayApi = false
      ComRetryFailedTransmitRequests = false
      ComSupportedIPduGroups = 2
      ComVersionInfoApi = false
      ComAdvancedIPduCallouts = true
      ComOptimizedIPduGroupHandling = false
      ComMetaDataSupport = false
      ComReceiveSignalMacroAPI = false
      ComDeferredEventCacheSupport = false
      ComMainfunctionTimingDomainSupport = false
      ComSignalGateway = false
      ComDescriptionGateway = false
      ComDescriptionRoutingCodeGeneration = false
    ComGeneration:
      ComOutOfBoundsWriteProtectionStrategy = NONE
      ComOutOfBoundsWriteSanitizer = false
      ComOutOfBoundsReadSanitizer = false
      ComReduceConstantData2Define = false
      ComBoolDataInArrayOfStructStrategy = BOOLEAN
      ComDeduplicateIndirectedData = true
      ComDataDeduplicationStrategy = WITH_CAST
      ComReduceBoolDataByNegationThreshold = 2
      ComReduceBoolDataByNumericalComparisonThreshold = 2
      ComReduceBoolDataByNumericalRelationThreshold = 2
      ComReduceBoolDataByNumericalOperandStrategy = WITH_ANY_VALUE
      ComReduceNumericalDataByOffsetThreshold = 2
      ComReduceNumericalDataByArraySubtractionThreshold = 2
      ComReduceDataByStreaming = false
      ComShortSymbols = false
      ComInterfacesForDeactivatedData = false
      ComReferringKeysInComments = false
    ComOptimization:
      ComTxCyclicProcessingISRLockThreshold = 1
      ComTxDeadlineMonitoringISRLockThreshold = 1
      ComTxProcessingISRLockThreshold = 1
      ComRxDeadlineMonitoringISRLockThreshold = 1
      ComRxDeferredProcessingISRLockThreshold = 1
      ComGatewayProcessingISRLockThreshold = 1
      ComGatewayDescriptionProcessingISRLockThreshold = 1
      ComIPduGroupISRLockThreshold = 1
